## drivers/soc/jlq/fingerprint/Kconfig
```kconfig
# JLQ fingerprint drivers

source "drivers/soc/jlq/fingerprint/fpc/Kconfig"
source "drivers/soc/jlq/fingerprint/goodix/Kconfig"
source "drivers/soc/jlq/fingerprint/silead/Kconfig"
```

## drivers/soc/jlq/fingerprint/fpc/Kconfig
```kconfig
#
# FPC Fingerprint driver configuration
#

config FPC_FINGERPRINT
	tristate "FPC Fingerprint driver support"
	help
	  This supports FPC Fingerprint drivers.
```

## drivers/soc/jlq/fingerprint/goodix/Kconfig
```kconfig
#
# GOODIX Fingerprint driver configuration
#

config GOODIX_FINGERPRINT
	tristate "GOODIX Fingerprint driver support"
	depends on FPC_FINGERPRINT
	help
	  This supports GOODIX Fingerprint drivers.
```

## drivers/soc/jlq/gpio/Kconfig
```kconfig
config GPIO_JLQ
	tristate "JLQ GPIO & pinctrl common support"
	depends on OF
	select PINMUX
	select GENERIC_PINCONF
	help
	  Say Y or M here to support GPIO & pinctrl on JLQ SoCs.

config GPIO_JLQ_QTANG
	tristate "JLQ qtang GPIO & pinctrl common support"
	depends on OF
	select PINMUX
	select GENERIC_PINCONF
	help
	  Say Y or M here to support GPIO & pinctrl on JLQ SoCs.
```

## drivers/soc/jlq/i2s/Kconfig
```kconfig
#
#  I2S drivers configuration
#

config JlQ_I2S
	tristate "JLQ I2S Component"
	default y
	help
	  Select driver for JLQ I2S Component.
```

## drivers/soc/jlq/iio/Kconfig
```kconfig
# SPDX-License-Identifier: GPL-2.0-only
#
# JLQ pwm drivers
#
source "drivers/soc/jlq/iio/adc/Kconfig"
```

## drivers/soc/jlq/iio/adc/Kconfig
```kconfig
# SPDX-License-Identifier: GPL-2.0-only
#
# JLQ pwm drivers
#
config JLQ_QCOM_SPMI_ADC5
	tristate "QTI SPMI PMIC5 ADC base on JLQ SOC"
	depends on SPMI
	select REGMAP_SPMI
	help
	  This is the IIO Voltage PMIC5 ADC driver for Qualcomm Technologies Inc.
	  The driver supports multiple channels read. The ADC is a 16-bit
	  sigma-delta ADC. The hardware supports calibrated results for
	  conversion requests and clients include reading voltage phone
	  power, on board system thermistors connected to the PMIC ADC,
	  PMIC die temperature, charger temperature, battery current, USB voltage
	  input, voltage signals connected to supported PMIC GPIO inputs. The
	  hardware supports internal pull-up for thermistors and can choose between
	  a 100k, 30k and 400k pull up using the ADC channels.

	  To compile this driver as a module, choose M here: the module will
	  be called qcom-spmi-adc5.
```

## drivers/soc/jlq/interconnect/Kconfig
```kconfig
# SPDX-License-Identifier: GPL-2.0-only
config INTERCONNECT_JLQ
	tristate "JLQ bus interconnect drivers"
	depends on ARCH_JLQ
	help
	  Support for JLQ's bus interconnect hardware.

config INTERCONNECT_JR510
	tristate "Qualcomm HOLI interconnect driver"
	depends on INTERCONNECT_JLQ
	help
	  This is a driver for the JLQ bus on jr510 platforms. The interconnect
	  provider collects and aggreagates the cosumer bandwidth requests to
	  satisfy constraints placed on bus performance states.

config INTERCONNECT_TEST
	tristate "Debugfs test"
	depends on INTERCONNECT_JLQ
	depends on DEBUG_FS
	help
	  Expose the interconnect API to userspace for testing purposes. This
	  will create /sys/kernel/debug/interconnect-test to allow requesting
	  bandwidth between endpoints.

	  If unsure, say no.
```

## drivers/soc/jlq/lpm/Kconfig
```kconfig
config JLQ_LPM_IRQ_CTRL
	tristate "lpm irq ctrl"
	default y if ARCH_JR510
	help
	  Convert qtang's edge interrupts convert to level triggered type,
	  in qtang's irq routine, we should clear and re-enable the relevant
	  irq, when request irq, we should also enable it.

	  If in doubt, say N here.
```

## drivers/soc/jlq/nanohub/Kconfig
```kconfig
config NANOHUB
	tristate "Nanohub"
	help
	  Enable support for the nanohub sensorhub driver.
	  This driver supports the android nanohub sensorhub.
	  It contains the devices of "nanohub" and "nanohub_comms".
	  If in doubt, say N here.
```

## drivers/soc/jlq/pmctrl/Kconfig
```kconfig
config PM_CTRL
	tristate "Device driver for pm control"
	help
	  Device driver for pm control.
```

## drivers/soc/jlq/pmic/Kconfig
```kconfig
# SPDX-License-Identifier: GPL-2.0-only
#
# JLQ PMIC drivers
#
menu "JLQ PMIC drivers"

source "drivers/soc/jlq/pmic/revid/Kconfig"

source "drivers/soc/jlq/pmic/regulator/Kconfig"

source "drivers/soc/jlq/pmic/pinctrl/Kconfig"

source "drivers/soc/jlq/pmic/pon/Kconfig"

source "drivers/soc/jlq/pmic/flash/Kconfig"

source "drivers/soc/jlq/pmic/pwm/Kconfig"

source "drivers/soc/jlq/pmic/rgb/Kconfig"

source "drivers/soc/jlq/pmic/vibrator/Kconfig"

source "drivers/soc/jlq/pmic/pm8008/Kconfig"

endmenu
```

## drivers/soc/jlq/pmic/flash/Kconfig
```kconfig
config LEDS_QPNP_FLASH_V2
	tristate "Support for QPNP V2 Flash LEDs"
	depends on LEDS_CLASS && MFD_SPMI_PMIC
	select LEDS_TRIGGERS
	help
	  This driver supports the flash V2 LED functionality of Qualcomm
	  Technologies, Inc. QPNP PMICs.  This driver supports PMICs starting
	  from PMI8998, PM8150L and their derivatives.  It can configure the
	  flash LED target current for several independent channels.  It also
	  supports various over current and over temperature mitigation features.
```

## drivers/soc/jlq/pmic/pinctrl/Kconfig
```kconfig
config PINCTRL_JLQ_SPMI_PMIC
       tristate "Qualcomm SPMI PMIC pin controller driver"
       depends on GPIOLIB && OF && SPMI
       select REGMAP_SPMI
       select PINMUX
       select PINCONF
       select GENERIC_PINCONF
       select GPIOLIB_IRQCHIP
       select IRQ_DOMAIN_HIERARCHY
       help
         This is the pinctrl, pinmux, pinconf and gpiolib driver for the
         Qualcomm GPIO and MPP blocks found in the Qualcomm PMIC's chips,
         which are using SPMI for communication with SoC. Example PMIC's
         devices are pm8841, pm8941 and pma8084.
```

## drivers/soc/jlq/pmic/pm8008/Kconfig
```kconfig
config MFD_I2C_PMIC
	tristate "QTI I2C PMIC support"
	depends on I2C && OF
	select IRQ_DOMAIN
	select REGMAP_I2C
	select MFD_CORE
	help
	  This enables support for controlling Qualcomm Technologies, Inc.
	  PMICs over I2C. The driver controls interrupts, and provides register
	  access for all of the device's peripherals.  Some QTI PMIC chips
	  support communication over both I2C and SPMI.
```

## drivers/soc/jlq/pmic/pon/Kconfig
```kconfig
config INPUT_QPNP_POWER_ON
	tristate "QPNP PMIC Power-on support"
	depends on SPMI
	help
	  This option enables device driver support for the power-on
	  functionality of Qualcomm Technologies, Inc. PNP PMICs.  It supports
	  reporting the change in status of the KPDPWR_N line (connected to the
	  power-key) as well as reset features.

config JLQ_POWEROFF
	tristate "JLQ PowerOff"
	depends on SPMI
	help
	  This option enables device driver support for the power-on
	  functionality of JLQ PMICs.  It supports
	  "adb reboot bootloader" or "adb reboot edl" command
```

## drivers/soc/jlq/pmic/pwm/Kconfig
```kconfig
config PWM_QTI_LPG
	tristate "Qualcomm Technologies, Inc. LPG driver"
	depends on MFD_SPMI_PMIC && OF
	help
	  This driver supports the LPG (Light Pulse Generator) module found in
	  Qualcomm Technologies, Inc. PMIC chips. Each LPG channel can be
	  configured to operate in PWM mode to output a fixed amplitude with
	  variable duty cycle or in LUT (Look up table) mode to output PWM
	  signal with a modulated amplitude.
```

## drivers/soc/jlq/pmic/regulator/Kconfig
```kconfig
# SPDX-License-Identifier: GPL-2.0-only
#
# JLQ regulator drivers
#
menu "JLQ regulator drivers"

config REGULATOR_STUB
	tristate "Stub Regulator"
	help
	  This driver adds stub regulator support. It allows for consumers to
	  request their regulator devices and to use all of the standard
	  regulator functions. It is useful for bringing up new platforms when
	  the real hardware based regulator implementation is not yet available.
	  Consumers can use stub regulator device with proper constraint
	  checking while the real regulator driver is being developed.

config JLQ_REGULATOR
	tristate "JLQ Regulator"
	help
	  This driver adds jlq regulator support. It allows for consumers to
	  request their regulator devices and to use all of the standard
	  regulator functions. It is useful for bringing up on JR510.
	  Consumers can use jlq regulator device with proper constraint
	  checking on JR510.

config REGULATOR_PROXY_CONSUMER
	tristate "Boot time regulator proxy consumer support"
	help
	  This library provides support for boot time regulator proxy requests.
	  It can enforce a specified voltage range, set a minimum current,
	  and/or keep a regulator enabled.  It is needed in circumstances where
	  reducing one or more of these three quantities will cause hardware to
	  stop working if performed before the driver managing the hardware has
	  probed.

config REGULATOR_QCOM_PM8008
	tristate "Qualcomm Technologies, Inc. PM8008 PMIC regulators"
	depends on MFD_I2C_PMIC
	help
	  This driver provides support for the voltage regulators and top-level
	  chip enablement of Qualcomm Technologies, Inc. PM8008 PMIC chips.
	  When all seven of the PM8008 LDO regulators are disabled, the PM8008
	  is put into a low power state.

config REGULATOR_QPNP_LCDB
        tristate "Qualcomm Technologies, Inc. QPNP LCDB support"
        depends on SPMI
        help
          Supports the LCDB module in the Qualcomm Technologies, Inc.
          QPNP PMICs. Exposes regulators to control the positive and
          negative voltage bias for the LCD display panel. It also
          allows configurability for the various bias-voltage parameters.


config REGULATOR_RPM_SMD
	tristate "RPM SMD regulator driver"
	depends on OF
	depends on MSM_RPM_SMD
	help
	  Compile in support for the RPM SMD regulator driver which is used for
	  setting voltages and other parameters of the various power rails
	  supplied by some Qualcomm Technologies Inc. PMICs. The RPM SMD regulator driver should
	  be used on systems which contain an RPM which communicates with the
	  application processor over SMD.

config REGULATOR_JLQ_DVFS
	tristate "JLQ dvfs feature"
	depends on REGULATOR
	help
	  This driver can trace the use information of special regulator
	  via regulator core. it can provide data for optimizing the power
	  consumption of system.
	  Say Y here to enable this feature.

endmenu
```

## drivers/soc/jlq/pmic/rgb/Kconfig
```kconfig
config LEDS_QTI_TRI_LED
	tristate "LED support for Qualcomm Technologies, Inc. TRI_LED"
	depends on LEDS_CLASS && MFD_SPMI_PMIC && PWM && OF
	help
	  This driver supports the TRI_LED module found in Qualcomm
	  Technologies, Inc. PMIC chips. TRI_LED supports 3 LED drivers
	  at max and each is controlled by a PWM channel used for dimming
	  or blinking.

	  To compile this driver as a module, choose M here: the module
	  will be called leds-qti-tri-led.
```

## drivers/soc/jlq/pmic/vibrator/Kconfig
```kconfig
config LEDS_QPNP_VIBRATOR_LDO
	tristate "Vibrator-LDO support for QPNP PMIC"
	depends on LEDS_CLASS && MFD_SPMI_PMIC
	help
	  This option enables device driver support for the vibrator-ldo
	  peripheral found on Qualcomm Technologies, Inc. QPNP PMICs.
	  The vibrator-ldo peripheral is capable of driving ERM vibrators.

config GPIO_VIBRATOR
	tristate "Vibrator-gpio support"
	depends on GPIOLIB
	help
	  This option enables device driver support for the vibrator-gpio
	  peripheral found on JLQ.
	  The vibrator-gpio peripheral is capable of driving ERM vibrators.
```

## drivers/soc/jlq/power/Kconfig
```kconfig
# SPDX-License-Identifier: GPL-2.0-only
#
# JLQ POWER drivers
#

menu "JLQ Power drivers"
source "drivers/soc/jlq/power/qcom/Kconfig"
endmenu
source "drivers/soc/jlq/power/supply/Kconfig"
```

## drivers/soc/jlq/power/qcom/Kconfig
```kconfig
# SPDX-License-Identifier: GPL-2.0-only
# JLQ POWER drivers

config JLQ_QCOM_POWER_SUPPLY
	tristate "QTI power supply support on jlq SOC"
	depends on ARCH_JLQ
	help
	  Say Y here to enable qcom power supply  support.This allows
	  Qcom power supply (batteries, qg, charger) monitoring by userspace
	  via sysfs and uevent (if available) and/or APM kernel interface
	  (if selected below).

if JLQ_QCOM_POWER_SUPPLY
config JLQ_QPNP_QG
	tristate "QPNP Qgauge driver"
	depends on MFD_SPMI_PMIC
	depends on IIO
	help
	  Say Y here to enable the Qualcomm Technologies, Inc. QGauge driver
	  which uses the periodic sampling of the battery voltage and current
	  to determine the battery state-of-charge (SOC) and supports other
	  battery management features.

	  To compile this driver as a module, choose M here: the
	  module will be called qcom-qpnp-qg.

config JLQ_QPNP_SMB5
	tristate "SMB5 Battery Charger"
	depends on MFD_SPMI_PMIC && IIO && TYPEC
	help
	  Say Y to enables support for the SMB5 charging peripheral.
	  The QPNP SMB5 charger driver supports the charger peripheral
	  present in the chip.
	  The power supply and iio frameworks are used to communicate battery
	  and usb properties to userspace and other driver consumers such
	  as fuel gauge, USB, and USB-PD.
	  VBUS and VCONN regulators are registered for supporting OTG,
	  and powered Type-C cables respectively.

	  To compile this driver as a module, choose M here: the
	  module will be called qpnp-smb5-main.

config JLQ_SMB1355_SLAVE_CHARGER
	tristate "SMB1355 Slave Battery Charger"
	depends on JLQ_QCOM_MFD_I2C_PMIC && IIO
	help
	  Say Y to include support for SMB1355 Battery Charger.
	  SMB1355 is a single phase 5A battery charger.
	  The driver supports charger enable/disable.
	  The driver reports the charger status via the power supply framework.
	  A charger status change triggers an IRQ via the device STAT pin.

endif # JLQ_QCOM_POWER_SUPPLY
```

## drivers/soc/jlq/power/supply/Kconfig
```kconfig
# SPDX-License-Identifier: GPL-2.0-only
# JLQ POWER drivers

config JLQ_CHARGER_MANAGER
	tristate "JLQ charger manager"
	depends on ARCH_JLQ
	help
	  Say Y here to enable JLQ charger manager support.This allows
	  jlq charger (batteries, jcmvote, charger manager) .

config JLQ_SD7601
	tristate "SD7601 charger IC for JLQ charger"
	depends on ARCH_JLQ
	help
	  Say Y here to enable SD7601 charger IC for JLQ chargert.
	  This allows SD7601 charger driver.

config JLQ_SGM4154X
        tristate "SD7601 charger IC for JLQ charger"
        depends on ARCH_JLQ
        help
          Say Y here to enable SGM4154X charger IC for JLQ chargert.
          This allows SGM4154X charger driver.




config JLQ_SH36610X
	tristate "SH36610x fuel gauge IC for JLQ charger"
	depends on ARCH_JLQ
	help
	  Say Y here to enable SH36610x gauge IC for JLQ chargert.
	  This allows SH36610x gauge driver.

config JLQ_CHARGER_FG_INFO_DEBUG
	tristate "SH36610x fuel gauge IC for JLQ charger debug"
	depends on ARCH_JLQ
	help
	 Say Y here to enable SH36610x gauge IC for JLQ charger debug.
```

## drivers/soc/jlq/pwm/Kconfig
```kconfig
# SPDX-License-Identifier: GPL-2.0-only
#
# JLQ pwm drivers
#
config PWM_JLQ
        tristate "JLQ pwm Support"
        help
          Generic PWM driver for jlq.
          To compile this driver as a module, choose M here.
```

## drivers/soc/jlq/reset/Kconfig
```kconfig
config RESET_JLQ
	tristate "JLQ Reset Driver"
	depends on ARCH_JLQ
	default n
	help
	  This enables the reset controller driver for JR510 Socs
```
