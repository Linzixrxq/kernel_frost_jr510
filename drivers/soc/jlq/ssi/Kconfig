## drivers/soc/jlq/ssi/Kconfig
```kconfig
config SPI_JLQ
	tristate "jlq SSP SPI master controller"
	depends on SPI_MASTER
	help
	  This enables using a SSP port as a SPI master controller.
```

## drivers/soc/jlq/sysdump/Kconfig
```kconfig
config JLQ_WATCHDOG
        tristate "JLQ watchdog"
	default n
        help
          Select this to support JLQ watchdog for monitor system run.
	  this driver will register an watchdog bark irq routine, the kernel
	  will to kick watchdog before it timeouts. if two consecutive timeout
	  happeded, the wdt hareware will generate an wdt bite irq signal which
	  routes to cm4 and arm cores. and the system will reset and when it is
	  unmasked for reset the Soc

config JLQ_SYSDUMP
	tristate "JLQ JLQ sysdump"
	default n
	help
	  the sysdump driver will receive extenal gpio trigger signal when
	  the serial or usb is not function properly, also it will receive
	  kernel panic notifier to force wdog timeout which cm4 will receive
	  wdog bite signal to start cpu and common register dump.

config JLQ_ISR_MONITOR
	tristate "irq count monitor"
	default n
	help
	  monitor the recent irq happened in JLQ soc, useful when
	  there are irq storm triggered to soc and the irq statics
	  will show in panic flow.
```

## drivers/soc/jlq/thermal/Kconfig
```kconfig
# SPDX-License-Identifier: GPL-2.0-only
#
# JLQ thermal drivers
#
source "drivers/soc/jlq/thermal/mpss/Kconfig"
source "drivers/soc/jlq/thermal/pmu/Kconfig"
source "drivers/soc/jlq/thermal/tsens/Kconfig"
source "drivers/soc/jlq/thermal/camera/Kconfig"
```

## drivers/soc/jlq/thermal/camera/Kconfig
```kconfig
# SPDX-License-Identifier: GPL-2.0-or-later
config JLQ_CAMERA_THERMAL
    tristate "JLQ camera thermal and bwlm driver"
    default m if ARCH_JLQ
config JLQ_CAMERA_THERMAL_TEST
    tristate "JLQ camera thermal and bwlm test driver"
```

## drivers/soc/jlq/thermal/mpss/Kconfig
```kconfig
# SPDX-License-Identifier: GPL-2.0-only
config QTI_QMI_SENSOR
	tristate "QTI QMI sensor driver"
	depends on QCOM_QMI_HELPERS && THERMAL_OF
	help
	   This enables to list the QTI remote subsystem temperature sensors.
	   This driver can read the temperature of the remote sensor.
	   These sensors can take thresholds and notify the thermal
	   framework when the threshold is reached.

config QTI_QMI_COOLING_DEVICE
	tristate "QTI QMI cooling devices"
	depends on QCOM_QMI_HELPERS && THERMAL_OF
	help
	   This enables the QTI remote subsystem cooling devices. These cooling
	   devices will be used by QTI chipset to place various remote
	   subsystem mitigations like remote processor passive mitigation,
	   remote subsystem voltage restriction at low temperatures etc.
	   The QMI cooling device will interface with remote subsystem
	   using QTI QMI interface.
```

## drivers/soc/jlq/thermal/pmu/Kconfig
```kconfig
# SPDX-License-Identifier: GPL-2.0-only
#
# JLQ pmu drivers
#
config JLQ_QTI_ADC_TM
	tristate "QTI Thermal Monitor ADC Driver base on JLQ SOC"
	depends on SPMI && THERMAL
	depends on JLQ_QCOM_SPMI_ADC5
	help
	  This enables the thermal Sysfs driver for the ADC thermal monitoring
	  device. It shows up in Sysfs as a thermal zone with multiple trip points.
	  Thermal client sets threshold temperature for both warm and cool
	  and gets updated when a threshold is reached.

config JLQ_QTI_BCL_SOC_DRIVER
	tristate "QTI Battery state of charge sensor driver base on JLQ SOC"
	depends on THERMAL_OF && POWER_SUPPLY
	help
	  This driver registers battery state of charge as a sensor with
	  thermal framework. This sensor can monitor for state of charge
	  thresholds and notify the thermal framework when the thresholds
	  are reached and cleared. This will help to monitor and apply any
	  mitigation when state of charge goes below a certain threshold.

config JLQ_QCOM_SPMI_TEMP_ALARM
	tristate "Qualcomm SPMI PMIC Temperature Alarm on JLQ SOC"
	depends on OF && SPMI && IIO
	select REGMAP_SPMI
	help
	  This enables a thermal sysfs driver for Qualcomm plug-and-play (QPNP)
	  PMIC devices. It shows up in sysfs as a thermal sensor with multiple
	  trip points. The temperature reported by the thermal sensor reflects the
	  real time die temperature if an ADC is present or an estimate of the
	  temperature based upon the over temperature stage value.

config JLQ_QTI_BCL_PMIC5
	tristate "BCL driver for BCL peripherals in PMIC5 on JLQ SOC"
	depends on SPMI && THERMAL_OF && JLQ_THERMAL
	help
	  This driver provides routines to configure and monitor the BCL
	  PMIC peripheral. This driver registers the battery current and
	  voltage sensors with the thermal core framework and can take
	  threshold input and notify the thermal core when the threshold is
	  reached.
```

## drivers/soc/jlq/timer/Kconfig
```kconfig
# SPDX-License-Identifier: GPL-2.0-only

config JLQ_DW_APB_TIMER
	tristate "DW APB timer driver"
	help
	  Enables the support for the dw_apb timer. this will register the
	  dw apb timer as an clocksource timer and been treated as a broadcast
	  timer in the end.
```

## drivers/soc/jlq/touchscreen/Kconfig
```kconfig
# SPDX-License-Identifier: GPL-2.0-only
#
# LCT touchscreen drivers
#
config TOUCHSCREEN_LCT
    tristate "lct Touchscreen Driver"
    help
      Say Y here if you want to add lct touchscreen driver.
      If unsure, say N.

source "drivers/soc/jlq/touchscreen/gsl/Kconfig"
source "drivers/soc/jlq/touchscreen/novatek/Kconfig"
source "drivers/soc/jlq/touchscreen/focaltech/Kconfig"
```

## drivers/soc/jlq/touchscreen/gsl/Kconfig
```kconfig
config TOUCHSCREEN_GSL
	tristate "GSL touchscreens"
	depends on I2C
	help
	  Say Y here if you have a touchscreen using GSL.

	  If unsure, say N.

	  To compile this driver as a module, choose M here: the
	  module will be called gsl_ts.
```

## drivers/soc/jlq/tz/Kconfig
```kconfig
config JLQ_TZ_VERIFIER
	tristate "JLQ trustzone verifier support"
	default n
	depends on TEE
	help
	  This driver supports trustzone verifier support
```

## drivers/soc/jlq/usb/Kconfig
```kconfig
# SPDX-License-Identifier: GPL-2.0-only
#
# JLQ Soc USB drivers
#

config JLQ_DWC2PHY
	tristate "JLQ DWC2 PHY controller Driver"
	select USB_PHY
	help
	  Enable this to support JLQ DWC2 phy controller
	  for JLQ SoCs.

config JLQ_USB_DWC2
	tristate "JLQ USB DWC2 Configuration"
	help
	  say y to support for JLQ DWC2 Configuration：
	  add dma_dir member in struct dwc2_hsotg_ep for
	  the input parameter for USB map/umap DMA in
	  DWC2

config USB_F_CDEV
	tristate

config USB_F_GSI
	tristate

config USB_CONFIGFS_F_CDEV
	tristate "USB Serial Character function"
	select USB_F_CDEV
	depends on USB_CONFIGFS
	help
	  The serial character function is a generic function driver that
	  exposes a pair of bulk IN and OUT endpoints which are backed by
	  a character device and mapped to its read/write routines. The
	  function also supports a single interrupt IN endpoint for
	  asynchronous notification to the host. This driver is typically
	  used to support DUN/NMEA functions.

config USB_CONFIGFS_F_GSI
	tristate "USB GSI function"
	select USB_F_GSI
	depends on USB_CONFIGFS
	help
	  Generic function driver to support h/w acceleration to IPA
	  over GSI. This driver provides USB RMNET/RNDIS/ECM/MBIM/DPL
	  related functionalities using GSI hardware accelerated data
	  path and control path.

config USB_EXT_TYPE_C_PERICOM
	tristate "USB Type-C charger detection support using Pericom chip"
	depends on I2C && POWER_SUPPLY
	help
	  Enables support for the USB Type-C chargers using external
	  pericom chip connected using I2C.

	  This adds support for detecting USB Type-C chargers that
	  can supply upto 3A Vbus current for charging.

config EXTCON_JLQ_USB_GPIO
	tristate "USB GPIO extcon support"
	depends on GPIOLIB
	help
	  Say Y here to enable GPIO based USB cable detection extcon support.
	  Used typically if GPIO is used for USB ID pin detection.
```

## drivers/soc/jlq/vdsp/Kconfig
```kconfig
config JLQ_VDSP
	tristate "config vdsp driver"
	help
	  enable it, if you need the communication between the host and
	  the coprocessors, or use the VDSP module, etc.
```

## drivers/soc/jlq/vdsp/ssr/Kconfig
```kconfig
config JLQ_SSR
	tristate "JLQ VDSP SSR support"
	depends on ARCH_JLQ
	default n
	help
	  jlq vdsp subsys restart and ramdump.
```
