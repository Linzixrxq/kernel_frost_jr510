## drivers/soc/qcom/Kconfig
```kconfig
# SPDX-License-Identifier: GPL-2.0-only
#
# QCOM Soc drivers
#
menu "Qualcomm SoC drivers"

config QCOM_AOSS_QMP
	tristate "Qualcomm AOSS Driver"
	depends on ARCH_QCOM || COMPILE_TEST
	depends on MAILBOX
	depends on COMMON_CLK && PM
	select PM_GENERIC_DOMAINS
	help
	  This driver provides the means of communicating with and controlling
	  the low-power state for resources related to the remoteproc
	  subsystems as well as controlling the debug clocks exposed by the Always On
	  Subsystem (AOSS) using Qualcomm Messaging Protocol (QMP).

config QCOM_COMMAND_DB
	tristate "Qualcomm Command DB"
	depends on ARCH_QCOM || COMPILE_TEST
	depends on OF_RESERVED_MEM
	help
	  Command DB queries shared memory by key string for shared system
	  resources. Platform drivers that require to set state of a shared
	  resource on a RPM-hardened platform must use this database to get
	  SoC specific identifier and information for the shared resources.

config QCOM_GENI_SE
	tristate "QCOM GENI Serial Engine Driver"
	depends on ARCH_QCOM || COMPILE_TEST
	help
	  This driver is used to manage Generic Interface (GENI) firmware based
	  Qualcomm Technologies, Inc. Universal Peripheral (QUP) Wrapper. This
	  driver is also used to manage the common aspects of multiple Serial
	  Engines present in the QUP.

config QCOM_GLINK_SSR
	tristate "Qualcomm Glink SSR driver"
	depends on RPMSG
	depends on QCOM_RPROC_COMMON
	help
	  Say y here to enable GLINK SSR support. The GLINK SSR driver
	  implements the SSR protocol for notifying the remote processor about
	  neighboring subsystems going up or down.

config QCOM_GSBI
        tristate "QCOM General Serial Bus Interface"
        depends on ARCH_QCOM || COMPILE_TEST
        select MFD_SYSCON
        help
          Say y here to enable GSBI support.  The GSBI provides control
          functions for connecting the underlying serial UART, SPI, and I2C
          devices to the output pins.

config QCOM_LLCC
	tristate "Qualcomm Technologies, Inc. LLCC driver"
	depends on ARCH_QCOM || COMPILE_TEST
	select REGMAP_MMIO
	help
	  Qualcomm Technologies, Inc. platform specific
	  Last Level Cache Controller(LLCC) driver. This provides interfaces
	  to clients that use the LLCC. Say yes here to enable LLCC slice
	  driver.

config QCOM_SDM845_LLCC
	tristate "Qualcomm Technologies, Inc. SDM845 LLCC driver"
	depends on QCOM_LLCC
	help
	  Say yes here to enable the LLCC driver for SDM845. This provides
	  data required to configure LLCC so that clients can start using the
	  LLCC slices.

config QCOM_MDT_LOADER
	tristate
	select QCOM_SCM

config QCOM_PM
	bool "Qualcomm Power Management"
	depends on ARCH_QCOM && !ARM64
	select ARM_CPU_SUSPEND
	select QCOM_SCM
	help
	  QCOM Platform specific power driver to manage cores and L2 low power
	  modes. It interface with various system drivers to put the cores in
	  low power modes.

config MSM_PIL
	tristate "Peripheral image loader"
	select FW_LOADER
	help
	  Some peripherals' firmware need to be loaded into memory before
	  they can be brought out of reset. The Peripheral Image Loader (PIL)
	  framework is used to achive this. The driver relays the lower-level
	  functionalities such as, authenticating the images, performing the
	  reset of the peripheral, and so on to the drivers that are registered
	  with it.

	  Say 'y' or 'm' to support these devices.

config MSM_SUBSYSTEM_RESTART
	tristate "MSM Subsystem Restart"
	select MSM_PIL
	select QCOM_QMI_HELPERS
	help
	  This option enables the MSM subsystem restart framework.

	  The MSM subsystem restart framework provides support to boot,
	  shutdown, and restart subsystems with a reference counted API.
	  It also extends the APIs to add support for MSM System Monitor
	  using the QMI layer. These APIs may be used for sending events
	  or passing commands.
	  Moreover, the framework also notifies userspace of transitions
	  between these states via sysfs.
config SETUP_SSR_NOTIF_TIMEOUTS
	bool "Set timeouts on SSR sysmon notifications and notifier callbacks"
	help
	  Setup timers prior to initiating communication between
	  subsystems through sysmon, and prior to sending notifications
	  to drivers in the kernel that have registered callbacks with the
	  subsystem notifier framework for a particular subsystem. This
	  is a debugging feature.

config SSR_SYSMON_NOTIF_TIMEOUT
	depends on SETUP_SSR_NOTIF_TIMEOUTS
	int "SSR Sysmon notifications timeout in ms"
	default 10000
	help
	  The amount of time, in milliseconds, that should elapse between
	  the start and end of sysmon SSR notifications, before a warning
	  is emitted.

config SSR_SUBSYS_NOTIF_TIMEOUT
	depends on SETUP_SSR_NOTIF_TIMEOUTS
	int "SSR Subsystem notifier timeout in ms"
	default 10000
	help
	  The amount of time, in milliseconds, that should elapse between
	  the start and end of SSR notifications through the subsystem
	  notifier, before a warning is emitted.

config PANIC_ON_SSR_NOTIF_TIMEOUT
	bool "Trigger kernel panic when notification timeout expires"
	depends on SETUP_SSR_NOTIF_TIMEOUTS
	help
	  This is a debug feature where a kernel panic is triggered when
	  communication between subsystems through sysmon is taking too
	  long. This scneario can happen if the peripheral has died and
	  is no longer responsive.
	  Also trigger a kernel panic if invoking the callbacks registered
	  with a particular subsystem's notifications by the subsystem
	  notifier framework is taking too long.

config MSM_PIL_SSR_GENERIC
	tristate "MSM Subsystem Boot Support"
	depends on MSM_SUBSYSTEM_RESTART
	help
	  Support for booting and shutting down MSM Subsystem processors.
	  This driver also monitors the SMSM status bits and the watchdog
	  interrupt for the subsystem and restarts it on a watchdog bite
	  or a fatal error. Subsystems include LPASS, Venus, VPU, WCNSS and
	  BCSS.

config MSM_SERVICE_LOCATOR
	tristate "Service Locator"
	select QCOM_QMI_HELPERS
	help
	  The Service Locator provides a library to retrieve location
	  information given a service identifier. Location here translates
	  to what process domain exports the service, and which subsystem
	  that process domain will execute in.

config MSM_SERVICE_NOTIFIER
	tristate "Service Notifier"
	depends on MSM_SERVICE_LOCATOR && MSM_SUBSYSTEM_RESTART
	help
	  The Service Notifier provides a library for a kernel client to
	  register for state change notifications regarding a remote service.
	  A remote service here refers to a process providing certain services
	  like audio, the identifier for which is provided by the service
	  locator.
config QCOM_QMI_HELPERS
	tristate "Qualcomm Technologies, Inc. QMI_HELPERS driver "
#	depends on ARCH_QCOM || COMPILE_TEST
#	depends on NET

source "drivers/soc/qcom/memshare/Kconfig"

config QCOM_RMTFS_MEM
	tristate "Qualcomm Remote Filesystem memory driver"
	depends on ARCH_QCOM
	select QCOM_SCM
	help
	  The Qualcomm remote filesystem memory driver is used for allocating
	  and exposing regions of shared memory with remote processors for the
	  purpose of exchanging sector-data between the remote filesystem
	  service and its clients.

	  Say y here if you intend to boot the modem remoteproc.

config QCOM_RPMH
	tristate "Qualcomm RPM-Hardened (RPMH) Communication"
	depends on ARCH_QCOM && ARM64 || COMPILE_TEST
	help
	  Support for communication with the hardened-RPM blocks in
	  Qualcomm Technologies Inc (QTI) SoCs. RPMH communication uses an
	  internal bus to transmit state requests for shared resources. A set
	  of hardware components aggregate requests for these resources and
	  help apply the aggregated state on the resource.

config QCOM_RPMHPD
	tristate "Qualcomm RPMh Power domain driver"
	depends on QCOM_RPMH && QCOM_COMMAND_DB
	help
	  QCOM RPMh Power domain driver to support power-domains with
	  performance states. The driver communicates a performance state
	  value to RPMh which then translates it into corresponding voltage
	  for the voltage rail.

config QCOM_RPMPD
	bool "Qualcomm RPM Power domain driver"
	depends on QCOM_SMD_RPM=y
	help
	  QCOM RPM Power domain driver to support power-domains with
	  performance states. The driver communicates a performance state
	  value to RPM which then translates it into corresponding voltage
	  for the voltage rail.

config QCOM_SMEM
	tristate "Qualcomm Shared Memory Manager (SMEM)"
	depends on ARCH_QCOM || COMPILE_TEST
	depends on HWSPINLOCK
	help
	  Say y here to enable support for the Qualcomm Shared Memory Manager.
	  The driver provides an interface to items in a heap shared among all
	  processors in a Qualcomm platform.

config QCOM_SMD_RPM
	tristate "Qualcomm Resource Power Manager (RPM) over SMD"
	depends on ARCH_QCOM || COMPILE_TEST
	depends on RPMSG
	help
	  If you say yes to this option, support will be included for the
	  Resource Power Manager system found in the Qualcomm 8974 based
	  devices.

	  This is required to access many regulators, clocks and bus
	  frequencies controlled by the RPM on these devices.

	  Say M here if you want to include support for the Qualcomm RPM as a
	  module. This will build a module called "qcom-smd-rpm".

config QCOM_SMEM_STATE
	tristate
	help
	  If you say yes to this option, support will be included for the
	  Resource Power Manager system found in the Qualcomm 8974 based
	  devices.

config QCOM_SMP2P
	tristate "Qualcomm Shared Memory Point to Point support"
	depends on MAILBOX
	depends on QCOM_SMEM
	select QCOM_SMEM_STATE
	select IRQ_DOMAIN
	help
	  Say yes here to support the Qualcomm Shared Memory Point to Point
	  protocol.

config QCOM_SMSM
	tristate "Qualcomm Shared Memory State Machine"
	depends on QCOM_SMEM
	select QCOM_SMEM_STATE
	select IRQ_DOMAIN
	help
	  Say yes here to support the Qualcomm Shared Memory State Machine.
	  The state machine is represented by bits in shared memory.

config QCOM_SOCINFO
	tristate "Qualcomm socinfo driver"
	depends on QCOM_SMEM
	select SOC_BUS
	help
	 Say yes here to support the Qualcomm socinfo driver, providing
	 information about the SoC to user space.

config QCOM_WCNSS_CTRL
	tristate "Qualcomm WCNSS control driver"
	depends on ARCH_QCOM || COMPILE_TEST
	depends on RPMSG
	help
	  Client driver for the WCNSS_CTRL SMD channel, used to download nv
	  firmware to a newly booted WCNSS chip.

config QCOM_MINIDUMP
	tristate "QCOM Minidump Support"
	depends on QCOM_SMEM && POWER_RESET_MSM
	help
	  This enables minidump feature. It allows various clients to
	  register to dump their state at system bad state (panic/WDT,etc.,).
	  Minidump would dump all registered entries, only when DLOAD mode
	  is enabled.

config QCOM_DYN_MINIDUMP_STACK
	bool "QTI Dynamic Minidump Stack Registration Support"
	depends on QCOM_MINIDUMP
	help
	  This enables minidump dynamic current stack registration feature.
	  It allows current task stack to be available in minidump, for cases
	  where CPU is unable to register it from IPI_CPU_STOP. The stack data
	  can be used to unwind stack frames.

config QCOM_MINIDUMP_FTRACE
	bool "QCOM Minidump Support"
	depends on QGKI && QCOM_MINIDUMP
	help
	  This enables ftrace buffer registration in minidump table.
	  This allows dumping ftrace buffer content as part of
	  minidump dumps.

config QCOM_MINIDUMP_PANIC_DUMP
	bool "QCOM Minidump Panic dumps Support"
	depends on QGKI && QCOM_MINIDUMP
	help
	  This enables various dumps collection in minidump table,
	  on panic.

config QCOM_MINIDUMP_PANIC_CPU_CONTEXT
	bool "QCOM Minidump Panic dumps Support"
	depends on ARM64 && QCOM_MINIDUMP_PANIC_DUMP
	help
	  This enables cpu context collection in minidump table,
	  on panic.

config MINIDUMP_MAX_ENTRIES
	int "Minidump Maximum num of entries"
	default 200
	depends on QCOM_MINIDUMP
	help
	  This defines maximum number of entries to be allocated for application
	  subsytem in Minidump table.
config QCOM_MICRODUMP
	tristate "Qualcomm Technologies, Inc. Microdump Support"
	depends on MSM_SUBSYSTEM_RESTART
	depends on QCOM_SMEM
	help
	  This enables microdump feature. It collects
	  crash data from SMEM whenever modem subsytem
	  crashes and stores it under /dev to expose
	  to user space.
config QCOM_APR
	tristate "Qualcomm APR Bus (Asynchronous Packet Router)"
	depends on ARCH_QCOM || COMPILE_TEST
	depends on RPMSG
	help
          Enable APR IPC protocol support between
          application processor and QDSP6. APR is
          used by audio driver to configure QDSP6
          ASM, ADM and AFE modules.

config QCOM_SECURE_BUFFER
	tristate "Helper functions for secure buffers through TZ"
	depends on QCOM_SCM
	help
	  Enable for targets that need to call into TZ to secure
	  memory buffers. This ensures that only the correct clients can
	  use this memory and no unauthorized access is made to the
	  buffer.
config QCOM_GLINK_PKT
	tristate "Enable device interface for GLINK packet channels"
	depends on QCOM_GLINK
	help
	  G-link packet driver provides the interface for the userspace
	  clients to communicate over G-Link via device nodes.
	  This enable the userspace clients to read and write to
	  some glink packets channel.
config QCOM_SMP2P_SLEEPSTATE
	tristate "SMP2P Sleepstate notifier"
	depends on QCOM_SMP2P
	help
	  When this option is enabled, notifications are sent to remote procs
	  for the power state changes on the local processor. The notifications
	  are sent through the smp2p framework. This driver can also receive
	  notifications from the remote to prevent suspend on the local
	  processor.
config QCOM_GLINK
	tristate "GLINK Probe Helper"
	depends on RPMSG_QCOM_GLINK_SMEM
	help
	  This enables the GLINK Probe module. This is designed to set up
	  other edges in the system. It will initialize all the transports for
	  all the edges present in the device.
	  Say M if you want to enable this module.

config MSM_GLINK_SSR
	tristate "MSM GLINK SSR"
	depends on RPMSG
	help
	  The GLINK RPMSG Plugin is currently designed to plugin with the
	  remote proc framework as a subdev. This module is responsible
	  for creating the glink transports when remote proc is disabled. This
	  will be used for drivers on MSMs.
	  Say M if you want to enable this

config QTI_RPM_STATS_LOG
	tristate "Qualcomm Technologies RPM Stats Driver"
	help
	  This option enables a driver which reads RPM messages from a shared
	  memory location. These messages provide statistical information about
	  the low power modes that RPM enters. The drivers outputs the message
	  via a sysfs node.


config QCOM_SOC_SLEEP_STATS
	tristate "Qualcomm Technologies, Inc. (QTI) SoC sleep stats driver"
	help
	  Qualcomm Technologies Inc (QTI) SoC sleep stats driver to read
	  the shared memory exported by the remote processor related to
	  various SoC level low power modes statistics and export to sysfs
	  interface.

source "drivers/soc/qcom/icnss2/Kconfig"
endmenu
```
