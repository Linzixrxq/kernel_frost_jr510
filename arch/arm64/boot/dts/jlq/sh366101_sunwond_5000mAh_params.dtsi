// SPDX-License-Identifier: GPL-2.0+
fg_battery_params {
	nominal_voltage = <385>;
	version_afi = <0x4A1A>;
	sinofs_afi_data = /bits/ 8 <
		0x02 0xAA 0x3E 0x02 0x00 0x80
		0x04 0x02 0x00 0x02
		0x02 0xAA 0x3E 0x02 0x00 0x80
		0x04 0x02 0x00 0x02
		0x02 0xAA 0x3E 0x02 0xCB 0x00
		0x04 0x02 0x00 0x05
		0x03 0xAA 0x3E 0x04 0xCB 0x00 0x00 0x00
		0x04 0x02 0x00 0x02
		0x02 0xAA 0x3E 0x02 0x01 0xE0
		0x04 0x02 0x00 0x02
		0x02 0xAA 0x40 0x08 0x65 0x4E 0x54 0x45 0x52 0x4F 0x45 0x4D
		0x04 0x02 0x00 0x02
		0x02 0xAA 0x60 0x02 0x9F 0x0C
		0x04 0x02 0x00 0xC8
		0x02 0xAA 0x3E 0x02 0xCB 0x00
		0x04 0x02 0x00 0x05
		0x03 0xAA 0x3E 0x05 0xCB 0x00 0x00 0x00 0x01
		0x04 0x02 0x00 0xC8
		0x02 0xAA 0x3E 0x02 0x11 0xE0
		0x04 0x02 0x00 0x02
		0x02 0xAA 0x40 0x07 0x65 0x52 0x78 0x44 0x72 0x61 0x6D
		0x04 0x02 0x00 0x02
		0x02 0xAA 0x60 0x02 0x5B 0x0B
		0x04 0x02 0x00 0xC8
		0x02 0xAA 0x3E 0x02 0xC0 0x00
		0x04 0x02 0x00 0x05
		0x03 0xAA 0x3E 0x04 0xC0 0x00 0xAA 0x11
		0x04 0x02 0x00 0x02
		0x02 0xAA 0x3E 0x02 0x10 0xE0
		0x04 0x02 0x00 0x02
		0x02 0xAA 0x40 0x08 0x45 0x52 0x6F 0x4E 0x43 0x48 0x49 0x50
		0x04 0x02 0x00 0x02
		0x02 0xAA 0x60 0x02 0x97 0x0C
		0x04 0x02 0x00 0xC8
		0x02 0xAA 0x3E 0x02 0xC0 0x00
		0x04 0x02 0x00 0x05
		0x03 0xAA 0x3E 0x04 0xC0 0x00 0xAA 0x10
		0x04 0x02 0x00 0x02
		0x02 0xAA 0x3E 0x02 0x40 0x40
		0x04 0x02 0x00 0x14
		0x02 0xAA 0x40 0x0E 0x1F 0x6A 0x00 0x00 0xFC 0x18 0x00 0x2B 0x58 0xBD 0xE6 0x00 0x40 0x05
		0x04 0x02 0x00 0x0A
		0x02 0xAA 0x60 0x02 0x77 0x12
		0x04 0x02 0x00 0x32
		0x02 0xAA 0x3E 0x02 0xC2 0x00
		0x04 0x02 0x00 0x0A
		0x03 0xAA 0x3E 0x04 0xC2 0x00 0x79 0x69
		0x02 0xAA 0x3E 0x02 0x50 0x40
		0x04 0x02 0x00 0x14
		0x02 0xAA 0x40 0x10 0x20 0x05 0x00 0x00 0x00 0x00 0xCC 0xCC 0x1F 0x27 0x0A 0x14 0x00 0x00 0x34 0x03
		0x04 0x02 0x00 0x0A
		0x02 0xAA 0x60 0x02 0x17 0x14
		0x04 0x02 0x00 0x32
		0x02 0xAA 0x3E 0x02 0xC2 0x00
		0x04 0x02 0x00 0x0A
		0x03 0xAA 0x3E 0x04 0xC2 0x00 0x3D 0x07
		0x02 0xAA 0x3E 0x02 0x74 0x40
		0x04 0x02 0x00 0x14
		0x02 0xAA 0x40 0x01 0x01
		0x04 0x02 0x00 0x0A
		0x02 0xAA 0x60 0x02 0x4A 0x05
		0x04 0x02 0x00 0x32
		0x02 0xAA 0x3E 0x02 0xC2 0x00
		0x04 0x02 0x00 0x0A
		0x03 0xAA 0x3E 0x04 0xC2 0x00 0xE6 0x49
		0x02 0xAA 0x3E 0x02 0x88 0x40
		0x04 0x02 0x00 0x14
		0x02 0xAA 0x40 0x20 0x10 0xFE 0x00 0x64 0x00 0x64 0x28 0x00 0x19 0x00 0x0A 0x14 0x19 0x2D 0x37 0x01 0x10 0xFE 0x00 0x84 0x01 0x60 0x01 0x08 0x00 0x64 0x10 0xFE 0x07 0xBC 0x0F 0xA4
		0x04 0x02 0x00 0x0A
		0x02 0xAA 0x60 0x02 0xA0 0x24
		0x04 0x02 0x00 0x32
		0x02 0xAA 0x3E 0x02 0xC2 0x00
		0x04 0x02 0x00 0x0A
		0x03 0xAA 0x3E 0x04 0xC2 0x00 0x83 0x00
		0x02 0xAA 0x3E 0x02 0xA8 0x40
		0x04 0x02 0x00 0x14
		0x02 0xAA 0x40 0x20 0x0B 0xB0 0x00 0x64 0x10 0xFE 0x09 0xCC 0x11 0x88 0x0D 0xC0 0x00 0x64 0x10 0xFE 0x07 0xBC 0x0F 0xA4 0x0B 0xB0 0x00 0x64 0x10 0xFE 0x03 0xF4 0x07 0xBC 0x05 0xD8
		0x04 0x02 0x00 0x0A
		0x02 0xAA 0x60 0x02 0x03 0x24
		0x04 0x02 0x00 0x32
		0x02 0xAA 0x3E 0x02 0xC2 0x00
		0x04 0x02 0x00 0x0A
		0x03 0xAA 0x3E 0x04 0xC2 0x00 0x20 0x63
		0x02 0xAA 0x3E 0x02 0xC8 0x40
		0x04 0x02 0x00 0x14
		0x02 0xAA 0x40 0x20 0x00 0x64 0x0A 0xF0 0x00 0x58 0x00 0x2C 0x0B 0x54 0x0E 0x10 0x0F 0xA0 0x00 0x32 0x4B 0x01 0x00 0x00 0x00 0x00 0x00 0x00 0x00 0x00 0x00 0x00 0x00 0x00 0x00 0x00
		0x04 0x02 0x00 0x0A
		0x02 0xAA 0x60 0x02 0x6B 0x24
		0x04 0x02 0x00 0x32
		0x02 0xAA 0x3E 0x02 0xC2 0x00
		0x04 0x02 0x00 0x0A
		0x03 0xAA 0x3E 0x04 0xC2 0x00 0x44 0x4B
		0x02 0xAA 0x3E 0x02 0xE8 0x40
		0x04 0x02 0x00 0x14
		0x02 0xAA 0x40 0x1B 0x00 0x00 0x00 0x00 0x00 0x00 0x00 0x00 0x00 0x00 0x00 0x00 0x00 0x00 0x00 0x00 0x00 0x00 0x00 0x00 0x00 0x00 0x00 0x00 0x00 0x00 0x00
		0x04 0x02 0x00 0x0A
		0x02 0xAA 0x60 0x02 0xD7 0x1F
		0x04 0x02 0x00 0x32
		0x02 0xAA 0x3E 0x02 0xC2 0x00
		0x04 0x02 0x00 0x0A
		0x03 0xAA 0x3E 0x04 0xC2 0x00 0xC8 0x3C
		0x02 0xAA 0x3E 0x02 0x12 0x41
		0x04 0x02 0x00 0x14
		0x02 0xAA 0x40 0x04 0x0A 0xF0 0x00 0x14
		0x04 0x02 0x00 0x0A
		0x02 0xAA 0x60 0x02 0x9E 0x08
		0x04 0x02 0x00 0x32
		0x02 0xAA 0x3E 0x02 0xC2 0x00
		0x04 0x02 0x00 0x0A
		0x03 0xAA 0x3E 0x04 0xC2 0x00 0xB3 0x1A
		0x02 0xAA 0x3E 0x02 0x18 0x41
		0x04 0x02 0x00 0x14
		0x02 0xAA 0x40 0x02 0x14 0x14
		0x04 0x02 0x00 0x0A
		0x02 0xAA 0x60 0x02 0x7E 0x06
		0x04 0x02 0x00 0x32
		0x02 0xAA 0x3E 0x02 0xC2 0x00
		0x04 0x02 0x00 0x0A
		0x03 0xAA 0x3E 0x04 0xC2 0x00 0x38 0x7C
		0x02 0xAA 0x3E 0x02 0x22 0x41
		0x04 0x02 0x00 0x14
		0x02 0xAA 0x40 0x01 0x13
		0x04 0x02 0x00 0x0A
		0x02 0xAA 0x60 0x02 0x89 0x05
		0x04 0x02 0x00 0x32
		0x02 0xAA 0x3E 0x02 0xC2 0x00
		0x04 0x02 0x00 0x0A
		0x03 0xAA 0x3E 0x04 0xC2 0x00 0x3F 0x08
		0x02 0xAA 0x3E 0x02 0x24 0x41
		0x04 0x02 0x00 0x14
		0x02 0xAA 0x40 0x20 0xFE 0xD5 0xFC 0x18 0x00 0x83 0x13 0x88 0x11 0x38 0x00 0xB4 0x11 0x62 0xFE 0xD5 0xFC 0x18 0x00 0x00 0x00 0x00 0x00 0x00 0x00 0x00 0x00 0x00 0x00 0x00 0x00 0x00
		0x04 0x02 0x00 0x0A
		0x02 0xAA 0x60 0x02 0x3E 0x24
		0x04 0x02 0x00 0x32
		0x02 0xAA 0x3E 0x02 0xC2 0x00
		0x04 0x02 0x00 0x0A
		0x03 0xAA 0x3E 0x04 0xC2 0x00 0x67 0x1E
		0x02 0xAA 0x3E 0x02 0x48 0x41
		0x04 0x02 0x00 0x14
		0x02 0xAA 0x40 0x20 0x0D 0x48 0x0A 0x5F 0x00 0x00 0x00 0x00 0x00 0x00 0x13 0x24 0x07 0x5F 0x00 0x00 0x00 0x00 0x00 0x00 0x00 0x00 0x00 0x3C 0x00 0x4B 0x00 0x28 0x00 0x3C 0x3C 0x05
		0x04 0x02 0x00 0x0A
		0x02 0xAA 0x60 0x02 0xEF 0x24
		0x04 0x02 0x00 0x32
		0x02 0xAA 0x3E 0x02 0xC2 0x00
		0x04 0x02 0x00 0x0A
		0x03 0xAA 0x3E 0x04 0xC2 0x00 0xAC 0x4F
		0x02 0xAA 0x3E 0x02 0x68 0x41
		0x04 0x02 0x00 0x14
		0x02 0xAA 0x40 0x06 0x00 0x00 0x00 0x00 0x00 0x00
		0x04 0x02 0x00 0x0A
		0x02 0xAA 0x60 0x02 0x56 0x0A
		0x04 0x02 0x00 0x32
		0x02 0xAA 0x3E 0x02 0xC2 0x00
		0x04 0x02 0x00 0x0A
		0x03 0xAA 0x3E 0x04 0xC2 0x00 0x25 0x50
		0x02 0xAA 0x3E 0x02 0x74 0x41
		0x04 0x02 0x00 0x14
		0x02 0xAA 0x40 0x18 0x0B 0xB8 0x0C 0x1C 0x00 0x05 0x11 0x30 0x10 0xCC 0x64 0x62 0x0C 0x80 0x0C 0xE4 0x06 0x08 0x11 0x30 0x10 0xCC 0x64 0x5F
		0x04 0x02 0x00 0x0A
		0x02 0xAA 0x60 0x02 0x0D 0x1C
		0x04 0x02 0x00 0x32
		0x02 0xAA 0x3E 0x02 0xC2 0x00
		0x04 0x02 0x00 0x0A
		0x03 0xAA 0x3E 0x04 0xC2 0x00 0xC2 0x75
		0x02 0xAA 0x3E 0x02 0x9C 0x41
		0x04 0x02 0x00 0x14
		0x02 0xAA 0x40 0x08 0x3F 0x0A 0x19 0x64 0x3C 0x0A 0x5F 0x05
		0x04 0x02 0x00 0x0A
		0x02 0xAA 0x60 0x02 0xB2 0x0C
		0x04 0x02 0x00 0x32
		0x02 0xAA 0x3E 0x02 0xC2 0x00
		0x04 0x02 0x00 0x0A
		0x03 0xAA 0x3E 0x04 0xC2 0x00 0xB5 0x2A
		0x02 0xAA 0x3E 0x02 0xDE 0x41
		0x04 0x02 0x00 0x14
		0x02 0xAA 0x40 0x20 0x63 0xAA 0x63 0xDE 0x63 0x9A 0x63 0x2D 0x63 0xD5 0x63 0x01 0x63 0xC5 0x63 0xC1 0x63 0xD5 0x63 0xB9 0x63 0x78 0x63 0xC8 0x67 0x3E 0x6B 0xA7 0x6B 0x4C 0x36 0x63
		0x04 0x02 0x00 0x0A
		0x02 0xAA 0x60 0x02 0xBC 0x24
		0x04 0x02 0x00 0x32
		0x02 0xAA 0x3E 0x02 0xC2 0x00
		0x04 0x02 0x00 0x0A
		0x03 0xAA 0x3E 0x04 0xC2 0x00 0xCD 0x1C
		0x02 0xAA 0x3E 0x02 0x00 0x42
		0x04 0x02 0x00 0x14
		0x02 0xAA 0x40 0x04 0x80 0x00 0x80 0x00
		0x04 0x02 0x00 0x0A
		0x02 0xAA 0x60 0x02 0xBD 0x08
		0x04 0x02 0x00 0x32
		0x02 0xAA 0x3E 0x02 0xC2 0x00
		0x04 0x02 0x00 0x0A
		0x03 0xAA 0x3E 0x04 0xC2 0x00 0xDF 0x39
		0x02 0xAA 0x3E 0x02 0x10 0x42
		0x04 0x02 0x00 0x14
		0x02 0xAA 0x40 0x20 0x00 0x00 0x00 0x00 0x00 0x00 0x00 0x00 0x00 0x00 0x00 0x00 0x00 0x00 0x00 0x00 0x00 0x00 0x00 0x00 0x00 0x00 0x00 0x00 0x00 0x00 0x00 0x00 0x00 0x00 0x00 0x00
		0x04 0x02 0x00 0x0A
		0x02 0xAA 0x60 0x02 0xAD 0x24
		0x04 0x02 0x00 0x32
		0x02 0xAA 0x3E 0x02 0xC2 0x00
		0x04 0x02 0x00 0x0A
		0x03 0xAA 0x3E 0x04 0xC2 0x00 0x6A 0x0D
		0x02 0xAA 0x3E 0x02 0x30 0x42
		0x04 0x02 0x00 0x14
		0x02 0xAA 0x40 0x20 0x00 0x00 0x00 0x00 0x00 0x00 0x00 0x00 0x00 0x00 0x00 0x00 0x00 0x00 0x00 0x00 0x00 0x00 0x00 0x00 0x00 0x00 0x00 0x00 0x00 0x00 0x00 0x00 0x00 0x00 0x00 0x00
		0x04 0x02 0x00 0x0A
		0x02 0xAA 0x60 0x02 0x8D 0x24
		0x04 0x02 0x00 0x32
		0x02 0xAA 0x3E 0x02 0xC2 0x00
		0x04 0x02 0x00 0x0A
		0x03 0xAA 0x3E 0x04 0xC2 0x00 0x5B 0x6D
		0x02 0xAA 0x3E 0x02 0x50 0x42
		0x04 0x02 0x00 0x14
		0x02 0xAA 0x40 0x20 0x00 0x00 0x00 0x00 0x00 0x00 0x00 0x00 0x00 0x00 0x00 0x00 0x00 0x00 0x00 0x00 0x00 0x00 0x00 0x00 0x00 0x00 0x00 0x00 0x00 0x00 0x00 0x00 0x00 0x00 0x00 0x00
		0x04 0x02 0x00 0x0A
		0x02 0xAA 0x60 0x02 0x6D 0x24
		0x04 0x02 0x00 0x32
		0x02 0xAA 0x3E 0x02 0xC2 0x00
		0x04 0x02 0x00 0x0A
		0x03 0xAA 0x3E 0x04 0xC2 0x00 0x08 0x4D
		0x02 0xAA 0x3E 0x02 0x90 0x42
		0x04 0x02 0x00 0x14
		0x02 0xAA 0x40 0x09 0x08 0x53 0x48 0x33 0x36 0x36 0x31 0x30 0x31
		0x04 0x02 0x00 0x0A
		0x02 0xAA 0x60 0x02 0x59 0x0D
		0x04 0x02 0x00 0x32
		0x02 0xAA 0x3E 0x02 0xC2 0x00
		0x04 0x02 0x00 0x0A
		0x03 0xAA 0x3E 0x04 0xC2 0x00 0xBC 0x50
		0x02 0xAA 0x3E 0x02 0xA6 0x42
		0x04 0x02 0x00 0x14
		0x02 0xAA 0x40 0x12 0x00 0x00 0x00 0x00 0x01 0x00 0x04 0x03 0x05 0x04 0x06 0x05 0x61 0x01 0x00 0x01 0x00 0x01
		0x04 0x02 0x00 0x0A
		0x02 0xAA 0x60 0x02 0x97 0x16
		0x04 0x02 0x00 0x32
		0x02 0xAA 0x3E 0x02 0xC2 0x00
		0x04 0x02 0x00 0x0A
		0x03 0xAA 0x3E 0x04 0xC2 0x00 0xFD 0x05
		0x02 0xAA 0x3E 0x02 0xCA 0x42
		0x04 0x02 0x00 0x14
		0x02 0xAA 0x40 0x20 0x00 0x00 0x7F 0xFF 0x00 0x00 0x00 0x00 0x80 0x7F 0x80 0x7F 0x00 0x00 0x00 0x00 0x00 0x00 0x00 0x00 0x00 0x00 0x00 0x00 0x00 0x00 0x00 0x00 0x00 0x00 0x00 0x00
		0x04 0x02 0x00 0x0A
		0x02 0xAA 0x60 0x02 0x77 0x24
		0x04 0x02 0x00 0x32
		0x02 0xAA 0x3E 0x02 0xC2 0x00
		0x04 0x02 0x00 0x0A
		0x03 0xAA 0x3E 0x04 0xC2 0x00 0x39 0x57
		0x02 0xAA 0x3E 0x02 0xEA 0x42
		0x04 0x02 0x00 0x14
		0x02 0xAA 0x40 0x14 0x00 0x00 0x00 0x00 0x00 0x00 0x00 0x00 0x00 0x00 0x00 0x00 0x00 0x00 0x00 0x00 0x00 0x00 0x00 0x00
		0x04 0x02 0x00 0x0A
		0x02 0xAA 0x60 0x02 0xD3 0x18
		0x04 0x02 0x00 0x32
		0x02 0xAA 0x3E 0x02 0xC2 0x00
		0x04 0x02 0x00 0x0A
		0x03 0xAA 0x3E 0x04 0xC2 0x00 0xEA 0x3F
		0x02 0xAA 0x3E 0x02 0xFE 0x42
		0x04 0x02 0x00 0x14
		0x02 0xAA 0x40 0x20 0x6B 0x63 0x63 0x63 0x13 0x96 0x63 0x63 0x5F 0x7D 0x61 0x5F 0x7F 0x6C 0x63 0x63 0x63 0x63 0x63 0xDE 0x4F 0x4A 0x63 0xF2 0x47 0x4A 0x61 0xD7 0x67 0x46 0x63 0x5F
		0x04 0x02 0x00 0x0A
		0x02 0xAA 0x60 0x02 0x42 0x24
		0x04 0x02 0x00 0x32
		0x02 0xAA 0x3E 0x02 0xC2 0x00
		0x04 0x02 0x00 0x0A
		0x03 0xAA 0x3E 0x04 0xC2 0x00 0x4C 0x22
		0x02 0xAA 0x3E 0x02 0x1E 0x43
		0x04 0x02 0x00 0x14
		0x02 0xAA 0x40 0x20 0x63 0x66 0xA3 0xDF 0x5F 0x6A 0x63 0x63 0x63 0x63 0x63 0x63 0x63 0x63 0x63 0xD7 0x5F 0x4A 0x63 0x47 0x5B 0x7A 0x23 0xF2 0x45 0x4A 0xE3 0xF2 0x45 0xCA 0x63 0x63
		0x04 0x02 0x00 0x0A
		0x02 0xAA 0x60 0x02 0xC2 0x24
		0x04 0x02 0x00 0x32
		0x02 0xAA 0x3E 0x02 0xC2 0x00
		0x04 0x02 0x00 0x0A
		0x03 0xAA 0x3E 0x04 0xC2 0x00 0x67 0x22
		0x02 0xAA 0x3E 0x02 0x3E 0x43
		0x04 0x02 0x00 0x14
		0x02 0xAA 0x40 0x20 0x63 0x63 0x63 0x63 0x63 0x63 0x9C 0x73 0x63 0x6F 0x6B 0x6B 0x6B 0x6B 0x63 0x63 0x6B 0x98 0x6F 0xA0 0x63 0x63 0x67 0x21 0x6B 0x02 0x63 0x33 0x63 0xAB 0x33 0x1B
		0x04 0x02 0x00 0x0A
		0x02 0xAA 0x60 0x02 0x1A 0x24
		0x04 0x02 0x00 0x32
		0x02 0xAA 0x3E 0x02 0xC2 0x00
		0x04 0x02 0x00 0x0A
		0x03 0xAA 0x3E 0x04 0xC2 0x00 0x35 0x7A
		0x02 0xAA 0x3E 0x02 0x5E 0x43
		0x04 0x02 0x00 0x14
		0x02 0xAA 0x40 0x20 0x63 0x40 0x63 0x40 0x63 0x1B 0x4B 0x63 0x63 0x40 0xF2 0x73 0x63 0x93 0x63 0x4B 0x63 0xF2 0x77 0xF3 0xC3 0x07 0x67 0x21 0x6B 0x02 0x5F 0x6F 0x7F 0x63 0x1F 0x62
		0x04 0x02 0x00 0x0A
		0x02 0xAA 0x60 0x02 0x91 0x24
		0x04 0x02 0x00 0x32
		0x02 0xAA 0x3E 0x02 0xC2 0x00
		0x04 0x02 0x00 0x0A
		0x03 0xAA 0x3E 0x04 0xC2 0x00 0x7E 0x71
		0x02 0xAA 0x3E 0x02 0x7E 0x43
		0x04 0x02 0x00 0x14
		0x02 0xAA 0x40 0x20 0x63 0x40 0x5B 0xC0 0x5B 0x15 0x67 0x21 0x63 0xF2 0xF7 0x66 0xE2 0x6B 0xAE 0x22 0x63 0x6F 0xEF 0x63 0x63 0x63 0x63 0x63 0x63 0x63 0x63 0x63 0x63 0x5F 0x4B 0x6B
		0x04 0x02 0x00 0x0A
		0x02 0xAA 0x60 0x02 0x05 0x24
		0x04 0x02 0x00 0x32
		0x02 0xAA 0x3E 0x02 0xC2 0x00
		0x04 0x02 0x00 0x0A
		0x03 0xAA 0x3E 0x04 0xC2 0x00 0x57 0x65
		0x02 0xAA 0x3E 0x02 0x9E 0x43
		0x04 0x02 0x00 0x14
		0x02 0xAA 0x40 0x20 0x77 0x4B 0x69 0x1B 0xDA 0xEF 0x77 0x4B 0x63 0x1B 0x63 0x40 0x4B 0x14 0x63 0xAB 0x67 0xC2 0x63 0x82 0x6F 0x33 0x63 0x63 0x4B 0x77 0x77 0x6B 0x6B 0x6F 0x6B 0x1E
		0x04 0x02 0x00 0x0A
		0x02 0xAA 0x60 0x02 0x42 0x24
		0x04 0x02 0x00 0x32
		0x02 0xAA 0x3E 0x02 0xC2 0x00
		0x04 0x02 0x00 0x0A
		0x03 0xAA 0x3E 0x04 0xC2 0x00 0x8D 0x22
		0x02 0xAA 0x3E 0x02 0xBE 0x43
		0x04 0x02 0x00 0x14
		0x02 0xAA 0x40 0x20 0x67 0xD3 0x4B 0xAB 0xD7 0x63 0xAB 0x63 0x4B 0x9C 0xCA 0x6F 0x71 0x4B 0x86 0x63 0x63 0x63 0x63 0x63 0x63 0x63 0x63 0x63 0x63 0x63 0x63 0x63 0x63 0x63 0x63 0x63
		0x04 0x02 0x00 0x0A
		0x02 0xAA 0x60 0x02 0x91 0x24
		0x04 0x02 0x00 0x32
		0x02 0xAA 0x3E 0x02 0xC2 0x00
		0x04 0x02 0x00 0x0A
		0x03 0xAA 0x3E 0x04 0xC2 0x00 0xE5 0x71
		0x02 0xAA 0x3E 0x02 0xDE 0x43
		0x04 0x02 0x00 0x14
		0x02 0xAA 0x40 0x20 0x63 0xAA 0x63 0xDE 0x63 0x9A 0x63 0x2D 0x63 0xD5 0x63 0x01 0x63 0xC5 0x63 0xC1 0x63 0xD5 0x63 0xB9 0x63 0x78 0x63 0xC8 0x67 0x3E 0x6B 0xA7 0x6B 0x4C 0x9C 0x63
		0x04 0x02 0x00 0x0A
		0x02 0xAA 0x60 0x02 0x54 0x24
		0x04 0x02 0x00 0x32
		0x02 0xAA 0x3E 0x02 0xC2 0x00
		0x04 0x02 0x00 0x0A
		0x03 0xAA 0x3E 0x04 0xC2 0x00 0x06 0x34
		0x02 0xAA 0x3E 0x02 0x00 0x46
		0x04 0x02 0x00 0x14
		0x02 0xAA 0x40 0x20 0x8B 0x7C 0x7C 0x7C 0xB4 0x7C 0x7C 0x5C 0x7C 0x7C 0x3C 0x7C 0x7C 0xFC 0x6C 0x7C 0x7F 0x7C 0x7C 0x15 0x7C 0x7C 0xBC 0x7C 0x7C 0x9C 0x7C 0x7C 0x7D 0x7C 0x7C 0x5D
		0x04 0x02 0x00 0x0A
		0x02 0xAA 0x60 0x02 0x04 0x24
		0x04 0x02 0x00 0x32
		0x02 0xAA 0x3E 0x02 0xC2 0x00
		0x04 0x02 0x00 0x0A
		0x03 0xAA 0x3E 0x04 0xC2 0x00 0x6A 0x64
		0x02 0xAA 0x3E 0x02 0x20 0x46
		0x04 0x02 0x00 0x14
		0x02 0xAA 0x40 0x20 0x7C 0x7C 0xF9 0x7C 0x7C 0x1D 0x7C 0x7C 0xFD 0x7C 0x7C 0xDD 0x7C 0x7C 0xBD 0x7C 0x7C 0x9D 0x7C 0x7C 0x7E 0x7C 0x5C 0x92 0x7C 0x5C 0xDD 0x7C 0x7C 0x99 0x7C 0x7C
		0x04 0x02 0x00 0x0A
		0x02 0xAA 0x60 0x02 0x61 0x24
		0x04 0x02 0x00 0x32
		0x02 0xAA 0x3E 0x02 0xC2 0x00
		0x04 0x02 0x00 0x0A
		0x03 0xAA 0x3E 0x04 0xC2 0x00 0xEB 0x41
		0x02 0xAA 0x3E 0x02 0x40 0x46
		0x04 0x02 0x00 0x14
		0x02 0xAA 0x40 0x20 0xFE 0x7C 0x5C 0x94 0x3C 0x7C 0xCE 0x3C 0x7C 0x9E 0x7C 0x7C 0x7F 0x7C 0x7C 0x5F 0x7C 0x5C 0xD6 0x7C 0x5C 0xD0 0x7C 0x7C 0x3F 0x7C 0x7C 0x1F 0x7C 0x2C 0x59 0x7D
		0x04 0x02 0x00 0x0A
		0x02 0xAA 0x60 0x02 0x43 0x24
		0x04 0x02 0x00 0x32
		0x02 0xAA 0x3E 0x02 0xC2 0x00
		0x04 0x02 0x00 0x0A
		0x03 0xAA 0x3E 0x04 0xC2 0x00 0x4B 0x23
		0x02 0xAA 0x3E 0x02 0x60 0x46
		0x04 0x02 0x00 0x14
		0x02 0xAA 0x40 0x20 0x1C 0x75 0x7D 0x1C 0x55 0x7D 0x1C 0x35 0x7D 0x1C 0x15 0x7D 0x1C 0xF5 0x4C 0x7C 0x7C 0x4C 0x7C 0x7C 0x4C 0x7C 0x7C 0x4C 0x7C 0x7C 0x4C 0x7C 0x7C 0x4C 0x7C 0x7C
		0x04 0x02 0x00 0x0A
		0x02 0xAA 0x60 0x02 0x38 0x24
		0x04 0x02 0x00 0x32
		0x02 0xAA 0x3E 0x02 0xC2 0x00
		0x04 0x02 0x00 0x0A
		0x03 0xAA 0x3E 0x04 0xC2 0x00 0x15 0x18
		0x02 0xAA 0x3E 0x02 0x80 0x46
		0x04 0x02 0x00 0x14
		0x02 0xAA 0x40 0x20 0x4C 0x7C 0x7C 0x4C 0x7C 0x7C 0x4C 0x7C 0x7C 0x4C 0x7C 0x7C 0x7C 0x7C 0x7C 0x7C 0x7C 0x7C 0x7C 0x7C 0x7C 0x7C 0x7C 0x7C 0x7C 0x7C 0x7C 0x7C 0x7C 0x7C 0x7C 0x7C
		0x04 0x02 0x00 0x0A
		0x02 0xAA 0x60 0x02 0x79 0x24
		0x04 0x02 0x00 0x32
		0x02 0xAA 0x3E 0x02 0xC2 0x00
		0x04 0x02 0x00 0x0A
		0x03 0xAA 0x3E 0x04 0xC2 0x00 0x1A 0x59
		0x02 0xAA 0x3E 0x02 0xA0 0x46
		0x04 0x02 0x00 0x14
		0x02 0xAA 0x40 0x20 0x7C 0x7C 0x7C 0x7C 0x7C 0x7C 0x7C 0x7C 0x7C 0x7C 0x7C 0x7C 0x7C 0x7C 0x7C 0x7C 0x7C 0x7C 0x7C 0x7C 0x7C 0x7C 0x7C 0x7C 0x7C 0x7C 0x7C 0x7C 0x7C 0x7C 0x7C 0x7C
		0x04 0x02 0x00 0x0A
		0x02 0xAA 0x60 0x02 0x99 0x24
		0x04 0x02 0x00 0x32
		0x02 0xAA 0x3E 0x02 0xC2 0x00
		0x04 0x02 0x00 0x0A
		0x03 0xAA 0x3E 0x04 0xC2 0x00 0x6F 0x79
		0x02 0xAA 0x3E 0x02 0xC0 0x46
		0x04 0x02 0x00 0x14
		0x02 0xAA 0x40 0x20 0x7C 0x7C 0x7C 0x7C 0x7C 0x7C 0x7C 0x7C 0x7C 0x7C 0x7C 0x7C 0x7C 0x7C 0x7C 0x7C 0x7C 0x7C 0x7C 0x7C 0x7C 0x7C 0x7C 0x7C 0x7C 0x7C 0x7C 0x7C 0x7C 0x7C 0x7C 0x7C
		0x04 0x02 0x00 0x0A
		0x02 0xAA 0x60 0x02 0x79 0x24
		0x04 0x02 0x00 0x32
		0x02 0xAA 0x3E 0x02 0xC2 0x00
		0x04 0x02 0x00 0x0A
		0x03 0xAA 0x3E 0x04 0xC2 0x00 0x3C 0x59
		0x02 0xAA 0x3E 0x02 0xE0 0x46
		0x04 0x02 0x00 0x14
		0x02 0xAA 0x40 0x10 0x7C 0x7C 0x7C 0x7C 0x7C 0x7C 0x7C 0x7C 0x7C 0x7C 0x7C 0x7C 0x7C 0x7C 0x7C 0x7C
		0x04 0x02 0x00 0x0A
		0x02 0xAA 0x60 0x02 0x19 0x14
		0x04 0x02 0x00 0x32
		0x02 0xAA 0x3E 0x02 0xC2 0x00
		0x04 0x02 0x00 0x0A
		0x03 0xAA 0x3E 0x04 0xC2 0x00 0xD0 0x09
		0x02 0xAA 0x3E 0x02 0xF0 0x46
		0x04 0x02 0x00 0x14
		0x02 0xAA 0x40 0x20 0x59 0x4C 0x83 0x21 0x83 0x72 0x83 0xB1 0x83 0x80 0x83 0xD0 0x83 0x32 0x83 0xE1 0x83 0x52 0x83 0xA2 0x83 0x81 0x83 0x86 0x83 0x3B 0x83 0x4B 0x83 0xD9 0x83 0x34
		0x04 0x02 0x00 0x0A
		0x02 0xAA 0x60 0x02 0x42 0x24
		0x04 0x02 0x00 0x32
		0x02 0xAA 0x3E 0x02 0xC2 0x00
		0x04 0x02 0x00 0x0A
		0x03 0xAA 0x3E 0x04 0xC2 0x00 0x9E 0x22
		0x02 0xAA 0x3E 0x02 0x10 0x47
		0x04 0x02 0x00 0x14
		0x02 0xAA 0x40 0x20 0x6D 0x2F 0x6D 0x6D 0x7D 0xD2 0x7D 0xC0 0x7D 0xB6 0x7D 0xA4 0x7D 0x8A 0x7D 0x69 0x7D 0x4F 0x7D 0x2D 0x8C 0xB3 0x8C 0x62 0x8C 0x00 0x8C 0xA6 0x8C 0xF5 0x8C 0x34
		0x04 0x02 0x00 0x0A
		0x02 0xAA 0x60 0x02 0xC3 0x24
		0x04 0x02 0x00 0x32
		0x02 0xAA 0x3E 0x02 0xC2 0x00
		0x04 0x02 0x00 0x0A
		0x03 0xAA 0x3E 0x04 0xC2 0x00 0x07 0x23
		0x02 0xAA 0x3E 0x02 0x30 0x47
		0x04 0x02 0x00 0x14
		0x02 0xAA 0x40 0x20 0x8C 0xBA 0x8C 0x49 0x8C 0xBF 0x8C 0x6E 0x8C 0xBC 0x8C 0x7C 0x9C 0x53 0x9C 0xD2 0x9C 0x72 0x9C 0xF1 0x9C 0x61 0x9C 0xB0 0x9C 0xF0 0x9C 0x20 0x9C 0xC7 0x9C 0x77
		0x04 0x02 0x00 0x0A
		0x02 0xAA 0x60 0x02 0xD9 0x24
		0x04 0x02 0x00 0x32
		0x02 0xAA 0x3E 0x02 0xC2 0x00
		0x04 0x02 0x00 0x0A
		0x03 0xAA 0x3E 0x04 0xC2 0x00 0x7E 0x39
		0x02 0xAA 0x3E 0x02 0x50 0x47
		0x04 0x02 0x00 0x14
		0x02 0xAA 0x40 0x20 0x9C 0x85 0x9C 0x55 0x9C 0x64 0x9C 0x3B 0x9C 0x0B 0x9C 0xB9 0xAC 0xB0 0xCC 0xB0 0xA3 0x7D 0xA3 0xCF 0xA3 0x39 0xA3 0x59 0xA3 0x1B 0xA3 0x00 0xA3 0xA4 0xA3 0xA6
		0x04 0x02 0x00 0x0A
		0x02 0xAA 0x60 0x02 0x50 0x24
		0x04 0x02 0x00 0x32
		0x02 0xAA 0x3E 0x02 0xC2 0x00
		0x04 0x02 0x00 0x0A
		0x03 0xAA 0x3E 0x04 0xC2 0x00 0x8A 0x30
		0x02 0xAA 0x3E 0x02 0x70 0x47
		0x04 0x02 0x00 0x14
		0x02 0xAA 0x40 0x20 0xA3 0x53 0x93 0x44 0x93 0x2C 0x93 0x2D 0x93 0xF2 0x83 0xF9 0x83 0x09 0x83 0x39 0x83 0x33 0x7C 0xBA 0x7C 0x45 0x7C 0xB6 0x6C 0x77 0x6C 0x5A 0x6C 0x71 0x6C 0xE9
		0x04 0x02 0x00 0x0A
		0x02 0xAA 0x60 0x02 0xF9 0x24
		0x04 0x02 0x00 0x32
		0x02 0xAA 0x3E 0x02 0xC2 0x00
		0x04 0x02 0x00 0x0A
		0x03 0xAA 0x3E 0x04 0xC2 0x00 0xA7 0x59
		0x02 0xAA 0x3E 0x02 0x90 0x47
		0x04 0x02 0x00 0x14
		0x02 0xAA 0x40 0x20 0x6C 0x0A 0x6C 0x50 0x6C 0x26 0x7C 0x3F 0x83 0xBC 0xC3 0x29 0xD3 0xF9 0xD3 0xAC 0xC3 0xF0 0xB3 0xBC 0xB3 0x22 0xB3 0x23 0xD3 0xB0 0xA3 0xFE 0xC3 0x3B 0xB2 0xFC
		0x04 0x02 0x00 0x0A
		0x02 0xAA 0x60 0x02 0x96 0x24
		0x04 0x02 0x00 0x32
		0x02 0xAA 0x3E 0x02 0xC2 0x00
		0x04 0x02 0x00 0x0A
		0x03 0xAA 0x3E 0x04 0xC2 0x00 0x40 0x76
		0x02 0xAA 0x3E 0x02 0xB0 0x47
		0x04 0x02 0x00 0x14
		0x02 0xAA 0x40 0x20 0x93 0x61 0x93 0x41 0x93 0x72 0x93 0xC2 0x83 0x3D 0x93 0x53 0x83 0xCC 0x93 0x71 0x93 0xD0 0x93 0x70 0x93 0xF0 0x93 0xB1 0x93 0x67 0xA3 0x7B 0xB3 0xD3 0x4D 0xF4
		0x04 0x02 0x00 0x0A
		0x02 0xAA 0x60 0x02 0xE1 0x24
		0x04 0x02 0x00 0x32
		0x02 0xAA 0x3E 0x02 0xC2 0x00
		0x04 0x02 0x00 0x0A
		0x03 0xAA 0x3E 0x04 0xC2 0x00 0xC8 0x41
		0x02 0xAA 0x3E 0x02 0xD0 0x47
		0x04 0x02 0x00 0x14
		0x02 0xAA 0x40 0x20 0x7C 0x5B 0x7C 0x8A 0x7C 0x9B 0x7C 0x45 0x7C 0xA6 0x7C 0xF5 0x7C 0xE6 0x7C 0xF6 0x7C 0xA6 0x7C 0x17 0x7C 0x10 0x7C 0xD2 0x6C 0x09 0x5C 0x6F 0x5C 0xC0 0x7C 0x7C
		0x04 0x02 0x00 0x0A
		0x02 0xAA 0x60 0x02 0xE9 0x24
		0x04 0x02 0x00 0x32
		0x02 0xAA 0x3E 0x02 0xC2 0x00
		0x04 0x02 0x00 0x0A
		0x03 0xAA 0x3E 0x04 0xC2 0x00 0x56 0x49
		0x02 0xAA 0x3E 0x02 0xF0 0x47
		0x04 0x02 0x00 0x14
		0x02 0xAA 0x40 0x08 0x7C 0x7C 0x7C 0x7C 0x7C 0x7C 0x92 0x61
		0x04 0x02 0x00 0x0A
		0x02 0xAA 0x60 0x02 0xED 0x0C
		0x04 0x02 0x00 0x32
		0x02 0xAA 0x3E 0x02 0xC2 0x00
		0x04 0x02 0x00 0x0A
		0x03 0xAA 0x3E 0x04 0xC2 0x00 0x91 0x65
		0x04 0x02 0x00 0xC8
		0x02 0xAA 0x3E 0x02 0x12 0xE0
		0x04 0x02 0x00 0x02
		0x02 0xAA 0x40 0x04 0x45 0x32 0x55 0x50
		0x04 0x02 0x00 0x02
		0x02 0xAA 0x60 0x02 0xF1 0x08
		0x04 0x02 0x03 0xE8
		0x02 0xAA 0x3E 0x02 0x18 0xE0
		0x04 0x02 0x00 0x02
		0x02 0xAA 0x40 0x07 0x45 0x78 0x69 0x74 0x6F 0x65 0x6D
		0x04 0x02 0x00 0x02
		0x02 0xAA 0x60 0x02 0x2C 0x0B
		0x04 0x02 0x00 0xC8
		0x02 0xAA 0x3E 0x02 0x20 0x00
		0x04 0x02 0x01 0xF4
		0x02 0xAA 0x3E 0x02 0xCB 0x00
		0x04 0x02 0x00 0x05
		0x03 0xAA 0x3E 0x05 0xCB 0x00 0x01 0x01 0x00
		0x04 0x02 0x00 0x02
		>;
	version_ts = <0x0004>;
	sinofs_ts_data = /bits/ 8 <
		0x02 0xAA 0x3E 0x02 0x00 0x80
		0x04 0x02 0x00 0x02
		0x02 0xAA 0x3E 0x02 0x00 0x80
		0x04 0x02 0x00 0x02
		0x02 0xAA 0x3E 0x02 0x01 0xE0
		0x04 0x02 0x00 0x02
		0x02 0xAA 0x40 0x08 0x65 0x4E 0x54 0x45 0x52 0x4F 0x45 0x4D
		0x04 0x02 0x00 0x02
		0x02 0xAA 0x60 0x02 0x9F 0x0C
		0x04 0x02 0x00 0x32
		0x02 0xAA 0x3E 0x02 0x02 0xE0
		0x04 0x02 0x00 0x02
		0x02 0xAA 0x40 0x08 0x45 0x6E 0x74 0x65 0x72 0x49 0x41 0x50
		0x04 0x02 0x00 0x02
		0x02 0xAA 0x60 0x02 0x45 0x0C
		0x04 0x02 0x01 0xF4
		0x03 0xAA 0xA0 0x04 0x02 0x01 0x61 0xAF
		0x04 0x02 0x00 0x02
		0x02 0xAA 0x81 0x03 0x00 0x00 0x03
		0x04 0x02 0x00 0x14
		0x02 0xAA 0x83 0x02 0x3A 0xE0
		0x04 0x02 0x00 0x14
		0x03 0xAA 0x83 0x03 0x01 0x3A 0x32
		0x04 0x02 0x00 0x02
		0x02 0xAA 0xFE 0x03 0x00 0xF0 0xFD
		0x04 0x02 0x00 0x0A
		0x02 0xAA 0xFB 0x05 0x00 0xF0 0x00 0x02 0x1E
		0x04 0x02 0x00 0x0A
		0x02 0xAA 0xFC 0x45 0x00 0xF0 0x40 0x00 0xFF 0xF6 0xB1 0x8B 0xB7 0x93 0xB5 0xAF 0xBB 0xC9 0xB9 0xD3 0xBF 0xF9 0xBD 0x1C 0xA3 0x22 0xA1 0x46 0xA7 0x6C 0xA5 0x8A 0xAB 0xDA 0xA9 0xF0 0xA9 0x0F 0xAB 0x21 0x95 0x4B 0x97 0xBB 0x91 0xE3 0x93 0xDF 0x9D 0x04 0x9F 0x48 0x99 0xB6 0x9B 0xF8 0x87 0x25 0x85 0x65 0x83 0xAF 0x81 0xD5 0x8F 0x16 0x8D 0x44 0x8B 0xEE 0x87 0x15 0xE0
		0x04 0x02 0x00 0x04
		0x02 0xAA 0xFC 0x45 0x40 0xF0 0x40 0x00 0xF9 0xC9 0xFB 0xAB 0xFD 0x0A 0xFF 0xFE 0xF3 0x61 0xF1 0xD7 0xF7 0x58 0xF5 0xDC 0xED 0x47 0xEF 0xCD 0xE9 0x78 0xEB 0x96 0xE7 0x01 0xE5 0xAF 0xE3 0xC4 0x9F 0x61 0xA1 0x8B 0xA3 0xFE 0xA7 0x37 0xA5 0x6A 0xAB 0xA2 0xAF 0xE5 0xA9 0x3A 0xA9 0x4F 0xB7 0x81 0xB5 0xB0 0xBD 0xED 0xBF 0x04 0xB3 0x37 0xB1 0x56 0xB1 0x73 0xB3 0x8D 0xEC
		0x04 0x02 0x00 0x04
		0x02 0xAA 0xFC 0x45 0x80 0xF0 0x40 0x00 0x4D 0x58 0x4D 0x43 0x4B 0x2C 0x57 0x13 0x59 0x08 0x59 0xE7 0x5F 0xD4 0x5B 0xC9 0x45 0xA4 0x45 0xB3 0x43 0x98 0x41 0x6E 0x41 0x7D 0x43 0x54 0x47 0x2B 0x45 0x00 0x7D 0x23 0x7F 0xC4 0x7B 0xED 0x79 0x80 0x49 0xAB 0x4B 0x77 0x4D 0x1E 0x4D 0x2B 0x53 0xE6 0x57 0x91 0x51 0x59 0x53 0x06 0x5F 0xCB 0x5D 0x88 0x5B 0x50 0x57 0x1D 0xA0
		0x04 0x02 0x00 0x04
		0x02 0xAA 0xFC 0x45 0xC0 0xF0 0x40 0x00 0x29 0x94 0x29 0xC1 0x2F 0x69 0x2D 0x94 0x23 0x3C 0x27 0x59 0x21 0xE0 0x23 0x0C 0x3F 0x83 0x3D 0x33 0x3B 0xBE 0x39 0x38 0x29 0xA9 0x2B 0x37 0x2D 0xBA 0x2F 0x04 0x13 0xAD 0x11 0x59 0x17 0xC2 0x15 0x6A 0x1B 0x18 0x1F 0xBB 0x19 0x43 0x1B 0xE6 0x05 0xAE 0x07 0x46 0x03 0xF1 0x01 0xA3 0x0F 0x59 0x0D 0x11 0x0B 0xCE 0x09 0x86 0x63
		0x04 0x02 0x00 0x04
		0x02 0xAA 0xFC 0x45 0x00 0xF1 0x40 0x00 0xF7 0xBA 0xF5 0xFE 0xFD 0x3F 0xFF 0x7F 0xF1 0xBD 0xF3 0xE5 0xF5 0x2A 0xF7 0x52 0xE9 0x80 0xEB 0xD6 0xED 0xE2 0xED 0x31 0xE3 0x4F 0xE1 0x9F 0xE7 0xAD 0xE5 0xC5 0xDB 0x24 0xD9 0x0E 0xDF 0x70 0xDD 0x5C 0xD3 0xB6 0xD1 0xEA 0xD7 0xCE 0xD3 0x2D 0xCD 0x11 0xCF 0x0D 0xC9 0x6F 0xCB 0x43 0xC5 0xB7 0xC7 0x9F 0xC1 0x87 0xC3 0xEF 0x8D
		0x04 0x02 0x00 0x04
		0x02 0xAA 0xFC 0x45 0x40 0xF1 0x40 0x00 0xBD 0xA3 0xBF 0xB7 0xBB 0xBA 0xB9 0xB8 0xB7 0xB6 0xB5 0xB4 0xB3 0xB2 0xB1 0xB0 0xAF 0xAE 0xAD 0xAC 0xAB 0xAA 0xA9 0xA8 0xA7 0xA6 0xA5 0xA4 0xA3 0xA2 0xA1 0xA0 0x9F 0x9E 0x9D 0x9C 0x9B 0x9A 0x99 0x98 0x97 0x96 0x95 0x94 0x93 0x92 0x91 0x90 0x8F 0x8E 0x8D 0x8C 0x8B 0x8A 0x89 0x88 0x87 0x86 0x85 0x84 0x83 0x82 0x81 0x80 0x96
		0x04 0x02 0x00 0x04
		0x03 0xAA 0x81 0x04 0x02 0x00 0x00 0x9C
		0x04 0x02 0x00 0x02
		0x02 0xAA 0xF7 0x03 0x7F 0x56 0xDD
		0x04 0x02 0x03 0xE8
	>;
};
