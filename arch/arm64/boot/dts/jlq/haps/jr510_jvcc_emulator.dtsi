// SPDX-License-Identifier: GPL-2.0+
#include <dt-bindings/clock/qcom,gcc-bengal.h>

&clocks {
	/delete-node/ qcom,gcc@34500150;
	/delete-node/ qcom,gcc@24b00000;
	/delete-node/ qcom,rpmcc;
	gcc: qcom,gcc@34500150 { //enable JVCC_HAPS
		compatible = "qcom,bengal-gcc", "syscon";
		reg = <0x34500150 0x1000>;
		reg-names = "cc_base";
		//vdd_cx-supply = <&VDD_CX_LEVEL>;
		//vdd_cx_ao-supply = <&VDD_CX_LEVEL_AO>;
		//vdd_mx-supply = <&VDD_MX_LEVEL>;
		#clock-cells = <1>;
		#reset-cells = <1>;
	};

	rpmcc: qcom,rpmcc {
		compatible = "qcom,rpmcc-bengal";
		#clock-cells = <1>;
	};
};

