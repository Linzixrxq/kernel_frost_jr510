// SPDX-License-Identifier: GPL-2.0+
fg_battery_params {
	nominal_voltage = <387>;
	version_ts = <0x0002>;
	sinofs_ts_data = /bits/ 8 <
		0x02 0xAA 0x3E 0x02 0x00 0x80
		0x04 0x02 0x00 0x02
		0x02 0xAA 0x3E 0x02 0x00 0x80
		0x04 0x02 0x00 0x02
		0x02 0xAA 0x3E 0x02 0x01 0xE0
		0x04 0x02 0x00 0x02
		0x02 0xAA 0x40 0x08 0x65 0x4E 0x54 0x45 0x52 0x4F 0x45 0x4D
		0x04 0x02 0x00 0x02
		0x02 0xAA 0x60 0x02 0x9F 0x0C
		0x04 0x02 0x00 0x32
		0x02 0xAA 0x3E 0x02 0x02 0xE0
		0x04 0x02 0x00 0x02
		0x02 0xAA 0x40 0x08 0x45 0x6E 0x74 0x65 0x72 0x49 0x41 0x50
		0x04 0x02 0x00 0x02
		0x02 0xAA 0x60 0x02 0x45 0x0C
		0x04 0x02 0x01 0xF4
		0x03 0xAA 0xA0 0x04 0x02 0x01 0x61 0xAF
		0x04 0x02 0x00 0x02
		0x02 0xAA 0x81 0x03 0x00 0x00 0x03
		0x04 0x02 0x00 0x14
		0x02 0xAA 0x83 0x02 0x3A 0xE0
		0x04 0x02 0x00 0x14
		0x03 0xAA 0x83 0x03 0x01 0x3A 0x32
		0x04 0x02 0x00 0x02
		0x02 0xAA 0xFE 0x03 0x00 0xF0 0xFD
		0x04 0x02 0x00 0x0A
		0x02 0xAA 0xFB 0x05 0x00 0xF0 0x00 0x02 0x1E
		0x04 0x02 0x00 0x0A
		0x02 0xAA 0xFC 0x45 0x00 0xF0 0x40 0x00 0xFF 0xFA 0x1B 0x45 0x27 0x28 0x2B 0x88 0x3F 0x7C 0x4B 0xE9 0x45 0xD2 0x5D 0x7F 0x4B 0x89 0x71 0x73 0x7D 0xDE 0x7B 0xAD 0x6D 0x6F 0x61 0xD4 0x9F 0xB3 0x97 0x34 0xAF 0x62 0xB7 0x28 0xBF 0x4B 0xB9 0xB0 0x8D 0x47 0x83 0x20 0x81 0x7A 0x9F 0x48 0x85 0x76 0x8B 0xDF 0x89 0x6B 0x89 0x94 0xFB 0x81 0xFF 0x9E 0xF5 0x57 0xF5 0x36 0x48
		0x04 0x02 0x00 0x04
		0x02 0xAA 0xFC 0x45 0x40 0xF0 0x40 0x00 0x8D 0xC4 0x8D 0x9C 0x97 0x5F 0x93 0x7F 0x9F 0x73 0x93 0x6B 0x95 0xBC 0x95 0xE8 0x8D 0x18 0x8D 0x87 0xB5 0x19 0xB7 0xE4 0xBB 0x5E 0xBF 0x11 0xB9 0x20 0xB9 0xFD 0x87 0xD8 0x8B 0xA3 0x8D 0xD8 0x8D 0xC9 0x83 0xFA 0x87 0x07 0x81 0x50 0x81 0x6D 0x9F 0xB1 0x9D 0x06 0x85 0x55 0x87 0xB3 0x89 0x18 0x8B 0x8C 0x8F 0xF9 0x8D 0x72 0xC8
		0x04 0x02 0x00 0x04
		0x02 0xAA 0xFC 0x45 0x80 0xF0 0x40 0x00 0x73 0x10 0x77 0x8F 0x71 0x07 0x73 0x73 0x7D 0xE8 0x7F 0x42 0x7B 0xA1 0x79 0x03 0x67 0x77 0x65 0xAC 0x63 0x06 0x61 0x74 0x61 0xB7 0x63 0xE3 0x65 0x23 0x67 0x9C 0x59 0xE2 0x5B 0x22 0x5D 0x18 0x5F 0x52 0x53 0x85 0x51 0xCB 0x57 0x3F 0x55 0x6D 0x4B 0x43 0x49 0xAC 0x4F 0xFC 0x4D 0xC4 0x43 0x22 0x41 0x7A 0x47 0x58 0x43 0xB9 0x69
		0x04 0x02 0x00 0x04
		0x02 0xAA 0xFC 0x45 0xC0 0xF0 0x40 0x00 0x3D 0xE9 0x3F 0x89 0x39 0xAD 0x3B 0x41 0x35 0x6D 0x37 0x0B 0x31 0x17 0x33 0x3B 0x2D 0xDC 0x2F 0xF6 0x29 0xE8 0x2B 0x84 0x25 0xB0 0x27 0xA6 0x21 0x4C 0x23 0x7A 0x1D 0x56 0x1F 0x2A 0x19 0x3C 0x1B 0x0C 0x15 0x12 0x15 0xE3 0x13 0xF5 0x11 0xC9 0x0F 0xC5 0x0D 0xB1 0x0B 0xBB 0x09 0xAD 0x07 0x91 0x05 0x89 0x03 0x83 0x01 0x75 0x4F
		0x04 0x02 0x00 0x04
		0x02 0xAA 0xFC 0x45 0x00 0xF1 0x40 0x00 0xFF 0x95 0xFD 0x9D 0xFB 0xAD 0xF9 0xB5 0xF7 0xB3 0xF5 0xCF 0xF3 0xC1 0xF1 0xDB 0xEF 0xCD 0xED 0xF7 0xEB 0xF9 0xE9 0xE3 0xE7 0xE3 0xE5 0x18 0xE3 0x14 0xE1 0x10 0xDF 0x34 0xDD 0x3E 0xDB 0x04 0xD9 0x00 0xD7 0x04 0xD5 0x18 0xD3 0x1A 0xD1 0x12 0xCF 0x70 0xCD 0x74 0xCB 0x7E 0xC9 0x78 0xC7 0x6A 0xC5 0x62 0xC3 0x60 0xC1 0x5E 0xD8
		0x04 0x02 0x00 0x04
		0x02 0xAA 0xFC 0x45 0x40 0xF1 0x40 0x00 0xBF 0x24 0xBD 0x24 0xBB 0xBA 0xB9 0xB8 0xB7 0xB6 0xB5 0xB4 0xB3 0xB2 0xB1 0xB0 0xAF 0xAE 0xAD 0xAC 0xAB 0xAA 0xA9 0xA8 0xA7 0xA6 0xA5 0xA4 0xA3 0xA2 0xA1 0xA0 0x9F 0x9E 0x9D 0x9C 0x9B 0x9A 0x99 0x98 0x97 0x96 0x95 0x94 0x93 0x92 0x91 0x90 0x8F 0x8E 0x8D 0x8C 0x8B 0x8A 0x89 0x88 0x87 0x86 0x85 0x84 0x83 0x82 0x81 0x80 0x7B
		0x04 0x02 0x00 0x04
		0x03 0xAA 0x81 0x04 0x02 0x00 0x00 0x9C
		0x04 0x02 0x00 0x02
		0x02 0xAA 0xF7 0x03 0x7F 0x56 0xDD
		0x04 0x02 0x03 0xE8
	>;

	version_afi = <0x0656>;
	version_afi2 = <0x5833>;
	sinofs_afi_data = /bits/ 8 <
		0x02 0xAA 0x3E 0x02 0x00 0x80
		0x04 0x02 0x00 0x02
		0x02 0xAA 0x3E 0x02 0x00 0x80
		0x04 0x02 0x00 0x02
		0x02 0xAA 0x3E 0x02 0xCB 0x00
		0x04 0x02 0x00 0x05
		0x03 0xAA 0x3E 0x04 0xCB 0x00 0x00 0x00
		0x04 0x02 0x00 0x02
		0x02 0xAA 0x3E 0x02 0x01 0xE0
		0x04 0x02 0x00 0x02
		0x02 0xAA 0x40 0x08 0x65 0x4E 0x54 0x45 0x52 0x4F 0x45 0x4D
		0x04 0x02 0x00 0x02
		0x02 0xAA 0x60 0x02 0x9F 0x0C
		0x04 0x02 0x00 0xC8
		0x02 0xAA 0x3E 0x02 0xCB 0x00
		0x04 0x02 0x00 0x05
		0x03 0xAA 0x3E 0x05 0xCB 0x00 0x00 0x00 0x01
		0x04 0x02 0x00 0xC8
		0x02 0xAA 0x3E 0x02 0x11 0xE0
		0x04 0x02 0x00 0x02
		0x02 0xAA 0x40 0x07 0x65 0x52 0x78 0x44 0x72 0x61 0x6D
		0x04 0x02 0x00 0x02
		0x02 0xAA 0x60 0x02 0x5B 0x0B
		0x04 0x02 0x01 0xF4
		0x02 0xAA 0x3E 0x02 0xC0 0x00
		0x04 0x02 0x00 0x05
		0x03 0xAA 0x3E 0x04 0xC0 0x00 0xAA 0x11
		0x04 0x02 0x00 0x02
		0x02 0xAA 0x3E 0x02 0x10 0xE0
		0x04 0x02 0x00 0x02
		0x02 0xAA 0x40 0x08 0x45 0x52 0x6F 0x4E 0x43 0x48 0x49 0x50
		0x04 0x02 0x00 0x02
		0x02 0xAA 0x60 0x02 0x97 0x0C
		0x04 0x02 0x00 0xC8
		0x02 0xAA 0x3E 0x02 0xC0 0x00
		0x04 0x02 0x00 0x05
		0x03 0xAA 0x3E 0x04 0xC0 0x00 0xAA 0x10
		0x04 0x02 0x00 0x02
		0x02 0xAA 0x3E 0x02 0x40 0x40
		0x04 0x02 0x00 0x14
		0x02 0xAA 0x40 0x0E 0x1F 0x6A 0x00 0x00 0xFC 0x18 0x00 0x2B 0x00 0x00 0xE6 0x00 0x40 0x05
		0x04 0x02 0x00 0x0A
		0x02 0xAA 0x60 0x02 0x8C 0x12
		0x04 0x02 0x00 0x32
		0x02 0xAA 0x3E 0x02 0xC2 0x00
		0x04 0x02 0x00 0x0A
		0x03 0xAA 0x3E 0x04 0xC2 0x00 0xEB 0x7E
		0x02 0xAA 0x3E 0x02 0x50 0x40
		0x04 0x02 0x00 0x14
		0x02 0xAA 0x40 0x10 0x20 0x05 0x00 0x00 0x00 0x00 0xCC 0xCC 0x1F 0x27 0x0A 0x14 0x00 0x00 0x34 0x02
		0x04 0x02 0x00 0x0A
		0x02 0xAA 0x60 0x02 0x18 0x14
		0x04 0x02 0x00 0x32
		0x02 0xAA 0x3E 0x02 0xC2 0x00
		0x04 0x02 0x00 0x0A
		0x03 0xAA 0x3E 0x04 0xC2 0x00 0x3A 0x08
		0x02 0xAA 0x3E 0x02 0x74 0x40
		0x04 0x02 0x00 0x14
		0x02 0xAA 0x40 0x01 0x01
		0x04 0x02 0x00 0x0A
		0x02 0xAA 0x60 0x02 0x4A 0x05
		0x04 0x02 0x00 0x32
		0x02 0xAA 0x3E 0x02 0xC2 0x00
		0x04 0x02 0x00 0x0A
		0x03 0xAA 0x3E 0x04 0xC2 0x00 0xE6 0x49
		0x02 0xAA 0x3E 0x02 0x88 0x40
		0x04 0x02 0x00 0x14
		0x02 0xAA 0x40 0x20 0x11 0x62 0x00 0xC8 0x00 0x64 0x28 0x00 0x19 0x00 0x05 0x0A 0x0F 0x2D 0x3C 0x01 0x11 0x62 0x02 0x4E 0x02 0x4E 0x02 0x4E 0x00 0xC8 0x11 0x62 0x06 0xEA 0x06 0xEA
		0x04 0x02 0x00 0x0A
		0x02 0xAA 0x60 0x02 0x51 0x24
		0x04 0x02 0x00 0x32
		0x02 0xAA 0x3E 0x02 0xC2 0x00
		0x04 0x02 0x00 0x0A
		0x03 0xAA 0x3E 0x04 0xC2 0x00 0x49 0x31
		0x02 0xAA 0x3E 0x02 0xA8 0x40
		0x04 0x02 0x00 0x14
		0x02 0xAA 0x40 0x20 0x06 0xEA 0x00 0xC8 0x11 0x62 0x0B 0x86 0x0B 0x86 0x0B 0x86 0x00 0xC8 0x11 0x62 0x0E 0x10 0x0E 0x10 0x0E 0x10 0x00 0xC8 0x11 0x62 0x0B 0x86 0x0B 0x86 0x0B 0x86
		0x04 0x02 0x00 0x0A
		0x02 0xAA 0x60 0x02 0xB6 0x24
		0x04 0x02 0x00 0x32
		0x02 0xAA 0x3E 0x02 0xC2 0x00
		0x04 0x02 0x00 0x0A
		0x03 0xAA 0x3E 0x04 0xC2 0x00 0x05 0x16
		0x02 0xAA 0x3E 0x02 0xC8 0x40
		0x04 0x02 0x00 0x14
		0x02 0xAA 0x40 0x20 0x00 0xC8 0x00 0x00 0x00 0x00 0x00 0x00 0x0B 0xB8 0x10 0x04 0x10 0x68 0x00 0x32 0x4B 0x01 0x00 0x00 0x00 0x00 0x00 0x00 0x00 0x00 0x00 0x00 0x00 0x00 0x00 0x00
		0x04 0x02 0x00 0x0A
		0x02 0xAA 0x60 0x02 0x62 0x24
		0x04 0x02 0x00 0x32
		0x02 0xAA 0x3E 0x02 0xC2 0x00
		0x04 0x02 0x00 0x0A
		0x03 0xAA 0x3E 0x04 0xC2 0x00 0x08 0x42
		0x02 0xAA 0x3E 0x02 0xE8 0x40
		0x04 0x02 0x00 0x14
		0x02 0xAA 0x40 0x1B 0x00 0x00 0x00 0x00 0x00 0x00 0x00 0x00 0x00 0x00 0x00 0x00 0x00 0x00 0x00 0x00 0x00 0x00 0x00 0x00 0x00 0x00 0x00 0x00 0x00 0x00 0x00
		0x04 0x02 0x00 0x0A
		0x02 0xAA 0x60 0x02 0xD7 0x1F
		0x04 0x02 0x00 0x32
		0x02 0xAA 0x3E 0x02 0xC2 0x00
		0x04 0x02 0x00 0x0A
		0x03 0xAA 0x3E 0x04 0xC2 0x00 0xC8 0x3C
		0x02 0xAA 0x3E 0x02 0x12 0x41
		0x04 0x02 0x00 0x14
		0x02 0xAA 0x40 0x04 0x0A 0xF0 0x00 0x15
		0x04 0x02 0x00 0x0A
		0x02 0xAA 0x60 0x02 0x9D 0x08
		0x04 0x02 0x00 0x32
		0x02 0xAA 0x3E 0x02 0xC2 0x00
		0x04 0x02 0x00 0x0A
		0x03 0xAA 0x3E 0x04 0xC2 0x00 0xB4 0x19
		0x02 0xAA 0x3E 0x02 0x18 0x41
		0x04 0x02 0x00 0x14
		0x02 0xAA 0x40 0x02 0x0A 0x0A
		0x04 0x02 0x00 0x0A
		0x02 0xAA 0x60 0x02 0x92 0x06
		0x04 0x02 0x00 0x32
		0x02 0xAA 0x3E 0x02 0xC2 0x00
		0x04 0x02 0x00 0x0A
		0x03 0xAA 0x3E 0x04 0xC2 0x00 0xE3 0x10
		0x02 0xAA 0x3E 0x02 0x22 0x41
		0x04 0x02 0x00 0x14
		0x02 0xAA 0x40 0x01 0x13
		0x04 0x02 0x00 0x0A
		0x02 0xAA 0x60 0x02 0x89 0x05
		0x04 0x02 0x00 0x32
		0x02 0xAA 0x3E 0x02 0xC2 0x00
		0x04 0x02 0x00 0x0A
		0x03 0xAA 0x3E 0x04 0xC2 0x00 0x3F 0x08
		0x02 0xAA 0x3E 0x02 0x24 0x41
		0x04 0x02 0x00 0x14
		0x02 0xAA 0x40 0x20 0xFE 0xD5 0xFC 0x18 0x00 0x83 0x17 0xF2 0x11 0x3D 0x00 0xB4 0x11 0x62 0xFE 0xD5 0xFC 0x18 0x00 0x00 0x00 0x00 0x00 0x00 0x00 0x00 0x00 0x00 0x00 0x00 0x00 0x00
		0x04 0x02 0x00 0x0A
		0x02 0xAA 0x60 0x02 0xCB 0x24
		0x04 0x02 0x00 0x32
		0x02 0xAA 0x3E 0x02 0xC2 0x00
		0x04 0x02 0x00 0x0A
		0x03 0xAA 0x3E 0x04 0xC2 0x00 0x38 0x2B
		0x02 0xAA 0x3E 0x02 0x48 0x41
		0x04 0x02 0x00 0x14
		0x02 0xAA 0x40 0x20 0x0D 0x48 0x0A 0x5F 0x00 0x00 0x00 0x00 0x00 0x00 0x17 0x70 0x5A 0xB4 0x00 0x00 0x00 0x00 0x00 0x00 0x00 0x00 0x00 0x3C 0x00 0x4B 0x00 0x28 0x00 0x3C 0x3C 0x05
		0x04 0x02 0x00 0x0A
		0x02 0xAA 0x60 0x02 0xF7 0x24
		0x04 0x02 0x00 0x32
		0x02 0xAA 0x3E 0x02 0xC2 0x00
		0x04 0x02 0x00 0x0A
		0x03 0xAA 0x3E 0x04 0xC2 0x00 0x49 0x57
		0x02 0xAA 0x3E 0x02 0x68 0x41
		0x04 0x02 0x00 0x14
		0x02 0xAA 0x40 0x06 0x00 0x00 0x00 0x00 0x00 0x0A
		0x04 0x02 0x00 0x0A
		0x02 0xAA 0x60 0x02 0x4C 0x0A
		0x04 0x02 0x00 0x32
		0x02 0xAA 0x3E 0x02 0xC2 0x00
		0x04 0x02 0x00 0x0A
		0x03 0xAA 0x3E 0x04 0xC2 0x00 0x13 0x46
		0x02 0xAA 0x3E 0x02 0x74 0x41
		0x04 0x02 0x00 0x14
		0x02 0xAA 0x40 0x18 0x0B 0xB8 0x0C 0x1C 0x00 0x05 0x11 0x30 0x10 0xCC 0x64 0x62 0x0C 0x80 0x0C 0xE4 0x06 0x08 0x11 0x30 0x10 0xCC 0x64 0x5F
		0x04 0x02 0x00 0x0A
		0x02 0xAA 0x60 0x02 0x0D 0x1C
		0x04 0x02 0x00 0x32
		0x02 0xAA 0x3E 0x02 0xC2 0x00
		0x04 0x02 0x00 0x0A
		0x03 0xAA 0x3E 0x04 0xC2 0x00 0xC2 0x75
		0x02 0xAA 0x3E 0x02 0x9C 0x41
		0x04 0x02 0x00 0x14
		0x02 0xAA 0x40 0x08 0x3F 0x0A 0x19 0x64 0x3C 0x0A 0x5F 0x05
		0x04 0x02 0x00 0x0A
		0x02 0xAA 0x60 0x02 0xB2 0x0C
		0x04 0x02 0x00 0x32
		0x02 0xAA 0x3E 0x02 0xC2 0x00
		0x04 0x02 0x00 0x0A
		0x03 0xAA 0x3E 0x04 0xC2 0x00 0xB5 0x2A
		0x02 0xAA 0x3E 0x02 0xDE 0x41
		0x04 0x02 0x00 0x14
				0x02 0xAA 0x40 0x20 0x63 0x0A 0x63 0x3E 0x63 0xFE 0x63 0x82 0x63 0x8A 0x63 0x92 0x63 0x9A 0x63 0x61 0x63 0x9E 0x63 0x65 0x63 0x5D 0x63 0x35 0x63 0x95 0x63 0x84 0x6F 0x47 0x36 0x63
		0x04 0x02 0x00 0x0A
				0x02 0xAA 0x60 0x02 0x9A 0x24
		0x04 0x02 0x00 0x32
		0x02 0xAA 0x3E 0x02 0xC2 0x00
		0x04 0x02 0x00 0x0A
				0x03 0xAA 0x3E 0x04 0xC2 0x00 0x12 0x7A
		0x02 0xAA 0x3E 0x02 0x00 0x42
		0x04 0x02 0x00 0x14
		0x02 0xAA 0x40 0x04 0x80 0x00 0x80 0x00
		0x04 0x02 0x00 0x0A
		0x02 0xAA 0x60 0x02 0xBD 0x08
		0x04 0x02 0x00 0x32
		0x02 0xAA 0x3E 0x02 0xC2 0x00
		0x04 0x02 0x00 0x0A
		0x03 0xAA 0x3E 0x04 0xC2 0x00 0xDF 0x39
		0x02 0xAA 0x3E 0x02 0x10 0x42
		0x04 0x02 0x00 0x14
		0x02 0xAA 0x40 0x20 0x00 0x00 0x00 0x00 0x00 0x00 0x00 0x00 0x00 0x00 0x00 0x00 0x00 0x00 0x00 0x00 0x00 0x00 0x00 0x00 0x00 0x00 0x00 0x00 0x00 0x00 0x00 0x00 0x00 0x00 0x00 0x00
		0x04 0x02 0x00 0x0A
		0x02 0xAA 0x60 0x02 0xAD 0x24
		0x04 0x02 0x00 0x32
		0x02 0xAA 0x3E 0x02 0xC2 0x00
		0x04 0x02 0x00 0x0A
		0x03 0xAA 0x3E 0x04 0xC2 0x00 0x6A 0x0D
		0x02 0xAA 0x3E 0x02 0x30 0x42
		0x04 0x02 0x00 0x14
		0x02 0xAA 0x40 0x20 0x00 0x00 0x00 0x00 0x00 0x00 0x00 0x00 0x00 0x00 0x00 0x00 0x00 0x00 0x00 0x00 0x00 0x00 0x00 0x00 0x00 0x00 0x00 0x00 0x00 0x00 0x00 0x00 0x00 0x00 0x00 0x00
		0x04 0x02 0x00 0x0A
		0x02 0xAA 0x60 0x02 0x8D 0x24
		0x04 0x02 0x00 0x32
		0x02 0xAA 0x3E 0x02 0xC2 0x00
		0x04 0x02 0x00 0x0A
		0x03 0xAA 0x3E 0x04 0xC2 0x00 0x5B 0x6D
		0x02 0xAA 0x3E 0x02 0x50 0x42
		0x04 0x02 0x00 0x14
		0x02 0xAA 0x40 0x20 0x00 0x00 0x00 0x00 0x00 0x00 0x00 0x00 0x00 0x00 0x00 0x00 0x00 0x00 0x00 0x00 0x00 0x00 0x00 0x00 0x00 0x00 0x00 0x00 0x00 0x00 0x00 0x00 0x00 0x00 0x00 0x00
		0x04 0x02 0x00 0x0A
		0x02 0xAA 0x60 0x02 0x6D 0x24
		0x04 0x02 0x00 0x32
		0x02 0xAA 0x3E 0x02 0xC2 0x00
		0x04 0x02 0x00 0x0A
		0x03 0xAA 0x3E 0x04 0xC2 0x00 0x08 0x4D
		0x02 0xAA 0x3E 0x02 0x90 0x42
		0x04 0x02 0x00 0x14
		0x02 0xAA 0x40 0x09 0x08 0x53 0x48 0x33 0x36 0x36 0x31 0x30 0x31
		0x04 0x02 0x00 0x0A
		0x02 0xAA 0x60 0x02 0x59 0x0D
		0x04 0x02 0x00 0x32
		0x02 0xAA 0x3E 0x02 0xC2 0x00
		0x04 0x02 0x00 0x0A
		0x03 0xAA 0x3E 0x04 0xC2 0x00 0xBC 0x50
		0x02 0xAA 0x3E 0x02 0xA6 0x42
		0x04 0x02 0x00 0x14
		0x02 0xAA 0x40 0x12 0x00 0x00 0x00 0x00 0x01 0x00 0x04 0x03 0x05 0x04 0x06 0x05 0x61 0x01 0x00 0x01 0x00 0x01
		0x04 0x02 0x00 0x0A
		0x02 0xAA 0x60 0x02 0x97 0x16
		0x04 0x02 0x00 0x32
		0x02 0xAA 0x3E 0x02 0xC2 0x00
		0x04 0x02 0x00 0x0A
		0x03 0xAA 0x3E 0x04 0xC2 0x00 0xFD 0x05
		0x02 0xAA 0x3E 0x02 0xCA 0x42
		0x04 0x02 0x00 0x14
		0x02 0xAA 0x40 0x20 0x00 0x00 0x7F 0xFF 0x00 0x00 0x00 0x00 0x80 0x7F 0x80 0x7F 0x00 0x00 0x00 0x00 0x00 0x00 0x00 0x00 0x00 0x00 0x00 0x00 0x00 0x00 0x00 0x00 0x00 0x00 0x00 0x00
		0x04 0x02 0x00 0x0A
		0x02 0xAA 0x60 0x02 0x77 0x24
		0x04 0x02 0x00 0x32
		0x02 0xAA 0x3E 0x02 0xC2 0x00
		0x04 0x02 0x00 0x0A
		0x03 0xAA 0x3E 0x04 0xC2 0x00 0x39 0x57
		0x02 0xAA 0x3E 0x02 0xEA 0x42
		0x04 0x02 0x00 0x14
		0x02 0xAA 0x40 0x14 0x00 0x00 0x00 0x00 0x00 0x00 0x00 0x00 0x00 0x00 0x00 0x00 0x00 0x00 0x00 0x00 0x00 0x00 0x00 0x00
		0x04 0x02 0x00 0x0A
		0x02 0xAA 0x60 0x02 0xD3 0x18
		0x04 0x02 0x00 0x32
		0x02 0xAA 0x3E 0x02 0xC2 0x00
		0x04 0x02 0x00 0x0A
		0x03 0xAA 0x3E 0x04 0xC2 0x00 0xEA 0x3F
		0x02 0xAA 0x3E 0x02 0xFE 0x42
		0x04 0x02 0x00 0x14
		0x02 0xAA 0x40 0x20 0x6B 0x63 0x63 0x63 0x13 0x96 0x63 0x63 0x5F 0x7D 0x61 0x5F 0x7F 0x6C 0x63 0x63 0x63 0x63 0x63 0xDE 0x4F 0x4A 0x63 0xF2 0x47 0x4A 0x61 0xC7 0x67 0x46 0x63 0x5F
		0x04 0x02 0x00 0x0A
		0x02 0xAA 0x60 0x02 0x52 0x24
		0x04 0x02 0x00 0x32
		0x02 0xAA 0x3E 0x02 0xC2 0x00
		0x04 0x02 0x00 0x0A
		0x03 0xAA 0x3E 0x04 0xC2 0x00 0x7E 0x32
		0x02 0xAA 0x3E 0x02 0x1E 0x43
		0x04 0x02 0x00 0x14
		0x02 0xAA 0x40 0x20 0x63 0x66 0xA3 0xDF 0x5F 0x6A 0x63 0x63 0x63 0x63 0x63 0x63 0x63 0x63 0x63 0xD7 0x5F 0x4A 0x63 0x47 0x5B 0x7A 0x23 0xF8 0x45 0x4A 0xE3 0xF8 0x45 0x4A 0x63 0x63
		0x04 0x02 0x00 0x0A
		0x02 0xAA 0x60 0x02 0x36 0x24
		0x04 0x02 0x00 0x32
		0x02 0xAA 0x3E 0x02 0xC2 0x00
		0x04 0x02 0x00 0x0A
		0x03 0xAA 0x3E 0x04 0xC2 0x00 0x82 0x16
		0x02 0xAA 0x3E 0x02 0x3E 0x43
		0x04 0x02 0x00 0x14
		0x02 0xAA 0x40 0x20 0x63 0x63 0x63 0x63 0x63 0x63 0x9C 0x73 0x63 0x6F 0x6B 0x6B 0x6B 0x6B 0x63 0x63 0x6B 0x98 0x6F 0xA0 0x63 0x63 0x67 0x21 0x6B 0x02 0x63 0x33 0x63 0xAB 0x33 0x1B
		0x04 0x02 0x00 0x0A
		0x02 0xAA 0x60 0x02 0x1A 0x24
		0x04 0x02 0x00 0x32
		0x02 0xAA 0x3E 0x02 0xC2 0x00
		0x04 0x02 0x00 0x0A
		0x03 0xAA 0x3E 0x04 0xC2 0x00 0x35 0x7A
		0x02 0xAA 0x3E 0x02 0x5E 0x43
		0x04 0x02 0x00 0x14
		0x02 0xAA 0x40 0x20 0x63 0x40 0x63 0x40 0x63 0x1B 0x4B 0x63 0x63 0x40 0xF2 0x73 0x63 0x93 0x63 0x4B 0x63 0xF2 0x77 0xF3 0xC3 0x07 0x67 0x21 0x6B 0x02 0x5F 0x6F 0x7F 0x63 0x1F 0x62
		0x04 0x02 0x00 0x0A
		0x02 0xAA 0x60 0x02 0x91 0x24
		0x04 0x02 0x00 0x32
		0x02 0xAA 0x3E 0x02 0xC2 0x00
		0x04 0x02 0x00 0x0A
		0x03 0xAA 0x3E 0x04 0xC2 0x00 0x7E 0x71
		0x02 0xAA 0x3E 0x02 0x7E 0x43
		0x04 0x02 0x00 0x14
		0x02 0xAA 0x40 0x20 0x63 0x40 0x5B 0x18 0x5B 0xF6 0x67 0x21 0x63 0xF2 0xF7 0x66 0xE2 0x6B 0xAE 0x22 0x63 0x6F 0xEF 0x63 0x63 0x63 0x63 0x63 0x63 0x63 0x63 0x63 0x63 0x5F 0x4B 0x6B
		0x04 0x02 0x00 0x0A
		0x02 0xAA 0x60 0x02 0xCC 0x24
		0x04 0x02 0x00 0x32
		0x02 0xAA 0x3E 0x02 0xC2 0x00
		0x04 0x02 0x00 0x0A
		0x03 0xAA 0x3E 0x04 0xC2 0x00 0xA5 0x2C
		0x02 0xAA 0x3E 0x02 0x9E 0x43
		0x04 0x02 0x00 0x14
		0x02 0xAA 0x40 0x20 0x77 0x4B 0x69 0x1B 0xDA 0xEF 0x77 0x5F 0x77 0x1B 0x63 0x40 0x4B 0x14 0x63 0x93 0x67 0xC2 0x63 0x82 0x6F 0x33 0x63 0x63 0x4B 0x77 0x77 0x6B 0x6B 0x6F 0x6B 0x1E
		0x04 0x02 0x00 0x0A
		0x02 0xAA 0x60 0x02 0x32 0x24
		0x04 0x02 0x00 0x32
		0x02 0xAA 0x3E 0x02 0xC2 0x00
		0x04 0x02 0x00 0x0A
		0x03 0xAA 0x3E 0x04 0xC2 0x00 0xE0 0x12
		0x02 0xAA 0x3E 0x02 0xBE 0x43
		0x04 0x02 0x00 0x14
		0x02 0xAA 0x40 0x20 0x67 0xD3 0x4B 0xAB 0xD7 0x63 0xAB 0x63 0x63 0x63 0x63 0x63 0x93 0x4B 0x86 0x63 0x63 0x63 0x63 0x63 0x63 0x63 0x63 0x63 0x63 0x63 0x63 0x63 0x63 0x63 0x63 0x63
		0x04 0x02 0x00 0x0A
		0x02 0xAA 0x60 0x02 0x03 0x24
		0x04 0x02 0x00 0x32
		0x02 0xAA 0x3E 0x02 0xC2 0x00
		0x04 0x02 0x00 0x0A
		0x03 0xAA 0x3E 0x04 0xC2 0x00 0x58 0x63
		0x02 0xAA 0x3E 0x02 0xDE 0x43
		0x04 0x02 0x00 0x14
		0x02 0xAA 0x40 0x20 0x63 0x0A 0x63 0x3E 0x63 0xFE 0x63 0x82 0x63 0x8A 0x63 0x92 0x63 0x9A 0x63 0x61 0x63 0x9E 0x63 0x65 0x63 0x5D 0x63 0x35 0x63 0x95 0x63 0x84 0x6F 0x47 0x9C 0x63
		0x04 0x02 0x00 0x0A
		0x02 0xAA 0x60 0x02 0x32 0x24
		0x04 0x02 0x00 0x32
		0x02 0xAA 0x3E 0x02 0xC2 0x00
		0x04 0x02 0x00 0x0A
		0x03 0xAA 0x3E 0x04 0xC2 0x00 0xD9 0x12
		0x02 0xAA 0x3E 0x02 0x00 0x46
		0x04 0x02 0x00 0x14
		0x02 0xAA 0x40 0x20 0x8B 0x7C 0x7C 0x7C 0xB4 0x7C 0x7C 0x5C 0x7C 0x7C 0x3C 0x7C 0x7C 0xFC 0x6C 0x7C 0x7F 0x7C 0x7C 0x15 0x7C 0x7C 0xBC 0x7C 0x7C 0x9C 0x7C 0x7C 0x7D 0x7C 0x7C 0x5D
		0x04 0x02 0x00 0x0A
		0x02 0xAA 0x60 0x02 0x04 0x24
		0x04 0x02 0x00 0x32
		0x02 0xAA 0x3E 0x02 0xC2 0x00
		0x04 0x02 0x00 0x0A
		0x03 0xAA 0x3E 0x04 0xC2 0x00 0x6A 0x64
		0x02 0xAA 0x3E 0x02 0x20 0x46
		0x04 0x02 0x00 0x14
		0x02 0xAA 0x40 0x20 0x7C 0x7C 0xF9 0x7C 0x7C 0x1D 0x7C 0x7C 0xFD 0x7C 0x7C 0xDD 0x7C 0x7C 0xBD 0x7C 0x7C 0x9D 0x7C 0x7C 0x7E 0x7C 0x5C 0x92 0x7C 0x7C 0xB9 0x7C 0x7C 0x99 0x7C 0x7C
		0x04 0x02 0x00 0x0A
		0x02 0xAA 0x60 0x02 0x65 0x24
		0x04 0x02 0x00 0x32
		0x02 0xAA 0x3E 0x02 0xC2 0x00
		0x04 0x02 0x00 0x0A
		0x03 0xAA 0x3E 0x04 0xC2 0x00 0xA3 0x45
		0x02 0xAA 0x3E 0x02 0x40 0x46
		0x04 0x02 0x00 0x14
		0x02 0xAA 0x40 0x20 0xFE 0x7C 0x2C 0xBE 0x3C 0x7C 0xCE 0x3C 0x7C 0x9E 0x7C 0x7C 0x7F 0x7C 0x7C 0x5F 0x7C 0x5C 0xD6 0x7C 0x5C 0xD0 0x7C 0x7C 0x3F 0x7C 0x7C 0x1F 0x7C 0x2C 0x59 0x7D
		0x04 0x02 0x00 0x0A
		0x02 0xAA 0x60 0x02 0x49 0x24
		0x04 0x02 0x00 0x32
		0x02 0xAA 0x3E 0x02 0xC2 0x00
		0x04 0x02 0x00 0x0A
		0x03 0xAA 0x3E 0x04 0xC2 0x00 0x53 0x29
		0x02 0xAA 0x3E 0x02 0x60 0x46
		0x04 0x02 0x00 0x14
		0x02 0xAA 0x40 0x20 0x1C 0x75 0x7D 0x1C 0x55 0x7D 0x1C 0x35 0x7D 0x1C 0x15 0x7D 0x1C 0xF5 0x4C 0x7C 0x7C 0x4C 0x7C 0x7C 0x4C 0x7C 0x7C 0x4C 0x7C 0x7C 0x4C 0x7C 0x7C 0x4C 0x7C 0x7C
		0x04 0x02 0x00 0x0A
		0x02 0xAA 0x60 0x02 0x38 0x24
		0x04 0x02 0x00 0x32
		0x02 0xAA 0x3E 0x02 0xC2 0x00
		0x04 0x02 0x00 0x0A
		0x03 0xAA 0x3E 0x04 0xC2 0x00 0x15 0x18
		0x02 0xAA 0x3E 0x02 0x80 0x46
		0x04 0x02 0x00 0x14
		0x02 0xAA 0x40 0x20 0x4C 0x7C 0x7C 0x4C 0x7C 0x7C 0x4C 0x7C 0x7C 0x4C 0x7C 0x7C 0x7C 0x7C 0x7C 0x7C 0x7C 0x7C 0x7C 0x7C 0x7C 0x7C 0x7C 0x7C 0x7C 0x7C 0x7C 0x7C 0x7C 0x7C 0x7C 0x7C
		0x04 0x02 0x00 0x0A
		0x02 0xAA 0x60 0x02 0x79 0x24
		0x04 0x02 0x00 0x32
		0x02 0xAA 0x3E 0x02 0xC2 0x00
		0x04 0x02 0x00 0x0A
		0x03 0xAA 0x3E 0x04 0xC2 0x00 0x1A 0x59
		0x02 0xAA 0x3E 0x02 0xA0 0x46
		0x04 0x02 0x00 0x14
		0x02 0xAA 0x40 0x20 0x7C 0x7C 0x7C 0x7C 0x7C 0x7C 0x7C 0x7C 0x7C 0x7C 0x7C 0x7C 0x7C 0x7C 0x7C 0x7C 0x7C 0x7C 0x7C 0x7C 0x7C 0x7C 0x7C 0x7C 0x7C 0x7C 0x7C 0x7C 0x7C 0x7C 0x7C 0x7C
		0x04 0x02 0x00 0x0A
		0x02 0xAA 0x60 0x02 0x99 0x24
		0x04 0x02 0x00 0x32
		0x02 0xAA 0x3E 0x02 0xC2 0x00
		0x04 0x02 0x00 0x0A
		0x03 0xAA 0x3E 0x04 0xC2 0x00 0x6F 0x79
		0x02 0xAA 0x3E 0x02 0xC0 0x46
		0x04 0x02 0x00 0x14
		0x02 0xAA 0x40 0x20 0x7C 0x7C 0x7C 0x7C 0x7C 0x7C 0x7C 0x7C 0x7C 0x7C 0x7C 0x7C 0x7C 0x7C 0x7C 0x7C 0x7C 0x7C 0x7C 0x7C 0x7C 0x7C 0x7C 0x7C 0x7C 0x7C 0x7C 0x7C 0x7C 0x7C 0x7C 0x7C
		0x04 0x02 0x00 0x0A
		0x02 0xAA 0x60 0x02 0x79 0x24
		0x04 0x02 0x00 0x32
		0x02 0xAA 0x3E 0x02 0xC2 0x00
		0x04 0x02 0x00 0x0A
		0x03 0xAA 0x3E 0x04 0xC2 0x00 0x3C 0x59
		0x02 0xAA 0x3E 0x02 0xE0 0x46
		0x04 0x02 0x00 0x14
		0x02 0xAA 0x40 0x10 0x7C 0x7C 0x7C 0x7C 0x7C 0x7C 0x7C 0x7C 0x7C 0x7C 0x7C 0x7C 0x7C 0x7C 0xDB 0xD8
		0x04 0x02 0x00 0x0A
		0x02 0xAA 0x60 0x02 0x5E 0x14
		0x04 0x02 0x00 0x32
		0x02 0xAA 0x3E 0x02 0xC2 0x00
		0x04 0x02 0x00 0x0A
		0x03 0xAA 0x3E 0x04 0xC2 0x00 0xD6 0x4E
		0x02 0xAA 0x3E 0x02 0xF0 0x46
		0x04 0x02 0x00 0x14
		0x02 0xAA 0x40 0x20 0x39 0x3E 0x83 0xBF 0x83 0x29 0x83 0x9A 0x83 0x2A 0x83 0x89 0x83 0x9B 0x83 0x6B 0x83 0x84 0x83 0xD5 0x83 0x55 0x83 0x2B 0x83 0xC5 0x83 0xF5 0x7C 0x5D 0x83 0x76
		0x04 0x02 0x00 0x0A
		0x02 0xAA 0x60 0x02 0x0B 0x24
		0x04 0x02 0x00 0x32
		0x02 0xAA 0x3E 0x02 0xC2 0x00
		0x04 0x02 0x00 0x0A
		0x03 0xAA 0x3E 0x04 0xC2 0x00 0xF8 0x6B
		0x02 0xAA 0x3E 0x02 0x10 0x47
		0x04 0x02 0x00 0x14
		0x02 0xAA 0x40 0x20 0x6D 0x89 0x6D 0x28 0x6D 0xBE 0x6D 0x5D 0x7D 0xF3 0x7D 0xE1 0x7D 0xC7 0x7D 0xD5 0x7D 0xCB 0x7D 0xC9 0x7D 0xBF 0x7D 0x9D 0x7D 0x6C 0x8C 0x22 0x8C 0xD0 0x8C 0xA6
		0x04 0x02 0x00 0x0A
		0x02 0xAA 0x60 0x02 0xBB 0x24
		0x04 0x02 0x00 0x32
		0x02 0xAA 0x3E 0x02 0xC2 0x00
		0x04 0x02 0x00 0x0A
		0x03 0xAA 0x3E 0x04 0xC2 0x00 0xE3 0x1B
		0x02 0xAA 0x3E 0x02 0x30 0x47
		0x04 0x02 0x00 0x14
		0x02 0xAA 0x40 0x20 0x8C 0x84 0x8C 0xDA 0x8C 0x49 0x8C 0x1F 0x8C 0x2E 0x8C 0x3D 0x8C 0x1C 0x9C 0xE3 0x9C 0x92 0x9C 0x42 0x9C 0xC1 0x9C 0x21 0x9C 0xB0 0x9C 0x30 0x9C 0xD7 0x9C 0xA6
		0x04 0x02 0x00 0x0A
		0x02 0xAA 0x60 0x02 0xF5 0x24
		0x04 0x02 0x00 0x32
		0x02 0xAA 0x3E 0x02 0xC2 0x00
		0x04 0x02 0x00 0x0A
		0x03 0xAA 0x3E 0x04 0xC2 0x00 0xD9 0x55
		0x02 0xAA 0x3E 0x02 0x50 0x47
		0x04 0x02 0x00 0x14
		0x02 0xAA 0x40 0x20 0x9C 0x95 0x9C 0x94 0x9C 0xAB 0x9C 0xFB 0x9C 0x4B 0x9C 0x09 0xAC 0xC6 0xCC 0xC6 0xB3 0x33 0xA3 0x34 0xA3 0xFB 0xA3 0x56 0xA3 0x96 0xA3 0x42 0x93 0x6C 0x93 0x58
		0x04 0x02 0x00 0x0A
		0x02 0xAA 0x60 0x02 0x3D 0x24
		0x04 0x02 0x00 0x32
		0x02 0xAA 0x3E 0x02 0xC2 0x00
		0x04 0x02 0x00 0x0A
		0x03 0xAA 0x3E 0x04 0xC2 0x00 0x59 0x1D
		0x02 0xAA 0x3E 0x02 0x70 0x47
		0x04 0x02 0x00 0x14
		0x02 0xAA 0x40 0x20 0x93 0x9C 0x93 0xBF 0x93 0xA9 0x93 0xE9 0x93 0x58 0x93 0x70 0x93 0x39 0x7C 0x85 0x6C 0xEE 0x7C 0x27 0x83 0x71 0x6C 0x6A 0x6C 0xEE 0x6C 0xB4 0x6C 0xA0 0x6C 0x76
		0x04 0x02 0x00 0x0A
		0x02 0xAA 0x60 0x02 0x25 0x24
		0x04 0x02 0x00 0x32
		0x02 0xAA 0x3E 0x02 0xC2 0x00
		0x04 0x02 0x00 0x0A
		0x03 0xAA 0x3E 0x04 0xC2 0x00 0x61 0x05
		0x02 0xAA 0x3E 0x02 0x90 0x47
		0x04 0x02 0x00 0x14
		0x02 0xAA 0x40 0x20 0x6C 0x67 0x6C 0x52 0x6C 0x0D 0x83 0x04 0xA3 0xD8 0xD3 0xEB 0xE3 0xDB 0xE3 0x03 0xE3 0xA3 0xD3 0xFA 0xE3 0xE0 0xD3 0xD1 0xC3 0x40 0x13 0x50 0x33 0xFF 0x11 0x34
		0x04 0x02 0x00 0x0A
		0x02 0xAA 0x60 0x02 0x23 0x24
		0x04 0x02 0x00 0x32
		0x02 0xAA 0x3E 0x02 0xC2 0x00
		0x04 0x02 0x00 0x0A
		0x03 0xAA 0x3E 0x04 0xC2 0x00 0x08 0x03
		0x02 0xAA 0x3E 0x02 0xB0 0x47
		0x04 0x02 0x00 0x14
		0x02 0xAA 0x40 0x20 0x93 0xCF 0x93 0xAF 0x93 0xC8 0x93 0xAA 0x93 0x15 0x93 0x1B 0x93 0x24 0x93 0x0D 0xA3 0x93 0xA3 0x63 0x93 0xBC 0xA3 0xC3 0xA3 0xA3 0x93 0x29 0x83 0xFA 0x0D 0x53
		0x04 0x02 0x00 0x0A
		0x02 0xAA 0x60 0x02 0x4F 0x24
		0x04 0x02 0x00 0x32
		0x02 0xAA 0x3E 0x02 0xC2 0x00
		0x04 0x02 0x00 0x0A
		0x03 0xAA 0x3E 0x04 0xC2 0x00 0x40 0x2F
		0x02 0xAA 0x3E 0x02 0xD0 0x47
		0x04 0x02 0x00 0x14
		0x02 0xAA 0x40 0x20 0x7C 0xD9 0x7C 0x09 0x7C 0x0A 0x7C 0xFB 0x7C 0xDB 0x7C 0xBB 0x7C 0x9B 0x7C 0x74 0x7C 0x8B 0x7C 0x64 0x7C 0x84 0x7C 0x25 0x7C 0xA7 0x7C 0xE3 0x4C 0xEC 0x7C 0x7C
		0x04 0x02 0x00 0x0A
		0x02 0xAA 0x60 0x02 0x42 0x24
		0x04 0x02 0x00 0x32
		0x02 0xAA 0x3E 0x02 0xC2 0x00
		0x04 0x02 0x00 0x0A
		0x03 0xAA 0x3E 0x04 0xC2 0x00 0x9E 0x22
		0x02 0xAA 0x3E 0x02 0xF0 0x47
		0x04 0x02 0x00 0x14
		0x02 0xAA 0x40 0x08 0x7C 0x7C 0x7C 0x7C 0x7C 0x7C 0xE6 0x84
		0x04 0x02 0x00 0x0A
		0x02 0xAA 0x60 0x02 0x76 0x0C
		0x04 0x02 0x00 0x32
		0x02 0xAA 0x3E 0x02 0xC2 0x00
		0x04 0x02 0x00 0x0A
		0x03 0xAA 0x3E 0x04 0xC2 0x00 0xD2 0x6E
		0x04 0x02 0x00 0xC8
		0x02 0xAA 0x3E 0x02 0x12 0xE0
		0x04 0x02 0x00 0x02
		0x02 0xAA 0x40 0x04 0x45 0x32 0x55 0x50
		0x04 0x02 0x00 0x02
		0x02 0xAA 0x60 0x02 0xF1 0x08
		0x04 0x02 0x03 0xE8
		0x02 0xAA 0x3E 0x02 0x18 0xE0
		0x04 0x02 0x00 0x02
		0x02 0xAA 0x40 0x07 0x45 0x78 0x69 0x74 0x6F 0x65 0x6D
		0x04 0x02 0x00 0x02
		0x02 0xAA 0x60 0x02 0x2C 0x0B
		0x04 0x02 0x00 0xC8
		0x02 0xAA 0x3E 0x02 0x20 0x00
		0x04 0x02 0x01 0xF4
		0x02 0xAA 0x3E 0x02 0xCB 0x00
		0x04 0x02 0x00 0x05
		0x03 0xAA 0x3E 0x05 0xCB 0x00 0x01 0x01 0x00
		0x04 0x02 0x00 0x02
		>;
};
