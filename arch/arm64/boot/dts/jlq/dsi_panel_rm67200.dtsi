&dsi {
	panel_rm67200: rm67200 {
		compatible = "jlq,dsi-panel";
		reg = <0>;
		panel_name = "rm67200";
		status = "okay";
		inited = "true";

		reset-gpio = <&gpio 68 0>;
		reset-sequence = <1 20>;
		bias-enp-gpio = <&gpio 41 0>;
		bias-enn-gpio = <&gpio 40 0>;
		enable-backlight-gpio = <&gpio 6 0>;

		dsi,lanes = <4>;
		dsi,channel = <0>;
		dsi,flags = <2051>;
		dsi,format = <0>;

		bias-delay-ms = <0>;
		init-delay-ms = <20>;
		prepare-delay-ms = <0>;
		enable-delay-ms = <2>;
		unprepare-delay-ms = <0>;
		disable-delay-ms = <2>;
		reset-delay-ms = <10>;
		width-mm = <120>;
		height-mm = <170>;
		pwm-names = "backlight";
		pwms = <&pwm0 0 32000>;

		panel-exit-sequence = [
			05 05 01 28
			05 78 01 10
		];

		panel-init-sequence = [
			23 00 02 fe 21
			23 00 02 04 00
			23 00 02 00 00
			23 00 02 2a 00
			23 00 02 26 00
			23 00 02 54 00
			23 00 02 50 00
			23 00 02 7b 00
			23 00 02 77 00
			23 00 02 a2 00
			23 00 02 9d 00
			23 00 02 c9 00
			23 00 02 c5 00
			23 00 02 01 0c
			23 00 02 27 0c
			23 00 02 51 0c
			23 00 02 78 0c
			23 00 02 9e 0c
			23 00 02 c6 0c
			23 00 02 02 25
			23 00 02 28 25
			23 00 02 52 25
			23 00 02 79 25
			23 00 02 9f 25
			23 00 02 c7 25
			23 00 02 03 3b
			23 00 02 29 3b
			23 00 02 53 3b
			23 00 02 7a 3b
			23 00 02 a0 3b
			23 00 02 c8 3b
			23 00 02 09 00
			23 00 02 05 4e
			23 00 02 31 00
			23 00 02 2b 4e
			23 00 02 5a 00
			23 00 02 55 4e
			23 00 02 80 00
			23 00 02 7c 4e
			23 00 02 a7 00
			23 00 02 a3 4e
			23 00 02 ce 00
			23 00 02 ca 4e
			23 00 02 06 60
			23 00 02 2d 60
			23 00 02 56 60
			23 00 02 7d 60
			23 00 02 a4 60
			23 00 02 cb 60
			23 00 02 07 70
			23 00 02 2f 70
			23 00 02 58 70
			23 00 02 7e 70
			23 00 02 a5 70
			23 00 02 cc 70
			23 00 02 08 7e
			23 00 02 30 7e
			23 00 02 59 7e
			23 00 02 7f 7e
			23 00 02 a6 7e
			23 00 02 cd 7e
			23 00 02 0e 01
			23 00 02 0a 8d
			23 00 02 36 01
			23 00 02 32 8d
			23 00 02 5f 01
			23 00 02 5b 8d
			23 00 02 85 01
			23 00 02 81 8d
			23 00 02 ad 01
			23 00 02 a9 8d
			23 00 02 d3 01
			23 00 02 cf 8d
			23 00 02 0b bb
			23 00 02 33 bb
			23 00 02 5c bb
			23 00 02 82 bb
			23 00 02 aa bb
			23 00 02 d0 bb
			23 00 02 0c e0
			23 00 02 34 e0
			23 00 02 5d e0
			23 00 02 83 e0
			23 00 02 ab e0
			23 00 02 d1 e0
			23 00 02 0d 1a
			23 00 02 35 1a
			23 00 02 5e 1a
			23 00 02 84 1a
			23 00 02 ac 1a
			23 00 02 d2 1a
			23 00 02 13 55
			23 00 02 0f 46
			23 00 02 3b 55
			23 00 02 37 46
			23 00 02 64 55
			23 00 02 60 46
			23 00 02 8a 55
			23 00 02 86 46
			23 00 02 b2 55
			23 00 02 ae 46
			23 00 02 d8 55
			23 00 02 d4 46
			23 00 02 10 8a
			23 00 02 38 8a
			23 00 02 61 8a
			23 00 02 87 8a
			23 00 02 af 8a
			23 00 02 d5 8a
			23 00 02 11 c1
			23 00 02 39 c1
			23 00 02 62 c1
			23 00 02 88 c1
			23 00 02 b0 c1
			23 00 02 d6 c1
			23 00 02 12 c2
			23 00 02 3a c2
			23 00 02 63 c2
			23 00 02 89 c2
			23 00 02 b1 c2
			23 00 02 d7 c2
			23 00 02 18 6a
			23 00 02 14 f7
			23 00 02 42 6a
			23 00 02 3d f7
			23 00 02 69 6a
			23 00 02 65 f7
			23 00 02 8f 6a
			23 00 02 8b f7
			23 00 02 b7 6a
			23 00 02 b3 f7
			23 00 02 dd 6a
			23 00 02 d9 f7
			23 00 02 15 3b
			23 00 02 3f 3b
			23 00 02 66 3b
			23 00 02 8c 3b
			23 00 02 b4 3b
			23 00 02 da 3b
			23 00 02 16 67
			23 00 02 40 67
			23 00 02 67 67
			23 00 02 8d 67
			23 00 02 b5 67
			23 00 02 db 67
			23 00 02 17 a7
			23 00 02 41 a7
			23 00 02 68 a7
			23 00 02 8e a7
			23 00 02 b6 a7
			23 00 02 dc a7
			23 00 02 1d bf
			23 00 02 19 d1
			23 00 02 47 bf
			23 00 02 43 d1
			23 00 02 6e bf
			23 00 02 6a d1
			23 00 02 94 bf
			23 00 02 90 d1
			23 00 02 bc bf
			23 00 02 b8 d1
			23 00 02 e2 bf
			23 00 02 de d1
			23 00 02 1a 0a
			23 00 02 44 0a
			23 00 02 6b 0a
			23 00 02 91 0a
			23 00 02 b9 0a
			23 00 02 df 0a
			23 00 02 1b 19
			23 00 02 45 19
			23 00 02 6c 19
			23 00 02 92 19
			23 00 02 ba 19
			23 00 02 e0 19
			23 00 02 1c 2e
			23 00 02 46 2e
			23 00 02 6d 2e
			23 00 02 93 2e
			23 00 02 bb 2e
			23 00 02 e1 2e
			23 00 02 22 ff
			23 00 02 1e 45
			23 00 02 4c ff
			23 00 02 48 45
			23 00 02 73 ff
			23 00 02 6f 45
			23 00 02 99 ff
			23 00 02 95 45
			23 00 02 c1 ff
			23 00 02 bd 45
			23 00 02 e7 ff
			23 00 02 e3 45
			23 00 02 1f 5c
			23 00 02 49 5c
			23 00 02 70 5c
			23 00 02 96 5c
			23 00 02 be 5c
			23 00 02 e4 5c
			23 00 02 20 7c
			23 00 02 4a 7c
			23 00 02 71 7c
			23 00 02 97 7c
			23 00 02 bf 7c
			23 00 02 e5 7c
			23 00 02 21 a8
			23 00 02 4b a8
			23 00 02 72 a8
			23 00 02 98 a8
			23 00 02 c0 a8
			23 00 02 e6 a8
			23 00 02 25 f0
			23 00 02 23 e0
			23 00 02 4f f0
			23 00 02 4d e0
			23 00 02 76 f0
			23 00 02 74 e0
			23 00 02 9c f0
			23 00 02 9a e0
			23 00 02 c4 f0
			23 00 02 c2 e0
			23 00 02 ea f0
			23 00 02 e8 e0
			23 00 02 24 e8
			23 00 02 4e e8
			23 00 02 75 e8
			23 00 02 9b e8
			23 00 02 c3 e8
			23 00 02 e9 e8
			23 00 02 fe 3d
			23 00 02 00 05
			23 00 02 fe 23
			23 00 02 08 c1
			23 00 02 0a 60
			23 00 02 0b 00
			23 00 02 0c 01
			23 00 02 0d 80
			23 00 02 0e 81
			23 00 02 10 00
			23 00 02 11 20
			23 00 02 12 03
			23 00 02 13 80
			23 00 02 86 81
			23 00 02 88 00
			23 00 02 89 20
			23 00 02 8a 04
			23 00 02 8b 80
			23 00 02 14 81
			23 00 02 16 18
			23 00 02 17 00
			23 00 02 18 03
			23 00 02 19 04
			23 00 02 1a c0
			23 00 02 1b 04
			23 00 02 1c 81
			23 00 02 1e 18
			23 00 02 1f 00
			23 00 02 20 05
			23 00 02 21 06
			23 00 02 22 c0
			23 00 02 23 04
			23 00 02 51 ff
			23 00 02 52 54
			23 00 02 53 36
			23 00 02 54 00
			23 00 02 55 cb
			23 00 02 56 bc
			23 00 02 58 12
			23 00 02 59 ff
			23 00 02 5a ff
			23 00 02 5b ff
			23 00 02 68 ff
			23 00 02 69 ff
			23 00 02 6a ff
			23 00 02 6b 21
			23 00 02 6c bc
			23 00 02 6d cb
			23 00 02 6e 00
			23 00 02 6f 45
			23 00 02 70 63
			23 00 02 71 ff
			23 00 02 5f 22
			23 00 02 60 11
			23 00 02 61 00
			23 00 02 62 00
			23 00 02 63 11
			23 00 02 64 22
			23 00 02 33 88
			23 00 02 34 88
			23 00 02 35 88
			23 00 02 36 88
			23 00 02 39 ff
			23 00 02 3a f7
			23 00 02 fe 00
			23 00 02 fe 20
			23 00 02 31 22
			23 00 02 32 22
			23 00 02 44 1e
			23 00 02 45 1e
			23 00 02 46 1a
			23 00 02 47 1a
			23 00 02 fe 3d
			23 00 02 23 2c
			23 00 02 fe 20
			23 00 02 2b 75
			23 00 02 26 30
			23 00 02 fe 3d
			23 00 02 20 71
			23 00 02 fe 00
			23 00 02 35 00
			05 98 01 11
			05 98 01 29
		];

		display-timings {
			native-mode = <&rm67200_timing>;
			rm67200_timing: timing0 {
				clock-frequency = <160000000>;
				hactive = <1080>;
				vactive = <1920>;
				hfront-porch = <180>;
				hsync-len = <30>;
				hback-porch = <80>;
				vfront-porch = <5>;
				vsync-len = <8>;
				vback-porch = <5>;
				hsync-active = <1>;
				vsync-active = <1>;
			};
		};
	};
};
