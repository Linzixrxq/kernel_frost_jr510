## drivers/soc/jlq/audio-kernel/Kconfig
```kconfig
menu "JLQ SoC Audio support"

config SND_SOC_JLQ_HOSTLESS_PCM
	tristate

config SND_SOC_JLQ_ADSP_INTF
	bool "SoC Q6 audio driver for jlq"
	help
	 To add support for SoC audio on JLQ.
	 This will enable all the platform specific
	 interactions towards DSP. It includes asm,
	 and afe interfaces on the DSP.
	
config SND_SOC_ADSP
	tristate "SoC ALSA audio driver for ADSP"
	select SND_SOC_JLQ_ADSP_INTF
	help
    To add support for JLQ ADSP Soc Audio.
    This will enable sound soc platform specific
    audio drivers. This includes asm, afe
    interfaces to DSP using apr.

config SND_SOC_ADSP_DEBUG
	bool "QDSP Audio Driver Debug Feature"
	help
	 Configuration to enable debugging utilities for
	 QDSP6 based audio drivers. One debugging utility
	 is inducing kernel panic upon encountering critical
	 errors from DSP audio modules

config DOLBY_DAP
	bool "Enable Dolby DAP"
	depends on SND_SOC_JLQ_ADSP_INTF
	help
	 To add support for dolby DAP post processing.
	 This support is to configure the post processing parameters
	 to DSP. The configuration includes sending the end point
	 device, end point dependent post processing parameters and
	 the various posrt processing parameters

config DOLBY_DS2
	bool "Enable Dolby DS2"
	depends on SND_SOC_JLQ_ADSP_INTF
	help
	 To add support for dolby DAP post processing.
	 This support is to configure the post processing parameters
	 to DSP. The configuration includes sending the end point
	 device, end point dependent post processing parameters and
	 the various posrt processing parameters

config DTS_EAGLE
	bool "Enable DTS Eagle Support"
	depends on SND_SOC_JLQ_ADSP_INTF
	select SND_HWDEP
	help
	 To add DTS Eagle support on QDSP6 targets.
	 Eagle is a DTS pre/post processing
	 package that includes HeadphoneX. The configuration
	 includes sending tuning parameters of various modules.

config DTS_SRS_TM
	bool "Enable DTS SRS"
	depends on SND_SOC_JLQ_ADSP_INTF
	help
	 To add support for DTS SRS post processing.
	 This support is to configure the post processing
	 parameters to DSP. The configuration includes sending
	 tuning parameters of various modules.

config SND_SOC_CPE
	tristate "CPE drivers"
	depends on SND_SOC_WCD_CPE
	help
	 To add support for Codec Processing Engine. This support
	 is to enable CPE block on the codec and this config needs
	 to be added to codecs that contain the CPE hardware block.
	 The configuration includes the cpe lsm driver to enable
	 listen on codec.

config PINCTRL_LPI
	tristate "JR510 ALSA PINCTRL_LPI"
	help
	 To add support for SoC audio on JLQ.

config AUDIO_EXT_CLK
	tristate "JR510 AUDIO_EXT_CLK"
	help
	 To add support for SoC audio on JLQ.

config SND_SOC_WCD9XXX_V2
	tristate "JR510 ALSA SND_SOC_WCD9XXX_V2"
	help
	 To add support for SoC audio on JLQ.
	 
config SND_SOC_WCD_MBHC
	tristate "JR510 SND_SOC_WCD_MBHC"
	help
	 To add support for SoC audio on JLQ.
	 
config SND_SOC_WSA881X_ANALOG
	tristate "JR510 ALSA SND_SOC_WSA881X_ANALOG"
	help
	 To add support for SoC audio on JLQ.

config SND_SOC_AW87XXX
	tristate "JR510 ALSA SND_SOC_AW87XXX"
	help
	 To add support for SoC audio on JLQ.

config SND_SOC_SIA81XX
	tristate "JR510 ALSA SND_SOC_SIA81XX"
	help
	 To add support for SoC audio on JLQ.
	 
config WCD9XXX_CODEC_CORE_V2
	tristate "JR510 ALSA WCD9XXX_CODEC_CORE_V2"
	help
	 To add support for SoC audio on JLQ.
	 
config MSM_CDC_PINCTRL
	tristate "JR510 ALSA MSM_CDC_PINCTRL"
	help
	 To add support for SoC audio on JLQ.
	 
config MSM_QDSP6V2_CODECS
	tristate "JR510 ALSA MSM_QDSP6V2_CODECS"
	help
	 To add support for SoC audio on JLQ.
	 
config MSM_ULTRASOUND
	tristate "JR510 ALSA MSM_ULTRASOUND"
	help
	 To add support for SoC audio on JLQ.
	 
config MSM_QDSP6_APRV2_RPMSG
	tristate "JR510 ALSA MSM_QDSP6_APRV2_RPMSG"
	help
	 To add support for SoC audio on JLQ.
	 
config SND_SOC_MSM_QDSP6V2_INTF
	tristate "JR510 ALSA SND_SOC_MSM_QDSP6V2_INTF"
	help
	 To add support for SoC audio on JLQ.
	 
config MSM_ADSP_LOADER
	tristate "JR510 ALSA MSM_ADSP_LOADER"
	help
	 To add support for SoC audio on JLQ.
	 
config REGMAP_SWR
	tristate "JR510 ALSA REGMAP_SWR"
	help
	 To add support for SoC audio on JLQ.
	 
config MSM_QDSP6_SSR
	tristate "JR510 ALSA MSM_QDSP6_SSR"
	help
	 To add support for SoC audio on JLQ.
	 
config MSM_QDSP6_PDR
	tristate "JR510 ALSA MSM_QDSP6_PDR"
	help
	 To add support for SoC audio on JLQ.
	 
config MSM_QDSP6_NOTIFIER
	tristate "JR510 ALSA MSM_QDSP6_NOTIFIER"
	help
	 To add support for SoC audio on JLQ.
	 
config SND_SOC_MSM_HOSTLESS_PCM
	tristate "JR510 ALSA SND_SOC_MSM_HOSTLESS_PCM"
	help
	 To add support for SoC audio on JLQ.
	 
config SOUNDWIRE_MSTR_CTRL
	tristate "JR510 ALSA SOUNDWIRE_MSTR_CTRL"
	help
	 To add support for SoC audio on JLQ.

config SND_SOC_WCD_MBHC_ADC
	tristate "JR510 ALSA SND_SOC_WCD_MBHC_ADC"
	help
	 To add support for SoC audio on JLQ.

config SND_SOC_QDSP6V2
	tristate "JR510 ALSA SND_SOC_QDSP6V2"
	help
	 To add support for SoC audio on JLQ.

config QTI_PP
	tristate "JR510 ALSA QTI_PP"
	help
	 To add support for SoC audio on JLQ.

config SND_HWDEP_ROUTING
	tristate "JR510 ALSA SND_HWDEP_ROUTING"
	help
	 To add support for SoC audio on JLQ.

config SND_SOC_MSM_STUB
	tristate "JR510 ALSA SND_SOC_MSM_STUB"
	help
	 To add support for SoC audio on JLQ.
config MSM_AVTIMER
	tristate "JR510 ALSA MSM_AVTIMER"
	help
	 To add support for SoC audio on JLQ.

config VA_MACRO
	tristate "JR510 ALSA VA_MACRO"
	help
	 To add support for SoC audio on JLQ.

config RX_MACRO
	tristate "JR510 ALSA RX_MACRO"
	help
	 To add support for SoC audio on JLQ.

config TX_MACRO
	tristate "JR510 ALSA TX_MACRO"
	help
	 To add support for SoC audio on JLQ.

config DIGITAL_CDC_RSC_MGR
    tristate "JR510 ALSA DIGITAL_CDC_RSC_MGR"
    help
     To add support for SoC audio on JLQ.

config SND_SOC_WCD_IRQ
	tristate "JR510 ALSA SND_SOC_WCD_IRQ"
	help
	 To add support for SoC audio on JLQ.

config SND_SOC_WCD937X
	tristate "JR510 ALSA SND_SOC_WCD937X"
	help
	 To add support for SoC audio on JLQ.

config SND_SOC_WCD937X_SLAVE
	tristate "JR510 ALSA SND_SOC_WCD937X_SLAVE"
	help
	 To add support for SoC audio on JLQ.

config SND_SOC_BOLERO
	tristate "JR510 ALSA SND_SOC_BOLERO"
	help
	 To add support for SoC audio on JLQ.

config SND_EVENT
	tristate "JR510 ALSA SND_EVENT"
	help
	 To add support for SoC audio on JLQ.

config TDM_DISABLE
	tristate "JR510 ALSA TDM_DISABLE"
	help
	 To add support for SoC audio on JLQ.

config MI2S_DISABLE
	tristate "JR510 ALSA MI2S_DISABLE"
	help
	 To add support for SoC audio on JLQ.

config AUXPCM_DISABLE
	tristate "JR510 ALSA AUXPCM_DISABLE"
	help
	 To add support for SoC audio on JLQ.
	 
config SND_SOC_JA310
	tristate "SoC Machine driver for JA310"
	select SND_SOC_ADSP
	#select SND_SOC_MSM_STUB
	select SND_SOC_JLQ_HOSTLESS_PCM
	#select SND_DYNAMIC_MINORS
	select ADSP_APR
	#select MSM_QDSP6V2_CODECS
	#select SND_SOC_WCD9330
	#select SND_SOC_WCD9335
	select SND_SOC_PM310_CODEC
	#select SND_SOC_WSA881X_ANALOG
	#select SND_SOC_WSA881X
	#select MFD_CORE
	#select QTI_PP
	#select DTS_SRS_TM
	#select DOLBY_DAP
	#select DOLBY_DS2
	#select SND_SOC_CPE
	#select SND_SOC_WCD_CPE
	#select SND_SOC_MSM_HDMI_DBA_CODEC_RX
	#select SND_HWDEP
       # select DTS_EAGLE
	help
	 To add support for SoC audio on MSM8996.
	 This will enable sound soc drivers which
	 interfaces with DSP, also it will enable
	 the machine driver and the corresponding
	 DAI-links

config SND_SOC_SM6150
	tristate "SoC Machine driver for JR510"
	select PINCTRL_WCD
	select PINCTRL_LPI
	select AUDIO_EXT_CLK
	select SND_SOC_WCD9XXX_V2
	select SND_SOC_WCD_MBHC
	select SND_SOC_WSA881X
	select SND_SOC_WCD_DSP_MGR
	select SND_SOC_WCD_SPI
	select SND_SOC_WCD934X
	select SND_SOC_WCD934X_MBHC
	select SND_SOC_WCD934X_DSD
	select SND_SOC_WCD_CPE
	select WCD9XXX_CODEC_CORE
	select MSM_CDC_PINCTRL
	select MSM_QDSP6V2_CODECS
	select MSM_ULTRASOUND
	select MSM_QDSP6_APRV2_RPMSG
	select SND_SOC_MSM_QDSP6V2_INTF
	select MSM_ADSP_LOADER
	select REGMAP_SWR
	select MSM_QDSP6_SSR
	select MSM_QDSP6_PDR
	select MSM_QDSP6_NOTIFIER
	select SND_SOC_MSM_HOSTLESS_PCM
	select MSM_GLINK_SPI_XPRT
	select WCD_DSP_GLINK
	select SOUNDWIRE
	select SOUNDWIRE_MSTR_CTRL
	select SND_SOC_WCD_MBHC_ADC
	select SND_SOC_QDSP6V2
	select QTI_PP
	select SND_HWDEP_ROUTING
	select DOLBY_LICENSE
	select SND_SOC_MSM_STUB
	select MSM_AVTIMER
	select SND_SOC_MSM_HDMI_CODEC_RX
	select SND_SOC_BOLERO
	select WSA_MACRO
	select VA_MACRO
	select RX_MACRO
	select TX_MACRO
	select SND_SOC_WCD_IRQ
	select SND_SOC_WCD937X
	select SND_SOC_WCD937X_SLAVE
	select SND_EVENT

	help
	 To add support for SoC audio on MSM8996.
	 This will enable sound soc drivers which
	 interfaces with DSP, also it will enable
	 the machine driver and the corresponding
	 DAI-links

config SND_SOC_JR510
	tristate "SoC Machine driver for JR510"
	#select PINCTRL_LPI
	#select AUDIO_EXT_CLK
	#select SND_SOC_WCD9XXX_V2
	#select SND_SOC_WCD_MBHC
	#select SND_SOC_WSA881X_ANALOG
	#select WCD9XXX_CODEC_CORE_V2
	#select MSM_CDC_PINCTRL
	#select MSM_QDSP6V2_CODECS
	#select MSM_ULTRASOUND
	#select MSM_QDSP6_APRV2_RPMSG
	#select SND_SOC_MSM_QDSP6V2_INTF
	#select MSM_ADSP_LOADER
	#select REGMAP_SWR
	#select MSM_QDSP6_SSR
	#select MSM_QDSP6_PDR
	#select MSM_QDSP6_NOTIFIER
	#select SND_SOC_MSM_HOSTLESS_PCM
	#select SOUNDWIRE
	#select SOUNDWIRE_MSTR_CTRL
	#select SND_SOC_WCD_MBHC_ADC
	#select SND_SOC_QDSP6V2
	#select QTI_PP
	#select SND_HWDEP_ROUTING
	#select SND_SOC_MSM_STUB
	#select MSM_AVTIMER
	#select SND_SOC_BOLERO
	#select VA_MACRO
	#select RX_MACRO
	#select TX_MACRO
	#select DIGITAL_CDC_RSC_MGR
	#select SND_SOC_WCD_IRQ
	#select SND_SOC_WCD937X
	#select SND_SOC_WCD937X_SLAVE
	#select SND_EVENT
	#select TDM_DISABLE
	#select MI2S_DISABLE
	#select AUXPCM_DISABLE

	help
	 To add support for SoC audio on JR510.
	 This will enable sound soc drivers which
	 interfaces with DSP, also it will enable
	 the machine driver and the corresponding
	 DAI-links
	 
config JLQ_ADSPLOAD
    tristate "adsp load"
    default m
    ---help---
        load adsp bin.
endmenu
```

## drivers/soc/jlq/blklog/Kconfig
```kconfig
config JLQ_BLK_LOG
	tristate "JLQ Block Log Driver"
	depends on ARCH_JLQ
	default n
	help
	  This enables the JLQ Block Log
```

## drivers/soc/jlq/bluetooth/Kconfig
```kconfig
config JLQ_BTSTATE
        tristate "JLQ bluetooth state"
        help
          Select this to set or get JLQ bluetooth state.
```

## drivers/soc/jlq/bridge/Kconfig
```kconfig
config JLQ_BRIDGE
	tristate "config bridge driver"
	help
	  enable it, if you need the communication between the host and
	  the coprocessors, or use the Audio module, etc.
```

## drivers/soc/jlq/cpufreq/Kconfig
```kconfig
config CPUFREQ_DT_JLQ
	tristate "Generic DT based cpufreq driver"
	depends on HAVE_CLK && OF
	select CPUFREQ_DT_PLATDEV_JLQ
	select PM_OPP
	help
	  This adds a generic DT based cpufreq driver for frequency management.
	  It supports both uniprocessor (UP) and symmetric multiprocessor (SMP)
	  systems.

	  If in doubt, say N.

config CPUFREQ_DT_JLQ_PLATDEV
	tristate "Generic dt cpufreq device driver"
	help
	  This adds a generic DT based cpufreq platdev driver for frequency
	  management.  This creates a 'cpufreq-dt-jlq' platform device, on the
	  supported platforms.

	  If in doubt, say N.
```

## drivers/soc/jlq/crypto/Kconfig
```kconfig
config JLQ_CRYPTO_FDE
	tristate "JLQ Inline Crypto Module, ARM FDE-741"
	default n
	depends on FS_ENCRYPTION
	depends on FS_ENCRYPTION_INLINE_CRYPT
	help
	  This driver supports Inline Crypto Engine for JLQ chipset JR510,
	  to accelerate crypto operations for storage needs.
	  To compile this driver as a module, choose M here: the
	  module will be called fde.
```

## drivers/soc/jlq/dcstat/Kconfig
```kconfig
config CPU_DCSTAT_JR510
	bool "Cpu debug feature for run stats and dutycycle stats"
	depends on CPU_FREQ
	depends on CPU_IDLE
	help
	  This enables cpu stats debug feature for cpu run stats and dutycycle
	  stats, including run time and idle time.You can get these stats with
	  debugfs interface.
```

## drivers/soc/jlq/devfreq/Kconfig
```kconfig
config DEVFREQ_GOV_CPUFREQ
	tristate "CPUfreq"
	depends on CPU_FREQ
	help
	  Chooses frequency based on the online CPUs' current frequency and a
	  CPU frequency to device frequency mapping table(s). This governor
	  can be useful for controlling devices such as DDR, cache, CCI, etc.

config DEVFREQ_SIMPLE_DEV
	tristate "Device driver for simple clock device with no status info"
	select DEVFREQ_GOV_PERFORMANCE
	select DEVFREQ_GOV_POWERSAVE
	select DEVFREQ_GOV_USERSPACE
	select DEVFREQ_GOV_CPUFREQ
	help
	  Device driver for simple devices that control their frequency using
	  clock APIs and don't have any form of status reporting.

config DEVFREQ_DDR
	tristate "Device driver for ddr dfs device with additional command"
	depends on PM_DEVFREQ
	depends on PM_CTRL
	select DEVFREQ_GOV_PERFORMANCE
	select DEVFREQ_GOV_POWERSAVE
	select DEVFREQ_GOV_USERSPACE
	select DEVFREQ_GOV_CPUFREQ
	help
	  Device driver for ddr dfs device that control their frequency using
	  bridge APIs and have additional command such as show ddr status.

config BW_BUSMON
	tristate "Device driver for ddr bandwidth monitor"
	help
	  Device driver for ddr master bandwidth monitor.
```

## drivers/soc/jlq/display/Kconfig
```kconfig
# SPDX-License-Identifier: GPL-2.0-only
#
# JLQ display subsystem drivers
#
source "drivers/soc/jlq/display/cmdline/Kconfig"
source "drivers/soc/jlq/display/komeda/Kconfig"
source "drivers/soc/jlq/display/camille/Kconfig"
source "drivers/soc/jlq/display/transmitter/Kconfig"
```

## drivers/soc/jlq/display/camille/Kconfig
```kconfig
# SPDX-License-Identifier: GPL-2.0-only
#
# JLQ camille drivers
#
config DISPLAY_CAMILLE
	tristate "jlq camille display driver"
	depends on DISPLAY_JLQ
	help
	  Choose this option if you want to compile the jlq camille display
	  driver.

	  If compiled as a module it will be called camille_drv.

config CAMILLE_PWM
	tristate "jlq camille pwm"
	depends on DISPLAY_CAMILLE
	help
	  Choose this option if you want to use camille pwm to output pwm
	  pulse.
```

## drivers/soc/jlq/display/cmdline/Kconfig
```kconfig
# SPDX-License-Identifier: GPL-3.0-only
#
# JLQ display cmdline code
#
config JLQ_DISPLAY_CMDLINE
	tristate "jlq display cmdline code"
	help
	 This selects support for the parsing of jlq
	 display cmdline.If you want to parse panel_cfg
	 from cmdline,you should selet this option.
```

## drivers/soc/jlq/display/transmitter/Kconfig
```kconfig
# SPDX-License-Identifier: GPL-2.0-only
#
# JLQ dsi/lcd/backlight drivers
#
config DSI_TRANSMITTER_JLQ
	tristate "jlq dsi transmitter driver"
	select DRM_PANEL
	select DRM_MIPI_DSI
	select VIDEOMODE_HELPERS
	select DRM_KMS_HELPER
	help
	 This selects support for jlq SoC specific extensions for
	 the Synopsys DesignWare DSI driver. If you want to enable MIPI DSI on
	 jlq platform, you should selet this option.

config DRM_VIRT_ENCODER
	tristate "Virtual OF-based encoder"
	depends on DRM && OF
	select VIDEOMODE_HELPERS
	help
	  Choose this option to get a virtual encoder and its associated
	  connector that will use the device tree to read the display
	  timings information. If M is selected the module will be called
	  drm_vencoder.

config BACKLIGHT_JLQ
	tristate "jlq backlight driver"
	help
	  jlq backlight driver provides a sys file by which userspace
	  can control the backlight brightness of lcd. Choose this option
	  to enable jlq backlight driver.

	  If M is selected the module will be called jlq backlighter.
```
