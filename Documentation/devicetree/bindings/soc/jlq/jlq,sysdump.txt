## Documentation/devicetree/bindings/soc/jlq/jlq,sysdump.txt
```
JLQ sysdump driver bindinngs

This binding descirbes the sysdump driver responsible for trigger sysdump which
register with an notifier for panic and will trigger wdog bite and  scp will do
soc register dump with wdog's bite signal

A force dump gpio is responsible for trigger an level interrupt to cpu and an
trigger for starting sysdump


- compatible:
	Usage: required
	Value type: <string>
	Definition: must be "jlq,sysdump"

- reg:
	Usage: required
	Value type: <prop-encoded-array>
	Definition: the base address and size of sysdump register, like
	TOP_CHIP_RSTN_CTL0 ~ TOP_CHIP_RSTN_CTL5

- reg-names:
	Usage: optional
	Value type: <string>

- enable_sysdump:
	Usage: optional
	Value type: bool
	Definition: enable sysdump, if not defined, sysdump won't be triggered.

- force-dump-enable:
	Usage: optional
	Value type: bool
	Definition: enable sysdump, if not defined, sysdump can't be  triggered
		    toggle force dump gpio

-force-dump-gpio:
	Usage: optional
	Value type: <prop-encoded-arrry>

-pinctrl-names:
	Usage: optional
	Value type: "string";
	Definition: pinctrl name of force dump

-pinctrl-0:
	Usage: optional

= EXAMPLE

The following example represents sysdump driver is enabled and force dump is
disabled.

sysdump: sysdump@0x34510300 {
	compatible = "jlq,sysdump";
	reg = <0x34510300 4>;
	reg-names = "shutdown_reg";
	enable_sysdump;

	//force-dump-enable;
	force-dump-gpio = <&gpio 43 GPIO_ACTIVE_HIGH>;
	pinctrl-names = "default";
	pinctrl-0 = <&force_dump_pin>;
};
```

## Documentation/devicetree/bindings/soc/jlq/jlq,wdt.txt
```
JLQ watchodg driver bindinngs

This binding descirbes the watchdog driver binding for

A force dump gpio is responsible for trigger an level interrupt to cpu and an
trigger for starting sysdump


- compatible:
	Usage: required
	Value type: <string>
	Definition: must be "jlq,ap_wdt"

- reg:
	Usage: required
	Value type: <prop-encoded-array>
	Definition: the base address and watchdog device

- reg-names:
	Usage: optional
	Value type: <string>

- interrupts:
	Usage: required
	Value type: <prop-encoded-array>
	Definition: bark irq number for watchodg

- clocks:
	Usage: required
	Value type: <prop-encoded-array>
	Definition: tclock for watchodg

- clock-names:
	Usage: optional
	Value type: <string>
	Definition: clock name

- resets:
	Usage: required
	Value type: <prop-encoded-array>
	Definition: reset config for watchdog

- jlq,bark-time;
	Usage: required
	Value type: u32
	Definition: bark interval for watchodg in millisecond

= EXAMPLE

The following example represents watchdog driver which will bark for every
ten seconds and will bite irq will trigger if bark irq is not cleared after
ten seconds

	wdt0: watchdog@30707000 {
		compatible = "jlq,ap_wdt";
		reg = <0x30707000 0x1000>;
		reg-names = "wdt0_base";
		interrupts = <GIC_SPI INT_WDT0_BARK IRQ_TYPE_LEVEL_HIGH>;
		clocks = <&wdt00_tclk>;
		clock-names = "wdt0_clk";
		resets = <&crg_rst 0x4c 10 RESET_LOW_ACTIVE>; /* bit10 */
		reset-names = "wdt0-reset";
		jlq,bark-time = <10000>;
	};
```

## Documentation/devicetree/bindings/soc/jlq/jlq-SD7601.txt
```
SD7601 for JLQ board driver binding

Required properties :
  - compatible : Must be "jlq,sd7601ad"
  - reg : Offset and length of the register set for the device
  - charger_name : charger power supply name
  - bigm,irq_gpio : IRQ GPIO
  - bigm,ce_gpio : Enable gpio
  - bigm,ilimit_ma : current limit
  - bigm,vlimit_mv : voltage limit
  - bigm,cc_ma : charger current
  - bigm,cv_mv : charger voltage
  - bigm,pre_ma : pre-charge current
  - bigm,eoc_ma : endof charge(terminal charge) current
  - bigm,vsysmin_mv : Vsys voltage
  - bigm,rechg_mv : recharge voltage drop detect.

Example :

SD7601@d6 {
	compatible = "jlq,sd7601ad";
	reg = <0xd6>;

	charger_name = "sd7601";
	bigm,irq_gpio = 1;
	bigm,ce_gpio = 2;
	bigm,ilimit_ma = 3000;
	bigm,vlimit_mv = 4600;
	bigm,cc_ma = 2200;
	bigm,cv_mv = 4400;
	bigm,pre_ma = 540;
	bigm,eoc_ma = 180;
	bigm,vsysmin_mv = 3500;
	bigm,rechg_mv = 100;
};
```

## Documentation/devicetree/bindings/soc/jlq/jlq-Sh36610x.txt
```
SH36610X for JLQ board driver binding

Required properties:
- compatible : One of:
  - sh,sh366101
  - jlq,sh36610x

Optional properties :
 - monitored-battery: phandle of battery characteristics node
     The fuel gauge uses the following battery properties:
     + energy-full-design-microwatt-hours
     + charge-full-design-microamp-hours
     + voltage-min-design-microvolt
   Both or neither of the *-full-design-*-hours properties must be set.
   See Documentation/devicetree/bindings/power/supply/battery.txt


Example :
	bat: battery {
		compatible = "simple-battery";
		charge-full-design-microamp-hours = <1900000>;
		constant-charge-voltage-max-microvolt = <4350000>;
	};

	SH36610X@AA {
		compatible = "jlq,sh36610x";
		reg = <0xaa>;
		interrupts-extended = <&gpiochip 10 IRQ_TYPE_EDGE_FALLING>;
		monitored-battery = <&bat>;
	};
```

## Documentation/devicetree/bindings/soc/jlq/jlq-blklog.txt
```
JLQ block log driver bindinngs

Required properties :
  - compatible :  "jlq,blk-log-loader",for "loader-log"

This binding descirbes the block log driver

	jlq-blk-log {
		compatible = "jlq,blk-log-loader";
		jlq,blk-dev = "/dev/block/platform/0.soc/34458000.sdhci/by-name/rawdump";
	};
```

## Documentation/devicetree/bindings/soc/jlq/jlq-charger-manager.txt
```
JLQ Charger Manager driver binding

This binding descirbes the JLQ Charger Manager driver

Required properties :
	- cm-name:Definition: JLQ charger-manager register power supply name.
	- cm-poll-interval: Charger check poll interval,(unit:ms).
	- cm-batt-id-iio:The IIO interface which for read battery ID.
	- cm-fuel-gauge:The power supply name which register by fuel-gauge.
	- cm-charger-extcon:Extcon interface Name ,which for notice cable be plugIN/OUT.
	- power-supply:battery charger power-supply.
	- cm-chip-name:battery charger power regulator,used for regulate charger volt& current
	- cm-chip-max:charger chip max charge current.

Optional properties :
	- cm-regulator-name : Input power regulator,if it can setting volt various.
	- otg_regulator_name:OTG power regulator.

Example :
	jlq-charger-manager {
		compatible = "jlq,charger-manager";

		cm-name = "battery";
		cm-poll-interval= <1000>;
		cm-batt-id-iio = "batt-id-iio";
		cm-fuel-gauge = "SH36610x";
		cm-regulator-name = "Charger-input-power";
		cm-charger-extcon = "charger-usb-extcon";
		otg_regulator_name = "otg-power";
		charger1{
			power-supply = "sd7601";
			cm-chip-name = "sd7601-charger-power";
			cm-chip-min = 0;
			cm-chip-max = 3000000;
		};
		charger2{
			power-supply = "smb13x";
			cm-chip-name = "smb13x-charger-power";
			cm-chip-min = 0;
			cm-chip-max = 2000000;
		};
	};
```

## Documentation/devicetree/bindings/soc/jlq/jlq-socinfo.txt
```
JLQ socinfo driver bindinngs

This binding descirbes the socinfo driver, only compatible property is need

	jlq-socinfo {
		compatible = "jlq,socinfo";
	};
```

## Documentation/devicetree/bindings/soc/jlq/jlq_cpufreq_dc.txt
```
cpu frequency duty cycle device

jlq-cpufreq-dcstat is a device that trace the use information of cpu frequency.
it can provide data for optimizing the power consumption of system.

Required properties:
- compatible:		Must be "jlq,cpufreq-dcstat"

Optional properties:


Example:

        jlq-cpufreq-dcstat {
                compatible = "jlq,cpufreq-dcstat";
        };
```

## Documentation/devicetree/bindings/soc/jlq/jlq_devfreq_cpufreq.txt
```
devfreq driver, matching cpufreq

this driver for devfreq, the device will be scaling when cpu frequency is changed.

Required properties:
- compatible:		Must be "jlq,devfreq-cpufreq"

Optional properties:


Example:

        jlq-devfreq-cpufreq {
                compatible = "jlq,devfreq-cpufreq";
        };
```

## Documentation/devicetree/bindings/soc/jlq/pericom-type-c.txt
```
USB Type-C Detection Chip

Required properties :
- compatible : Must be "pericom,usb-type-c"
- reg: 7bit I2C slave address

Optional properties:
- gpio-irq : config INTB pin
- pinctrl-names : This should be defined if a target uses pinctrl framework
  for INT_N and ENB pin. See "pinctrl" in
  Documentation/devicetree/bindings/pinctrl/pinctrl-bindings.txt.
  It should specify the names of the configs that pinctrl can install in driver.
  Following are the pinctrl config that can be installed:

Example :
        pericom_type_c: pericom_type_c@1d {
                compatible = "pericom,usb-type-c";
                reg = <0x1d>;
                qpio-irq = <&gpio 9 GPIO_ACTIVE_LOW>;
                pinctrl-names = "default";
                pinctrl-0 = <&pericom_irq_pin>;
        };
```

## Documentation/devicetree/bindings/spi/spi-jlq-ssi.txt
```
JLQ SSI controller.

Required properties:
- compatible : should be "jlq,jlq-spi".
- reg: Should contain ssi registers location and length.
- reg-names: Should contain the resource reg names.
	- ssi: ssi configuration register Address space
	- ap_ctrl:ssi mode select
- interrupts: should contain the ssi interrupt number.
- #address-cells, #size-cells : Must be present if the device has sub-nodes

Example:

For ja310:
master:ssi ctroller
ssi1: spi@FA726000 {
	compatible = "jlq,jlq-spi";
	#address-cells = <1>;
	#size-cells = <0>;
	reg = <0xFA726000 0x1000>;
	reg-names = "ssi";
	interrupts = <0 INT_SSI1 0>;
	rx_dma_channel = <&ap_dmas 11 0>;
	tx_dma_channel = <&ap_dmas 3 0>;
	num_chipselect= <1>;
	ssi_protocol = <(0x30002)>;/*0->ssp,1->spi*/
	pinctrl-names = "default";
	pinctrl-0 = <&spi1_tx_rx_clk_ssn_pins>;
	clocks = <&ssi1_clk>, <&ssi0_pclk>;
	clock-names = "ssi_clk", "ssi_pclkgt";
};
```

## Documentation/devicetree/bindings/thermal/jlq-tsens.txt
```
* JLQ SoC Temperature Sensor (TSENS)

Required properties:
- compatible:
  Must be one of the following:
    - "jlq,ja310-tsens" (ja310/ja308)
    - "jlq,jr510-tsens" (jr510)
- reg: Address range of the thermal registers.
  New platforms containing v2.x.y of the TSENS IP must specify the SROT and TM
  register spaces separately, with order being TM before SROT.
  See Example 2, below.
- #jlq,sensors: Number of sensors in tsens block
- #jlq,tsens-slope_numerator / jlq,tsens-slope_denominator is Division value.
- #jlq,sensor-id is sensor-id mapping.
- #thermal-sensor-cells : Should be 1.

Example 1:
	tsens: tsens@34500180 {
		compatible = "jlq,jr510-tsens";
		reg = <0x34500180 0x50>;
		reg-names = "tsens_base";
		interrupts = <GIC_SPI INT_PVT_INTR 0>;
		interrupt-names = "tsens-upper-lower";
		jlq,sensors = <4>;
		jlq,tsens-slope_numerator = <1>;
		jlq,tsens-slope_denominator = <16>;
		jlq,sensor-id = <0 1 2 3>;
		#thermal-sensor-cells = <1>;
	};
```

## drivers/soc/jlq/Kconfig
```kconfig
# SPDX-License-Identifier: GPL-2.0-only
#
# JLQ Soc drivers
#
menu "JLQ SoC drivers"

config DMAS_JLQ
	tristate "JLQ DMAS support"
	help
	  Say yes here to support the JLQ DMAS module.

config SERIAL_JLQ
	tristate "jlq serial port support"
	select SERIAL_CORE
	depends on DMAS_JLQ
	help
	  If you have a machine based on an jlq ja31x CPU you
	  can enable its onboard serial ports by enabling this option.

config SERIAL_JLQ_CONSOLE
	bool "Console on comip serial port"
	default n
	depends on SERIAL_JLQ
	select SERIAL_CORE_CONSOLE
	select SERIAL_EARLYCON
	help
	  If you have enabled the serial port on the jlq serial console
	  CPU you can make it the console by answering Y to this option.

config PRINTK_LIMIT
	bool "limit printk level"
	depends on PRINTK
	default n
	help
	  If you need to limit printk log for better performance you can
	  enable this option by answering Y.
	  By default this option should be n.

config CLK_JLQ_JR510
	tristate "JLQ CLock Driver Support"
	depends on OF
	help
	  Say yes here to support the JLQ clock module.

config IRQ_JLQ_MAILBOX
	tristate "JLQ MAILBOX irq"
	help
	  Select this option to support MAILBOX irq.
	  There are four mailbox irq groups for AP-SEC, CM4F2AP-NONSEC,
	  ADSP2SP-NONSEC and VDSP2AP-NONSENONSEC in mailbox-irq
	  driver.

config JGKI
	bool "Enable for JGKI or debug variant"
	help
	  When this flag is enabled, it is safe to assume that the build
	  is a Non GKI build. It can be either JGKI build or a debug
	  build. This does not differentiate a JGKI and a debug build.
	  This flag is absent if the build is a GKI build. If this flag is
	  enabled, all the ABI compatibilities are not applicable.

config JLQ_SLIMBUS
	tristate "slimbus support"
	default m
	---help---
	  slimbus driver.

config JLQ_SOCINFO
	tristate "JLQ socinfo driver"
	select SOC_BUS
	help
	  Say yes here to support the JLQ socinfo driver, providing
	  information about the SoC to user space.

source "drivers/soc/jlq/cpufreq/Kconfig"
source "drivers/soc/jlq/pmic/Kconfig"
source "drivers/soc/jlq/lpm/Kconfig"
source "drivers/soc/jlq/pwm/Kconfig"
source "drivers/soc/jlq/display/Kconfig"
#source "drivers/soc/jlq/gpu/Kconfig"
source "drivers/soc/jlq/gpio/Kconfig"
source "drivers/soc/jlq/ssi/Kconfig"
source "drivers/soc/jlq/bridge/Kconfig"
source "drivers/soc/jlq/nanohub/Kconfig"
source "drivers/soc/jlq/reset/Kconfig"
source "drivers/soc/jlq/usb/Kconfig"
source "drivers/soc/jlq/interconnect/Kconfig"
source "drivers/soc/jlq/vdsp/Kconfig"
source "drivers/soc/jlq/power/Kconfig"
source "drivers/soc/jlq/audio-kernel/Kconfig"
source "drivers/soc/jlq/devfreq/Kconfig"
source "drivers/soc/jlq/iio/Kconfig"
source "drivers/soc/jlq/thermal/Kconfig"
#source "drivers/soc/jlq/glink/Kconfig"
source "drivers/soc/jlq/i2s/Kconfig"
source "drivers/soc/jlq/crypto/Kconfig"
source "drivers/soc/jlq/sysdump/Kconfig"
source "drivers/soc/jlq/dcstat/Kconfig"
source "drivers/soc/jlq/touchscreen/Kconfig"
source "drivers/soc/jlq/tz/Kconfig"
source "drivers/soc/jlq/fingerprint/Kconfig"
source "drivers/soc/jlq/bluetooth/Kconfig"
source "drivers/soc/jlq/timer/Kconfig"
source "drivers/soc/jlq/pmctrl/Kconfig"
source "drivers/soc/jlq/blklog/Kconfig"
endmenu
```
