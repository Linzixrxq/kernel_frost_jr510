## Documentation/devicetree/bindings/power/supply/qcom,pmi632.txt
```
Qualcomm Switch-Mode Battery Charger and Boost

PROPERTIES
- compatible:
  Usage: required
  Value type: <stringlist>
  Description: Must be one of:
               - "qcom,spmi-pmic"

- reg:
  Usage: required
  Value type: <prop-encoded-array>
  Description: Base address of SMPI slave address

EXAMPLE
	qcom,pmi632@2 {
		compatible = "qcom,spmi-pmic";
		reg = <0x2 0x0>;
		#address-cells = <2>;
		#size-cells = <0>;

		pmi632_revid: qcom,revid@100 {
			compatible = "qcom,qpnp-revid";
			reg = <0x100 0x100>;
		};

		pmi632_pon: qcom,power-on@800 {
			compatible = "qcom,qpnp-power-on";
			reg = <0x800 0x100>;
		};

		pmi632_vadc: vadc@3100 {
			compatible = "qcom,spmi-adc5-lite";
			reg = <0x3100 0x100>, <0x3700 0x100>;
			reg-names = "adc5-usr-base", "adc5-cal-base";
			#address-cells = <1>;
			#size-cells = <0>;
			interrupts = <0x2 0x31 0x0 IRQ_TYPE_EDGE_RISING>;
			interrupt-names = "eoc-int-en-set";
			qcom,adc-vdd-reference = <1875>;
			#io-channel-cells = <1>;
			io-channel-ranges;
			qcom,pmic-revid = <&pmi632_revid>;

			/* Channel nodes */
			ref_gnd {
				reg = <ADC_REF_GND>;
				label = "ref_gnd";
				qcom,pre-scaling = <1 1>;
			};

			vref_1p25 {
				reg = <ADC_1P25VREF>;
				label = "vref_1p25";
				qcom,pre-scaling = <1 1>;
			};

			die_temp {
				reg = <ADC_DIE_TEMP>;
				label = "die_temp";
				qcom,pre-scaling = <1 1>;
			};

			vph_pwr {
				reg = <ADC_VPH_PWR>;
				label = "vph_pwr";
				qcom,pre-scaling = <1 3>;
			};

			vbat_sns {
				reg = <ADC_VBAT_SNS>;
				label = "vbat_sns";
				qcom,pre-scaling = <1 3>;
			};

			usb_in_i_uv {
				reg = <ADC_USB_IN_I>;
				label = "usb_in_i_uv";
				qcom,pre-scaling = <1 1>;
			};

			usb_in_v_div_16 {
				reg = <ADC_USB_IN_V_16>;
				label = "usb_in_v_div_16";
				qcom,pre-scaling = <1 16>;
			};

			chg_temp {
				reg = <ADC_CHG_TEMP>;
				label = "chg_temp";
				qcom,pre-scaling = <1 1>;
			};

			bat_therm {
				reg = <ADC_BAT_THERM_PU2>;
				label = "bat_therm";
				qcom,ratiometric;
				qcom,hw-settle-time = <200>;
				qcom,pre-scaling = <1 1>;
			};

			bat_therm_30k {
				reg = <ADC_BAT_THERM_PU1>;
				label = "bat_therm_30k";
				qcom,ratiometric;
				qcom,hw-settle-time = <200>;
				qcom,pre-scaling = <1 1>;
			};

			bat_therm_400k {
				reg = <ADC_BAT_THERM_PU3>;
				label = "bat_therm_400k";
				qcom,ratiometric;
				qcom,hw-settle-time = <200>;
				qcom,pre-scaling = <1 1>;
			};

			bat_id {
				reg = <ADC_BAT_ID_PU2>;
				label = "bat_id";
				qcom,ratiometric;
				qcom,hw-settle-time = <200>;
				qcom,pre-scaling = <1 1>;
			};

			i_parallel {
				reg = <ADC_PARALLEL_ISENSE>;
				label = "i_parallel";
				qcom,pre-scaling = <1 1>;
			};

			v_i_int_ext {
				reg = <ADC_INT_EXT_ISENSE_VBAT_VDATA>;
				label = "v_i_int_vbat_vdata";
				qcom,pre-scaling = <1 1>;
			};

			v_i_parallel {
				reg = <ADC_PARALLEL_ISENSE_VBAT_VDATA>;
				label = "v_i_parallel_vbat_vdata";
				qcom,pre-scaling = <1 1>;
			};

		};

		pmi632_adc_tm: adc_tm@3500 {
			compatible = "qcom,adc-tm5";
			reg = <0x3500 0x100>;
			interrupts = <0x2 0x35 0x0 IRQ_TYPE_EDGE_RISING>;
			interrupt-names = "thr-int-en";
			#address-cells = <1>;
			#size-cells = <0>;
			#thermal-sensor-cells = <1>;
		};

		pmi632_tz: qcom,temp-alarm@2400 {
			compatible = "qcom,spmi-temp-alarm";
			reg = <0x2400 0x100>;
			interrupts = <0x2 0x24 0x0 IRQ_TYPE_EDGE_BOTH>;
			#thermal-sensor-cells = <0>;
			qcom,temperature-threshold-set = <1>;
		};

		pmi632_charger: qcom,qpnp-smb5 {
			compatible = "qcom,qpnp-smb5","qcom,pm6150-smb5","qcom,pmi632-smb5";
			#address-cells = <1>;
			#size-cells = <1>;
			#cooling-cells = <2>;

			qcom,pmic-revid = <&pmi632_revid>;
			io-channels = <&pmi632_vadc ADC_USB_IN_V_16>,
				      <&pmi632_vadc ADC_USB_IN_I>,
				      <&pmi632_vadc ADC_CHG_TEMP>,
				      <&pmi632_vadc ADC_DIE_TEMP>;
			io-channel-names = "usb_in_voltage",
					   "usb_in_current",
					   "chg_temp",
					   "die_temp";

			qcom,chgr@1000 {
				reg = <0x1000 0x100>;
				interrupts =
					<0x2 0x10 0x0 IRQ_TYPE_EDGE_RISING>,
					<0x2 0x10 0x1 IRQ_TYPE_EDGE_RISING>,
					<0x2 0x10 0x2 IRQ_TYPE_EDGE_RISING>,
					<0x2 0x10 0x3 IRQ_TYPE_EDGE_RISING>,
					<0x2 0x10 0x4 IRQ_TYPE_EDGE_RISING>,
					<0x2 0x10 0x5 IRQ_TYPE_EDGE_RISING>,
					<0x2 0x10 0x6 IRQ_TYPE_EDGE_RISING>,
					<0x2 0x10 0x7 IRQ_TYPE_EDGE_RISING>;

				interrupt-names = "chgr-error",
						  "chg-state-change",
						  "step-chg-state-change",
						  "step-chg-soc-update-fail",
						  "step-chg-soc-update-req",
						  "fg-fvcal-qualified",
						  "vph-alarm",
						  "vph-drop-prechg";
			};

			qcom,dcdc@1100 {
				reg = <0x1100 0x100>;
				interrupts =
					<0x2 0x11 0x0 IRQ_TYPE_EDGE_RISING>,
					<0x2 0x11 0x1 IRQ_TYPE_EDGE_RISING>,
					<0x2 0x11 0x2 IRQ_TYPE_EDGE_RISING>,
					<0x2 0x11 0x3 IRQ_TYPE_EDGE_BOTH>,
					<0x2 0x11 0x4 IRQ_TYPE_EDGE_BOTH>,
					<0x2 0x11 0x5 IRQ_TYPE_EDGE_BOTH>,
					<0x2 0x11 0x6 IRQ_TYPE_EDGE_RISING>,
					<0x2 0x11 0x7 IRQ_TYPE_EDGE_BOTH>;

				interrupt-names = "otg-fail",
						  "otg-oc-disable-sw",
						  "otg-oc-hiccup",
						  "bsm-active",
						  "high-duty-cycle",
						  "input-current-limiting",
						  "concurrent-mode-disable",
						  "switcher-power-ok";
			};

			qcom,batif@1200 {
				reg = <0x1200 0x100>;
				interrupts =
					<0x2 0x12 0x0 IRQ_TYPE_EDGE_RISING>,
					<0x2 0x12 0x1 IRQ_TYPE_EDGE_RISING>,
					<0x2 0x12 0x2 IRQ_TYPE_EDGE_BOTH>,
					<0x2 0x12 0x3 IRQ_TYPE_EDGE_BOTH>,
					<0x2 0x12 0x4 IRQ_TYPE_EDGE_BOTH>,
					<0x2 0x12 0x5 IRQ_TYPE_EDGE_BOTH>,
					<0x2 0x12 0x6 IRQ_TYPE_EDGE_BOTH>,
					<0x2 0x12 0x7 IRQ_TYPE_EDGE_BOTH>;

				interrupt-names = "bat-temp",
						  "all-chnl-conv-done",
						  "bat-ov",
						  "bat-low",
						  "bat-therm-or-id-missing",
						  "bat-terminal-missing",
						  "buck-oc",
						  "vph-ov";
			};

			qcom,usb@1300 {
				reg = <0x1300 0x100>;
				interrupts =
					<0x2 0x13 0x0 IRQ_TYPE_EDGE_BOTH>,
					<0x2 0x13 0x1 IRQ_TYPE_EDGE_BOTH>,
					<0x2 0x13 0x2 IRQ_TYPE_EDGE_RISING>,
					<0x2 0x13 0x3 IRQ_TYPE_EDGE_BOTH>,
					<0x2 0x13 0x4 IRQ_TYPE_EDGE_BOTH>,
					<0x2 0x13 0x5 IRQ_TYPE_EDGE_BOTH>,
					<0x2 0x13 0x6 IRQ_TYPE_EDGE_RISING>,
					<0x2 0x13 0x7 IRQ_TYPE_EDGE_RISING>;

				interrupt-names = "usbin-collapse",
						  "usbin-vashdn",
						  "usbin-uv",
						  "usbin-ov",
						  "usbin-plugin",
						  "usbin-revi-change",
						  "usbin-src-change",
						  "usbin-icl-change";
			};

			qcom,typec@1500 {
				reg = <0x1500 0x100>;
				interrupts =
					<0x2 0x15 0x0 IRQ_TYPE_EDGE_BOTH>,
					<0x2 0x15 0x1 IRQ_TYPE_EDGE_BOTH>,
					<0x2 0x15 0x2 IRQ_TYPE_EDGE_RISING>,
					<0x2 0x15 0x3 IRQ_TYPE_EDGE_RISING>,
					<0x2 0x15 0x4 IRQ_TYPE_EDGE_BOTH>,
					<0x2 0x15 0x5 IRQ_TYPE_EDGE_RISING>,
					<0x2 0x15 0x6 IRQ_TYPE_EDGE_RISING>,
					<0x2 0x15 0x7 IRQ_TYPE_EDGE_RISING>;

				interrupt-names = "typec-or-rid-detect-change",
						  "typec-vpd-detect",
						  "typec-cc-state-change",
						  "typec-vconn-oc",
						  "typec-vbus-change",
						  "typec-attach-detach",
						  "typec-legacy-cable-detect",
						  "typec-try-snk-src-detect";
			};

			qcom,misc@1600 {
				reg = <0x1600 0x100>;
				interrupts =
					<0x2 0x16 0x0 IRQ_TYPE_EDGE_RISING>,
					<0x2 0x16 0x1 IRQ_TYPE_EDGE_RISING>,
					<0x2 0x16 0x2 IRQ_TYPE_EDGE_RISING>,
					<0x2 0x16 0x3 IRQ_TYPE_EDGE_RISING>,
					<0x2 0x16 0x4 IRQ_TYPE_EDGE_BOTH>,
					<0x2 0x16 0x5 IRQ_TYPE_EDGE_RISING>,
					<0x2 0x16 0x6 IRQ_TYPE_EDGE_RISING>,
					<0x2 0x16 0x7 IRQ_TYPE_EDGE_RISING>;

				interrupt-names = "wdog-snarl",
						  "wdog-bark",
						  "aicl-fail",
						  "aicl-done",
						  "smb-en",
						  "imp-trigger",
						  "temp-change",
						  "temp-change-smb";
			};

			qcom,schgm-flash@a600 {
				reg = <0xa600 0x100>;
				interrupts =
					<0x2 0xa6 0x2 IRQ_TYPE_EDGE_RISING>,
					<0x2 0xa6 0x5 IRQ_TYPE_EDGE_RISING>,
					<0x2 0xa6 0x6 IRQ_TYPE_EDGE_RISING>,
					<0x2 0xa6 0x7 IRQ_TYPE_EDGE_BOTH>;

				interrupt-names = "flash-state-change",
						"ilim1-s1",
						"ilim2-s2",
						"vreg-ok";
			};
		};

		pmi632_qg: qpnp,qg {
			compatible = "qcom,qpnp-qg","qcom,pmi632-qg";
			#address-cells = <1>;
			#size-cells = <1>;

			qcom,pmic-revid = <&pmi632_revid>;
			io-channels = <&pmi632_vadc ADC_BAT_THERM_PU2>,
				      <&pmi632_vadc ADC_BAT_ID_PU2>;
			io-channel-names = "batt-therm",
					   "batt-id";

			qcom,qgauge@4800 {
				status = "okay";
				reg = <0x4800 0x100>;
				interrupts =
					<0x2 0x48 0x0 IRQ_TYPE_EDGE_BOTH>,
					<0x2 0x48 0x1 IRQ_TYPE_EDGE_BOTH>,
					<0x2 0x48 0x2 IRQ_TYPE_EDGE_RISING>,
					<0x2 0x48 0x3 IRQ_TYPE_EDGE_RISING>,
					<0x2 0x48 0x4 IRQ_TYPE_EDGE_RISING>;
				interrupt-names = "qg-batt-missing",
						  "qg-vbat-low",
						  "qg-vbat-empty",
						  "qg-fifo-done",
						  "qg-good-ocv";
			};

			qcom,qg-sdam@b100 {
				status = "okay";
				reg = <0xb100 0x100>;
			};
		};

		pmi632_pbs_client3: qcom,pbs@7400 {
			compatible = "qcom,qpnp-pbs";
			reg = <0x7400 0x100>;
		};

		pmi632_sdam7: qcom,sdam@b600 {
			compatible = "qcom,spmi-sdam";
			reg = <0xb600 0x100>;
		};

		bcl_sensor: bcl@3d00 {
			compatible = "qcom,bcl-v5";
			reg = <0x3d00 0x100>;
			interrupts = <0x2 0x3d 0x0 IRQ_TYPE_NONE>,
					<0x2 0x3d 0x1 IRQ_TYPE_NONE>,
					<0x2 0x3d 0x2 IRQ_TYPE_NONE>;
			interrupt-names = "bcl-lvl0",
						"bcl-lvl1",
						"bcl-lvl2";
			qcom,ibat-use-qg-adc-5a;
			#thermal-sensor-cells = <1>;
		};

		bcl_soc: bcl-soc {
			compatible = "qcom,msm-bcl-soc";
			#thermal-sensor-cells = <0>;
		};
	};

	pmi632_gpios: pinctrl@c000 {
		compatible = "qcom,pmi632-gpio";
		reg = <0xc000 0x800>;
		interrupts = <0x2 0xc0 0 IRQ_TYPE_NONE>,
				<0x2 0xc1 0 IRQ_TYPE_NONE>,
				<0x2 0xc2 0 IRQ_TYPE_NONE>,
				<0x2 0xc3 0 IRQ_TYPE_NONE>,
				<0x2 0xc4 0 IRQ_TYPE_NONE>,
				<0x2 0xc5 0 IRQ_TYPE_NONE>,
				<0x2 0xc6 0 IRQ_TYPE_NONE>,
				<0x2 0xc7 0 IRQ_TYPE_NONE>;
		interrupt-names = "pmi632_gpio1", "pmi632_gpio2",
				"pmi632_gpio3", "pmi632_gpio4",
				"pmi632_gpio5", "pmi632_gpio6",
				"pmi632_gpio7", "pmi632_gpio8";
		gpio-controller;
		#gpio-cells = <2>;
	};

	pmi632_adc_tm: adc_tm@3500 {
		compatible = "qcom,adc-tm5","qcom,adc-tm5-iio","qcom,adc-tm7","qcom,adc-tm7-iio";
		reg = <0x3500 0x100>;
		interrupts = <0x2 0x35 0x0 IRQ_TYPE_EDGE_RISING>;
		interrupt-names = "thr-int-en";
		#address-cells = <1>;
		#size-cells = <0>;
		#thermal-sensor-cells = <1>;
	};
```

## Documentation/devicetree/bindings/power/supply/qcom,smb1355.txt
```
Qualcomm Switch-Mode Battery Charger and Boost

PROPERTIES
- compatible:
  Usage: required
  Value type: <stringlist>
  Description: Must be one of:
               - "qcom,i2c-pmic","qcom,smb1355"

- reg:
  Usage: required
  Value type: <u32>
  Description: Slave address of SMB1355

- interrupts:
  Usage: required
  Value type: <prop-encoded-array>
  Description: The format of the specifier is defined by the binding document
               describing the node's interrupt parent.

- interrupt-names:
  Usage: required
  Value type: <stringlist>
  Description: Must contain the following list, strictly ordered:
               "smb1355"


child nodes:
- smb1355_charger:
  Description: This node defines A smb1335 charger device node .

EXAMPLE
smb1355: qcom,smb1355@c {
	compatible = "qcom,i2c-pmic";
	reg = <0xc>;
	#address-cells = <1>;
	#size-cells = <0>;
	interrupt-parent = <&spmi_bus>;
	interrupts = <0x2 0xC5 0x0 IRQ_TYPE_LEVEL_LOW>;
	interrupt_names = "smb1355";
	interrupt-controller;
	#interrupt-cells = <3>;
	qcom,periph-map = <0x10 0x12 0x13 0x16>;
	status = "disabled";

	smb1355_revid: qcom,revid@100 {
		compatible = "qcom,qpnp-revid";
		reg = <0x100 0x100>;
	};

	smb1355_charger: qcom,smb1355-charger@1000 {
		compatible = "qcom,smb1355";
		qcom,pmic-revid = <&smb1355_revid>;
		reg = <0x1000 0x700>;
		#address-cells = <1>;
		#size-cells = <1>;
		interrupt-parent = <&smb1355>;
		status = "disabled";

		qcom,chgr@1000 {
			reg = <0x1000 0x100>;
			interrupts = <0x10 0x1 IRQ_TYPE_EDGE_RISING>;
			interrupt-names = "chg-state-change";
		};

		qcom,chgr-misc@1600 {
			reg = <0x1600 0x100>;
			interrupts = <0x16 0x1 IRQ_TYPE_EDGE_RISING>,
				     <0x16 0x6 IRQ_TYPE_EDGE_RISING>;
			interrupt-names = "wdog-bark",
					  "temperature-change";
		};
	};
};
```

## Documentation/devicetree/bindings/regulator/jlq-dvfs.txt
```
JLQ Duty cycle Driver

Duty cycle is used to record the regulator voltages in some time.
It can provide the statistic data for Power Optimize.

Required properties:
 - compatible:		Must be "jlq,dc-stat"
 - label:			A string, must be one of as following:
					"cpu"
					"ddr"
					"core"

Optional properties:
 - cpu-supply:		the input supply for cpu
 - ddr-supply:		the input supply for ddr
 - core-supply:		the input supply for core

Example:
	dc_stat0 : dc_stat0 {
		compatible = "jlq,dc-stat";
		cpu-supply = <&S1A>;
		lable = "cpu";
	};
```

## Documentation/devicetree/bindings/regulator/jlq-gdsc-regulator.txt
```
JLQ Global Distributed Switch Controller (GDSC) Regulator Driver

The GDSC driver, implemented under the regulator framework, is responsible for
safely collapsing and restoring power to peripheral and multimedia cores on
chipsets like JA510 for power savings.

Required properties:
 - compatible:      Must be "jlq,gdsc"
 - regulator-name:  A string used as a descriptive name for regulator outputs
 - reg:             The address of the GDSCR register

Optional properties:
 - parent-supply:   phandle to the parent supply/regulator node

Example:
	gdsc_smmu: jlq,gdsc@34510290 {
		compatible = "jlq,gdsc";
		regulator-name = "smmu_gdsc";
		parent-supply = <&pm6125_s4>;
		reg = <0x34510290 0x4>;
	};
```

## Documentation/devicetree/bindings/soc/jlq/extcon-jlq-gpio.txt
```
USB GPIO Extcon device

This is a virtual device used to generate USB cable states from the USB ID pin
connected to a GPIO pin.

Required properties:
- compatible: Should be "jlq,extcon-usb-gpio"

Either one of id-gpio must be present. Both can be present as well.
- id-gpio: gpio for USB ID pin. See gpio binding.

Example: Examples of extcon-usb-gpio node as listed below:
	usb_id: usb_id {
		compatible = "jlq,extcon-usb-gpio";
		id-gpio = <&gpio 61 0>;
		pinctrl-names = "default";
		pinctrl-0 = <&usb_phy_id_pin>;
	};
```

## Documentation/devicetree/bindings/soc/jlq/jlq,dummy.txt
```
JLQ dummy driver bindinngs

This binding descirbes the dummy driver responsible for detecting access
display/ai/gpu/vpu/adsp register when these master is power donw.


- compatible:
	Usage: required
	Value type: <string>
	Definition: must be "jlq,dummy"

- reg:
	Usage: required
	Value type: <prop-encoded-array>
	Definition: the base address and size of dummy register

- interrupts-names:
	Usage: required
	Value type: <string>
	Definition: the irq name of dummy report

- interrupts:
	Usage: required
	Value type: <prop-encoded-array>
	Definition: irq type(SPI), irq number and trigger type

- dummy-slaves:
	Usage: required
	Value type: <string array>
	Definition: dummy slave name sorted by the order in PD_RD_WR_INT_EN_CFG

- dummy-rpt-id:
	Usage" required
	Value type: <prop-encoded-array>
	Definition: dummy slave report id sorted by the order of PD_ARADDR_RPTx


= EXAMPLE

The following example represents jlq dummy device

disabled.

	dummy:dummy@0x3450e0c4 {
		reg = <0x3450e0c4 0xc0>;
		compatible = "jlq,dummy";
		interrupt-names = "top_sysctl_irq";
		interrupts = <GIC_SPI INT_TOP_SYS_CTL IRQ_TYPE_LEVEL_HIGH>;
		dummy-slaves = "ai", "gpu", "vpu", "display", "vdsp";
		dummy-rpt-id = <0 1 4 2 3>;
	};
```
