## Documentation/devicetree/bindings/soc/jlq/jlq,isr_monitor.txt
```
JLQ dummy driver bindinngs

This binding descirbes the isr monitor driver which can monitor all irq times
in a specified period, it will shows the active irq count when kernel crash,
This driver can help to detect irq storm.


- compatible:
	Usage: required
	Value type: <string>
	Definition: must be "jlq,isr-monitor"

- irq-interval:
	Usage: required
	Value type: <uint32>
	Definition: the monitor interval of isr monitor, in seconds unit

- max-irqs:
	Usage: required
	Value type: <uint32>
	Definition: the monitor maximum physical irqs supported by chip:


= EXAMPLE

The following example represents isr-monitor driver dts

disabled.
        isr-monitor {
		compatible = "jlq,isr-monitor";
		irq-interval = <10>;
		max-irqs = <256>;
	};
```

## Documentation/devicetree/bindings/soc/jlq/jlq,pll-power.txt
```
JLQ pll-power driver bindinngs

This binding descirbes the pll power driver, this driver will set initial voltage for pll

- compatible:
	Usage: required
	Value type: <string>
	Definition: must be "jlq,pll-power"

- *-supply:
	Usage: required
	Value type: <prop-encoded-array>
	Definition: power for pll

- jlq,supply-*:
	Usage: required
	Value type: u32
	Definition: voltage value

= EXAMPLE

pll-power {
	compatible = "jlq,pll-power";
	supply_0-supply = <&L12A>;
	jlq,supply_0 = <1800000 1800000>;
	supply_1-supply = <&L2A>;
	jlq,supply_1 = <800000 800000>;
	supply_2-supply = <&L3A_LEVEL>;
	jlq,supply_2 = <800000 800000>;
};
```
