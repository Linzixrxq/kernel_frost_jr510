## Documentation/devicetree/bindings/clock/jlq_clk.txt
```
Clock bindings for JLQ chips

This binding uses the common clock binding[1].
Documentation/devicetree/bindings/clock/clock-bindings.txt

Required properties :
- compatible :
			"jlq,ap_pwr_clks"
			"jlq,ddr_pwr_clks"
			"jlq,clk-thru"
			"jlq,clk-gate"
			"jlq,clk-div"
			"jlq,clk-mux"
			"jlq,clk-pllx"
			"jlq,clk-fdiv"
			"jlq,clk-pll1143x"
			"jlq,clk-pll1180x"
			"jlq,top_crg_clks"
			"jlq,cm4_sysctrl_clks"
			"jlq,audio_sysctrl_clks"
			"jlq,ai_sysctrl_clks"
			"jlq,vdsp_sysctrl_clks"
			"jlq,vpu_sysctrl_clks"
			"jlq,display_sysctrl_clks"
			"jlq,hblk_sysctrl_clks"
			"jlq,clk-smd"
			"qcom,bengal-gcc"

- reg : shall contain base register location and length
- #clock-cells : shall be 0
- clocks: shall be the parent clock phandle
- clock-output-names: clock name
Example:
		ddr_pwr_clks: ddr_pwr_clks@f9030000 {
			compatible = "jlq,ddr_pwr_clks";
			reg = <0xf9030000 0x1000>;

			ddr_pwr_clk32k: ddr_pwr_clk32k {
				compatible = "jlq,clk-thru";
				#clock-cells = <0>;
				clocks = <&clk32k>;
				clock-output-names = "ddr_pwr_clk32k";
			};
			gpio_clkgt: gpio_clkgt {
				compatible = "jlq,clk-gate";
				#clock-cells = <0>;
				clocks = <&ddr_pwr_clk32k>;
				jlq,clkgt = <DDRPWR_COMPONENT_CLKEN1
					PWR_BIT_SFT(5) PWR_WEBIT_DEF(5)>;
				clock-output-names = "gpio_clkgt";
			};
		}
```

## Documentation/devicetree/bindings/devfreq/devfreq_busmon_hw.txt
```
JLQ DDR bandwidth monitor device

busmon is a device that represents the jlq ddr bandwidth monitors that
can be used to measure the bandwidth of read/write traffic from the DDRC
master ports. For example, the CPU subsystem sits on one ddrc master port.

Required properties:
- compatible:         Must be "jlq,busmon"
- reg:                Pairs of physical base addresses and region sizes of
            memory mapped registers.
- reg-names:          Names of the bases for the above registers. Expected
            bases are: "bm_base", "sysctrl_base"
- interrupt-parent:   Parent of IRQ.
- interrupts:         Lists the threshold IRQ.
- busmon_port_nums:   The bus monitor hardware master port numbers that this device can monitor
- busmon_group_nums:  The bus monitor group numbers, which is hardware related.
- busmon_port0_target-dev:  The DT device that corresponds to this master port0
- busmon_port1_target-dev:  The DT device that corresponds to this master port1
- busmon_port2_target-dev:  The DT device that corresponds to this master port2
Optional properties:
- busmon_polling_ms:  Polling interval for the device in milliseconds. Default: 50

Example:

busmon: jlq,busmon {
    compatible = "jlq,busmon";
    reg = <0x34688000 0x8000>,<0x3450e000 0x1000>;
    reg-names = "bm_base","sysctrl_base"
    interrupt-parent = <&gic>;
    interrupts = <GIC_SPI INT_BUSMON IRQ_TYPE_LEVEL_HIGH>;
    interrupt-controller;
    busmon_port_nums = <6>;
    busmon_port0_target-dev = <&icc_ddr_port0>;
    busmon_port1_target-dev = <&icc_ddr_port1>;
    busmon_port2_target-dev = <&icc_ddr_port2>;
    busmon_group_nums = <16>;
    busmon_polling_ms = <50>;
};
```

## Documentation/devicetree/bindings/devfreq/devfreq_ddr_dfs.txt
```
JLQ devfreq ddr dfs device

ddr-dfs-dev is a device that performs real-time statistics of DDR frequency
requirements on the AP side and aggregates the requirements to vote for CM4.
At the same time, the device is registered with cooling-device, using the
cooling_devfreq logic.

Required properties:
- compatible:       Must be "devfreq-simple-dev"
- operating-points-v2 : A phandle to the OPP v2 table that holds meaningful
            instantaneous bandwidth values (in MB/s) that can be
            requested from the device master port to the slave port.
            The list of values depend on the supported bus/slave
            frequencies and the bus width.
Optional properties:
- polling-ms:   Polling interval for the device in milliseconds. Default: 50
- governor: Initial governor to user for the device. Default: "userspace"

Example:

ddr_dfs:jlq,ddr-devfreq {
    compatible = "jlq,ddr-devfreq";
    governor = "userspace";
    polling_ms = <50> ;
    operating-points-v2 = <&ddr_opp_table>;
};

ddr_opp_table: ddr-opp-table {
    compatible = "operating-points-v2";
    opp@200000000  {opp-hz = /bits/ 64 <200000000>;};
    opp@533000000  {opp-hz = /bits/ 64 <533000000>;};
    opp@800000000  {opp-hz = /bits/ 64 <800000000>;};
    opp@1066000000 {opp-hz = /bits/ 64 <1066000000>;};
    opp@1333000000 {opp-hz = /bits/ 64 <1333000000>;};
    opp@1866000000 {opp-hz = /bits/ 64 <1866000000>;};
};
```

## Documentation/devicetree/bindings/devfreq/devfreq_icc_ddr_port.txt
```
JLQ devfreq icc device

devfreq icc is a device that represents a JLQ device's BW requirements from its
master port(s) to a different device's slave port(s) in a JLQ SoC. This
device is typically used to vote for BW requirements from a device's (Eg:
CPU, GPU) master port(s) to the slave (Eg: DDR) port(s).

Required properties:
- compatible:       Must be "jlq,ddr-devfreq-port0" or "jlq,ddr-devfreq-port1"
            or "jlq,ddr-devfreq-port2" or "jlq,ddr-devfreq-port3"
            or "jlq,ddr-devfreq-port4"
- interconnects:    Pairs of phandles and interconnect provider specificers
            to denote the edge source and destination ports of the
            desired interconnect path.
- operating-points-v2:  A phandle to the OPP v2 table that holds meaningful
            instantaneous bandwidth values (in MB/s) that can be
            requested from the device master port to the slave port.
            The list of values depend on the supported bus/slave
            frequencies and the bus width.
Optional properties:
- jlq,active-only: Indicates that the bandwidth votes need to be
            enforced only when the CPU subsystem is active.
- governor:     Initial governor to use for the device.
            Default: "gov-busmon-bw"

Example:

icc_ddr_port0: jlq,ddr-devfreq-port0 {
    compatible = "jlq,ddr-devfreq-port0";
    governor = "gov-busmon-bw";
    interconnects = <&bus_sw0 MASTER_VDSP_BUS &bus_sw0 SLAVE_DDR_PORT1>;
    jlq,active-only;
    operating-points-v2 = <&ddr_port_bw_table0>;
};

ddr_port_bw_table0: ddr-port-bw-table0 {
    compatible = "operating-points-v2";
    opp@200000000   {opp-hz = /bits/ 64 <25600>;};
    opp@300000000   {opp-hz = /bits/ 64 <38400>;};
    opp@400000000   {opp-hz = /bits/ 64 <51200>;};
};
```

## Documentation/devicetree/bindings/dsp/jlq_vdsp.txt
```
JLQ vdsp-hw-vp6 bindings

Required properties:
- compatible:
  - "jlq,vdsp-hw-vp6,cma"
- reg: Physical base address and length of the controller's registers.
- vdsp-priv-mem : vdsp reserve mem.
- vdsp-start-addr : vdsp hardware pc start address.
- interrupt-controller: Mark the device node as an interrupt controller
- #interrupt-cells : Should be 2. The interrupt type is fixed in the hardware.
- interrupts: Specify the interrupt.
- iommus: vdsp smmu streamid.
- queue-priority: vdsp data stream queue priority.
- core-clock-rate: vdsp core clock default clk rate.

Example:

vdsp: vdsp {
	compatible = "jlq,vdsp-hw-vp6,cma";
	reg = <0x30000000 0x40000>,
		<0x30090000 0x1000>,
		<0x0 0x200000>,
		<0x200000 0xA00000>,
		<0xC00000 0x200000>,
		<0xE00000 0x100000>,
		<0xF00000 0x100000>,
		<0x1000000 0x7F000000>;
	reg-names = "vdsp_tcm_mem",
			"vdsp_sysctl_mem",
			"code-region",
			"reserved-region",
			"sysdump-region",
			"log-sys-region",
			"smd-sys-region",
			"dynamic-alloc-region";
	vdsp-priv-mem = <&vdsp_mem_region>;
	vdsp-start-addr = <0x80000000>;
	interrupt-parent = <&top_mbox_irq_vdspnsec>;
	interrupts = <0 IRQ_TYPE_LEVEL_HIGH>,
				<2 IRQ_TYPE_LEVEL_HIGH>,
				<3 IRQ_TYPE_LEVEL_HIGH>;
	interrupt-names = "smd-irq-id",
				"panic-irq-id", "wdog-irq-id";
	iommus = <&smmu 0x100>;
	clocks = <&vdsp_coreclk>, <&vdsp_bclk>, <&vdsp_pbclk>;
	clock-names = "coreclk", "bus-clk", "debug-clk";
	/* vdsp support the flow core clock rate : */
	/* 800000000 692494000 519322000 400000000 */
	/* 346214000 200000000 100000000 */
	core-clock-rate = <800000000>;
	is-debug-enable = <0>;
	is-support-smmu = <1>;
	device-irq = <0 1 0>; /* SMD IRQ_NUM, type(SECURE(0)/NON_SECURE(1)), reserved */
	device-irq-mode = <1>; /* VDSP_IRQ_LEVEL */
	host-irq = <0 1>; /* IRQ_NUM, type(SECURE(0)/NON_SECURE(1)) */
	host-irq-mode = <1>; /* VDSP_IRQ_LEVEL */
	queue-priority = <7>;
	force_ramdump_tx_irq = <2>;
}
```

## Documentation/devicetree/bindings/dsp/jlq_vdsp_log.txt
```
JLQ vdsp log bindings

Required properties:
- compatible:
  - "jlq,vdsp-log"
- interrupt-parent: use mailbox irq.
- interrupt-controller: Mark the device node as an interrupt controller.
- #interrupt-cells : Should be 2. The interrupt type is fixed in the hardware.
- interrupts: Specify the interrupt.
- jlq,vdsp_log_tx_irq: the number of ap send irq to vdsp by mailbox.

Example:

vdsp_log: vdsp_log {
	compatible = "jlq,vdsp-log";
	interrupt-parent = <&top_mbox_irq_vdspnsec>;
	interrupts = <1 IRQ_TYPE_LEVEL_HIGH>;
	interrupt-names = "log-irq-id";
	jlq,vdsp_log_tx_irq = <1>;
};
```

## Documentation/devicetree/bindings/dsp/jlq_vdsp_wdt.txt
```
JLQ vdsp-watchdog bindings

Required properties:
- compatible:
  - "jlq,vdsp_wdt"
- reg: Physical base address and length of the controller's registers.
- interrupt-controller: Mark the device node as an interrupt controller
- #interrupt-cells : Should be 2. The interrupt type is fixed in the hardware.
- interrupts: Specify the interrupt.

Example:

wdt3: watchdog@30709000 {
	compatible = "jlq,vdsp_wdt";
	reg = <0x30709000 0x1000>;
	reg-names = "wdt3_base";
	interrupts = <GIC_SPI INT_WDT3_BITE IRQ_TYPE_LEVEL_LOW>;
	interrupt-names = "wdt3_bite";
};
```

## Documentation/devicetree/bindings/input/touchscreen/novatek.txt
```
Device tree bindings for novatek 36525b series touchscreen controller

Required properties:

 - compatible		: Should be "novatek,NVT-ts-spi"
 - reg			: id of spi slave device.

Optional properties:

 - novatek,irq-gpio		: GPIO pin used for IRQ. The driver uses the
			  interrupt gpio pin as output to reset the device.
 - novatek,reset-gpio		: GPIO pin used for reset

The touchscreen-* properties are documented in touchscreen.txt in this
directory.

Example:

	nvt36525b@0 {
		reg = <0>;
		status = "okay";
		panel = <&panel_nt36525b_lv>;
		compatible = "novatek,NVT-ts-spi";
		novatek,reset-gpio = <&gpio 8 0>;
		novatek,irq-gpio = <&gpio 9 0>;
		novatek,longv-mode = <0x1>;
		novatek,swrst-n8-addr = <0x03F0FE>;
		novatek,spi-rd-fast-addr = <0x03F310>;
		novatek,resolution-width = /bits/ 16 <720>;
		novatek,resolution-height = /bits/ 16 <1650>;
		spi-max-frequency = <10000000>;
		/* ... */
	};
```

## Documentation/devicetree/bindings/interconnect/jr510.txt
```
JR510 bus interconnect driver binding
-----------------------------------------------------------

JR510 interconnect providers support system bandwidth requirements

Required properties :
- compatible : shall contain only one of the following:
			"jlq,bus_sw0"
			"jlq,top_bus"
			"jlq,qtang_xm1_bus"
			"jlq,hblk_bus"
			"jlq,fbe_bus"
			"jlq,bus_sw1"
			"jlq,bus_sw2"
			"jlq,bus_p0"
			"jlq,bus_p3"
			"jlq,qt_sys_noc"
			"jlq,qt_sys_noc_rt"
			"jlq,qt_sys_noc_nrt"
			"jlq,qt_snoc"
			"jlq,qt_cnoc"

- #interconnect-cells : should contain 1

Examples:

apps_rsc: rsc {
	bus_sw0: interconnect {
		compatible = "jlq,bus_sw0";
		#interconnect-cells = <1>;
	};
};
```

## Documentation/devicetree/bindings/mailbox/jlq-bridge.txt
```
JLQ Bridge Driver
================================

Bridge Device Node:
====================

Required properties:
--------------------
- compatible:		Shall be "jlq,bridge"
- jlq,bridge-edge:	the coprocessor communicated with AP, eg. 0 is zsp0
- jlq,bridge-name:	the name of bridge channel. Now there are PM and AUDIO
- reg:			Three region for the share memory base address, the receive base address and the send base address
- reg-names:		eg."baseaddr","rx_addr","tx_addr"
- interrupt-parent:	top_mailbox_irq is the interrupt parent
- interrupts:		interrupt for the receiver irq and receive flow irq
- interrupt-names:	the names list of received interrupt
- jlq,bridge-tx-irq:	the irq id for sending
- jlq,bridge-txctl-irq:	the irq id for the sending flow control

Example:
--------
	bridge_pm: bridge_pm {
		compatible = "jlq,bridge";
		jlq,bridge-edge = <0>;
		jlq,bridge-name = "PM";
		reg = <0xF9002000 0x0>,
			<0x4000 0x400>,
			<0x4400 0x400>;
		reg-names = "baseaddr","rx_addr","tx_addr";
		interrupt-parent = <&top_mailbox_irq>;
		interrupts = <0 0>,<1 0>;
		interrupt-names = "rx_irq","rx_ctl_id";
		jlq,bridge-tx-irq = <0x0>;
		jlq,bridge-txctl-irq = <0x1>;
	};
```

## Documentation/devicetree/bindings/mailbox/jlq-mailbox.txt
```
JLQ Mailbox IRQ Driver
================================

Mailbox Device Node:
====================

Required properties:
--------------------
- compatible:		Shall be "jlq,top_mailbox-base"
- reg:			Contains the top mailbox register base address
- status:		Shall be "disabled" or "enabled".
- interrupts:		Contains the interrupt information corresponding
- interrupt-controller:	Normal
- #interrupt-cells:	Normal
- irq_num:		the number of irqs

Example:
--------

	top_mailbox_irq: top_mailbox_irq {
		compatible = "jlq,top_mailbox-irq-ja310";
		interrupts = <GIC_SPI INT_TOP_MAILBOX 0>;
		interrupt-controller;
		#interrupt-cells = <2>;
		irq_num = <64>;
	};

	top_mailbox_base: top_mailbox_base@F9002000 {
		compatible = "jlq,top_mailbox-base";
		reg = <0xF9002000 0x400>;
		status = "disabled";
	};
```

## Documentation/devicetree/bindings/mailbox/jlq-nanohub.txt
```
jlq Nanohub driver

Nanohub driver is used to communicate between AP host and Sensorhub.

Required properties:
- compatible : should be "jlq,nanohub".
- sensorhub,cm4gpios : bit0~6 corresponding cm4gpio0~6 should be set to 1,
			when sensorhub use them as interrupt input gpios.
- pinctrl-names : must be default
- pinctrl-0 : initiate the muxpin configuration of gpios that sensorhub used.

Example:
	nanohub {
		compatible = "jlq,nanohub";
		sensorhub,cm4gpios = <0x00000072>;
		pinctrl-names = "default";
		pinctrl-0 = <&spi1_tx_pin &spi1_rx_clk_pins &cm4gpio_general
				&cm4gpio_pull &cm4gpio_nopull &i2c5_pins>;
	};
```

## Documentation/devicetree/bindings/misc/jlq-irq-ctrl.txt
```
jr510 lpm modules edge irq to level irq controll device

Required properties:
- compatible = "jlq,lpm-irq-ctrl";
- reg: specify the lpm-irq-ctrl module base address  and associated address range
- irq-mappings: specify the mapped edge->level gic spi irq number, the sequence
  of the irq represent the bit offset from the base address of lpm-irq-ctrl
  module, if no irq is mapped, set relevent byte to 0


Example:
	lpm-irq-ctl@0x34510704 {
		compatible = "jlq,lpm-irq-ctrl";
		reg = <0x34510704 8>;
		irq-mappings = [
			75 76 77 78 79 7a 7b 7c
			7d 7e 7f 81 82 83 84 85
			86 87 88 89 8a 8b 8c 8d
			8e 95 96 97 99 9a 9b 9c
			b1 b2 b3 b4 b5 b6 b7 b8
			b9 ba bb bc bd be
		];
	};
```
